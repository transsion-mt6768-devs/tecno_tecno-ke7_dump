/dts-v1/;

/ {

	__fixups__ {
		accdet = "/fragment@9:target:0";
		auxadc = "/fragment@18:target:0", "/fragment@19/__overlay__:io-channels:0";
		chosen = "/fragment@1:target:0";
		consys = "/fragment@13:target:0";
		dsi_te = "/fragment@34:target:0";
		flashlights_aw36515 = "/fragment@50:target:0";
		flashlights_ocp81375 = "/fragment@52:target:0";
		gpio = "/fragment@31:target:0";
		gpio_usage_mapping = "/fragment@30:target:0";
		i2c0 = "/fragment@21:target:0";
		i2c1 = "/fragment@22:target:0";
		i2c2 = "/fragment@8:target:0", "/fragment@23:target:0";
		i2c3 = "/fragment@24:target:0";
		i2c4 = "/fragment@25:target:0";
		i2c5 = "/fragment@26:target:0";
		i2c6 = "/fragment@27:target:0";
		i2c7 = "/fragment@28:target:0";
		i2c8 = "/fragment@29:target:0";
		irtx_pwm = "/fragment@14:target:0";
		kd_camera_hw1 = "/fragment@44:target:0", "/fragment@48:target:0";
		keypad = "/fragment@46:target:0";
		main_pmic = "/fragment@35:target:0";
		md1_sim1_hot_plug_eint = "/fragment@36:target:0";
		md_auxadc = "/fragment@19:target:0";
		mt6370_pmu = "/fragment@10:target:0";
		mt6370_typec = "/fragment@11:target:0";
		mt_pmic_vcama1_ldo_reg = "/fragment@37:target:0", "/fragment@44/__overlay__:vcama_main2-supply:0", "/fragment@44/__overlay__:vcama_main3-supply:0", "/fragment@48/__overlay__:cam2_vcama-supply:0", "/fragment@48/__overlay__:cam4_vcama-supply:0";
		mt_pmic_vcama2_ldo_reg = "/fragment@38:target:0", "/fragment@44/__overlay__:vcama_sub2-supply:0", "/fragment@48/__overlay__:cam3_vcama-supply:0";
		mt_pmic_vcamd_ldo_reg = "/fragment@41:target:0", "/fragment@44/__overlay__:vcamd_main2-supply:0", "/fragment@44/__overlay__:vcamd_sub2-supply:0", "/fragment@44/__overlay__:vcamd_sub-supply:0", "/fragment@48/__overlay__:cam1_vcamd-supply:0", "/fragment@48/__overlay__:cam2_vcamd-supply:0", "/fragment@48/__overlay__:cam3_vcamd-supply:0";
		mt_pmic_vcamio_ldo_reg = "/fragment@42:target:0", "/fragment@44/__overlay__:vcamio-supply:0", "/fragment@44/__overlay__:vcamio_sub-supply:0", "/fragment@44/__overlay__:vcamio_main2-supply:0", "/fragment@44/__overlay__:vcamio_sub2-supply:0", "/fragment@48/__overlay__:cam0_vcamio-supply:0", "/fragment@48/__overlay__:cam1_vcamio-supply:0", "/fragment@48/__overlay__:cam2_vcamio-supply:0", "/fragment@48/__overlay__:cam3_vcamio-supply:0", "/fragment@48/__overlay__:cam4_vcamio-supply:0";
		mt_pmic_vldo28_ldo_reg = "/fragment@43:target:0", "/fragment@44/__overlay__:vcamaf-supply:0", "/fragment@45/__overlay__:vtouch-supply:0";
		mt_pmic_vsim1_ldo_reg = "/fragment@39:target:0";
		mt_pmic_vsim2_ldo_reg = "/fragment@40:target:0";
		mtkfb = "/fragment@17:target:0";
		odm = "/fragment@2:target:0";
		otg_iddig = "/fragment@33:target:0";
		pio = "/fragment@2/__overlay__/tran_audio:extamp_gpio:0", "/fragment@2/__overlay__/fingerprint:interrupt-parent:0", "/fragment@2/__overlay__/fingerprint:fpc,gpio_irq:0", "/fragment@4:target:0", "/fragment@7:target:0", "/fragment@10/__overlay__:mt6370,intr_gpio:0", "/fragment@11/__overlay__:mt6370pd,intr_gpio:0", "/fragment@12:target:0", "/fragment@15:target:0", "/fragment@16:target:0", "/fragment@30/__overlay__:GPIO_SIM1_HOT_PLUG:0", "/fragment@30/__overlay__:GPIO_SIM2_SIO:0", "/fragment@30/__overlay__:GPIO_SIM2_SRST:0", "/fragment@30/__overlay__:GPIO_SIM2_SCLK:0", "/fragment@30/__overlay__:GPIO_SIM1_SCLK:0", "/fragment@30/__overlay__:GPIO_SIM1_SRST:0", "/fragment@30/__overlay__:GPIO_SIM1_SIO:0", "/fragment@32/__overlay__:interrupt-parent:0", "/fragment@33/__overlay__:interrupt-parent:0", "/fragment@33/__overlay__:deb-gpios:0", "/fragment@34/__overlay__:interrupt-parent:0", "/fragment@35/__overlay__:interrupt-parent:0", "/fragment@47:target:0", "/fragment@49:target:0", "/fragment@51:target:0";
		pmic_clock_buffer_ctrl = "/fragment@20:target:0";
		reserved_memory = "/fragment@0:target:0";
		spi0 = "/fragment@3:target:0";
		spi2 = "/fragment@5:target:0";
		touch = "/fragment@6:target:0", "/fragment@32:target:0", "/fragment@45:target:0";
	};

	__local_fixups__ {

		fragment@13 {

			__overlay__ {
				pinctrl-0 = <0x0>;
				pinctrl-1 = <0x0>;
				pinctrl-2 = <0x0>;
				pinctrl-3 = <0x0>;
			};
		};

		fragment@14 {

			__overlay__ {
				pinctrl-0 = <0x0>;
				pinctrl-1 = <0x0>;
			};
		};

		fragment@17 {

			__overlay__ {
				pinctrl-0 = <0x0>;
				pinctrl-1 = <0x0>;
				pinctrl-2 = <0x0>;
				pinctrl-3 = <0x0>;
				pinctrl-4 = <0x0>;
				pinctrl-5 = <0x0>;
				pinctrl-6 = <0x0>;
			};
		};

		fragment@2 {

			__overlay__ {

				fingerprint {
					pinctrl-0 = <0x0>;
					pinctrl-1 = <0x0>;
					pinctrl-2 = <0x0>;
					pinctrl-3 = <0x0>;
					pinctrl-4 = <0x0>;
				};
			};
		};

		fragment@48 {

			__overlay__ {
				pinctrl-0 = <0x0>;
				pinctrl-1 = <0x0>;
				pinctrl-10 = <0x0>;
				pinctrl-11 = <0x0>;
				pinctrl-12 = <0x0>;
				pinctrl-13 = <0x0>;
				pinctrl-14 = <0x0>;
				pinctrl-15 = <0x0>;
				pinctrl-16 = <0x0>;
				pinctrl-17 = <0x0>;
				pinctrl-18 = <0x0>;
				pinctrl-19 = <0x0>;
				pinctrl-2 = <0x0>;
				pinctrl-20 = <0x0>;
				pinctrl-21 = <0x0>;
				pinctrl-22 = <0x0>;
				pinctrl-23 = <0x0>;
				pinctrl-24 = <0x0>;
				pinctrl-25 = <0x0>;
				pinctrl-26 = <0x0>;
				pinctrl-27 = <0x0>;
				pinctrl-28 = <0x0>;
				pinctrl-29 = <0x0>;
				pinctrl-3 = <0x0>;
				pinctrl-30 = <0x0>;
				pinctrl-31 = <0x0>;
				pinctrl-32 = <0x0>;
				pinctrl-33 = <0x0>;
				pinctrl-34 = <0x0>;
				pinctrl-35 = <0x0>;
				pinctrl-36 = <0x0>;
				pinctrl-37 = <0x0>;
				pinctrl-38 = <0x0>;
				pinctrl-39 = <0x0>;
				pinctrl-4 = <0x0>;
				pinctrl-40 = <0x0>;
				pinctrl-41 = <0x0>;
				pinctrl-42 = <0x0>;
				pinctrl-43 = <0x0>;
				pinctrl-44 = <0x0>;
				pinctrl-45 = <0x0>;
				pinctrl-46 = <0x0>;
				pinctrl-47 = <0x0>;
				pinctrl-48 = <0x0>;
				pinctrl-49 = <0x0>;
				pinctrl-5 = <0x0>;
				pinctrl-50 = <0x0>;
				pinctrl-51 = <0x0>;
				pinctrl-6 = <0x0>;
				pinctrl-7 = <0x0>;
				pinctrl-8 = <0x0>;
				pinctrl-9 = <0x0>;
			};
		};

		fragment@50 {

			__overlay__ {
				pinctrl-0 = <0x0>;
				pinctrl-1 = <0x0>;
				pinctrl-2 = <0x0>;
			};
		};

		fragment@52 {

			__overlay__ {
				pinctrl-0 = <0x0>;
				pinctrl-1 = <0x0>;
				pinctrl-2 = <0x0>;
			};
		};

		fragment@6 {

			__overlay__ {
				pinctrl-0 = <0x0>;
				pinctrl-1 = <0x0>;
				pinctrl-2 = <0x0>;
				pinctrl-3 = <0x0>;
				pinctrl-4 = <0x0>;
				pinctrl-5 = <0x0>;
			};
		};
	};

	__symbols__ {
		camera0_mclk_2mA = "/fragment@47/__overlay__/camera0_mclk_2mA@gpio100";
		camera0_mclk_4mA = "/fragment@47/__overlay__/camera0_mclk_4mA@gpio100";
		camera0_mclk_6mA = "/fragment@47/__overlay__/camera0_mclk_6mA@gpio100";
		camera0_mclk_8mA = "/fragment@47/__overlay__/camera0_mclk_8mA@gpio100";
		camera0_mclk_off = "/fragment@47/__overlay__/camera0_mclk_gpio_mode@gpio100";
		camera0_rst_high = "/fragment@47/__overlay__/camera0_rst_output_high@gpio102";
		camera0_rst_low = "/fragment@47/__overlay__/camera0_rst_output_low@gpio102";
		camera0_vcama_off = "/fragment@47/__overlay__/camera0_vcama_output_low@gpio23";
		camera0_vcama_on = "/fragment@47/__overlay__/camera0_vcama_output_high@gpio23";
		camera0_vcamd_off = "/fragment@47/__overlay__/camera0_vcamd_output_low@gpio79";
		camera0_vcamd_on = "/fragment@47/__overlay__/camera0_vcamd_output_high@gpio79";
		camera1_mclk_2mA = "/fragment@47/__overlay__/camera1_mclk_2mA@gpio99";
		camera1_mclk_4mA = "/fragment@47/__overlay__/camera1_mclk_4mA@gpio99";
		camera1_mclk_6mA = "/fragment@47/__overlay__/camera1_mclk_6mA@gpio99";
		camera1_mclk_8mA = "/fragment@47/__overlay__/camera1_mclk_8mA@gpio99";
		camera1_mclk_off = "/fragment@47/__overlay__/camera1_mclk_gpio_mode@gpio99";
		camera1_pdn_high = "/fragment@47/__overlay__/camera1_pdn_output_high@gpio97";
		camera1_pdn_low = "/fragment@47/__overlay__/camera1_pdn_output_low@gpio97";
		camera1_rst_high = "/fragment@47/__overlay__/camera1_rst_output_high@gpio101";
		camera1_rst_low = "/fragment@47/__overlay__/camera1_rst_output_low@gpio101";
		camera1_vcama_off = "/fragment@47/__overlay__/camera1_vcama_output_low@gpio23";
		camera1_vcama_on = "/fragment@47/__overlay__/camera1_vcama_output_high@gpio23";
		camera2_mclk_2mA = "/fragment@47/__overlay__/camera2_mclk_2mA@gpio108";
		camera2_mclk_4mA = "/fragment@47/__overlay__/camera2_mclk_4mA@gpio108";
		camera2_mclk_6mA = "/fragment@47/__overlay__/camera2_mclk_6mA@gpio108";
		camera2_mclk_8mA = "/fragment@47/__overlay__/camera2_mclk_8mA@gpio108";
		camera2_mclk_off = "/fragment@47/__overlay__/camera2_mclk_gpio_mode@gpio108";
		camera2_pdn_high = "/fragment@47/__overlay__/camera2_pdn_output_high@gpio107";
		camera2_pdn_low = "/fragment@47/__overlay__/camera2_pdn_output_low@gpio107";
		camera2_rst_high = "/fragment@47/__overlay__/camera2_rst_output_high@gpio109";
		camera2_rst_low = "/fragment@47/__overlay__/camera2_rst_output_low@gpio109";
		camera3_mclk_2mA = "/fragment@47/__overlay__/camera3_mclk_2mA@gpio111";
		camera3_mclk_4mA = "/fragment@47/__overlay__/camera3_mclk_4mA@gpio111";
		camera3_mclk_6mA = "/fragment@47/__overlay__/camera3_mclk_6mA@gpio111";
		camera3_mclk_8mA = "/fragment@47/__overlay__/camera3_mclk_8mA@gpio111";
		camera3_mclk_off = "/fragment@47/__overlay__/camera3_mclk_gpio_mode@gpio111";
		camera3_pdn_high = "/fragment@47/__overlay__/camera3_pdn_output_high@gpio110";
		camera3_pdn_low = "/fragment@47/__overlay__/camera3_pdn_output_low@gpio110";
		camera3_rst_high = "/fragment@47/__overlay__/camera3_rst_output_high@gpio112";
		camera3_rst_low = "/fragment@47/__overlay__/camera3_rst_output_low@gpio112";
		camera4_mclk_2mA = "/fragment@47/__overlay__/camera4_mclk_2mA@gpio108";
		camera4_mclk_4mA = "/fragment@47/__overlay__/camera4_mclk_4mA@gpio108";
		camera4_mclk_6mA = "/fragment@47/__overlay__/camera4_mclk_6mA@gpio108";
		camera4_mclk_8mA = "/fragment@47/__overlay__/camera4_mclk_8mA@gpio108";
		camera4_mclk_off = "/fragment@47/__overlay__/camera4_mclk_gpio_mode@gpio108";
		camera4_pdn_high = "/fragment@47/__overlay__/camera4_pdn_output_high@gpio159";
		camera4_pdn_low = "/fragment@47/__overlay__/camera4_pdn_output_low@gpio159";
		camera_main_af_mtk = "/fragment@23/__overlay__/camera_main_af@0c";
		camera_main_eeprom_mtk = "/fragment@23/__overlay__/camera_main_eeprom@50";
		camera_main_mtk = "/fragment@23/__overlay__/camera_main@1a";
		camera_main_three_mtk = "/fragment@23/__overlay__/camera_main_three@18";
		camera_main_two_mtk = "/fragment@25/__overlay__/camera_main_two@10";
		camera_mipi_switch_en_high = "/fragment@47/__overlay__/camera_mipi_switch_en_high@gpio65";
		camera_mipi_switch_en_low = "/fragment@47/__overlay__/camera_mipi_switch_en_low@gpio65";
		camera_mipi_switch_sel_high = "/fragment@47/__overlay__/camera_mipi_switch_sel_high@gpio66";
		camera_mipi_switch_sel_low = "/fragment@47/__overlay__/camera_mipi_switch_sel_low@gpio66";
		camera_pins_default = "/fragment@47/__overlay__/camdefault";
		camera_sub_eeprom_mtk = "/fragment@25/__overlay__/camera_sub_eeprom@52";
		camera_sub_mtk = "/fragment@25/__overlay__/camera_sub@2d";
		camera_sub_two_mtk = "/fragment@28/__overlay__/camera_sub_two@16";
		cap_touch_mtk = "/fragment@21/__overlay__/cap_touch@14";
		ccu_sensor_i2c_2_hw_mtk = "/fragment@23/__overlay__/ccu_sensor_i2c_2_hw@11";
		ccu_sensor_i2c_4_hw_mtk = "/fragment@25/__overlay__/ccu_sensor_i2c_4_hw@12";
		consys_pins_default = "/fragment@12/__overlay__/consys_default";
		ctp_pins_default = "/fragment@7/__overlay__/eint0default";
		ctp_pins_eint_as_int = "/fragment@7/__overlay__/eint@0";
		ctp_pins_eint_output0 = "/fragment@7/__overlay__/eintoutput0";
		ctp_pins_eint_output1 = "/fragment@7/__overlay__/eintoutput1";
		ctp_pins_rst_output0 = "/fragment@7/__overlay__/rstoutput0";
		ctp_pins_rst_output1 = "/fragment@7/__overlay__/rstoutput1";
		ctp_ts_pins_default = "/fragment@7/__overlay__/eint1default";
		fingerprint = "/fragment@2/__overlay__/fingerprint";
		fingerprint_default = "/fragment@4/__overlay__/fingerprint_default";
		fingerprint_eint = "/fragment@4/__overlay__/gpio7_eint";
		fingerprint_eint_pull_down = "/fragment@4/__overlay__/gpio7_eint_pull_down";
		fingerprint_rst_one = "/fragment@4/__overlay__/rst_out_one";
		fingerprint_rst_zero = "/fragment@4/__overlay__/rst_out_zero";
		flashlights_aw36515_pins_default = "/fragment@49/__overlay__/aw36515default";
		flashlights_aw36515_pins_hwen_high = "/fragment@49/__overlay__/aw36515hwen_high";
		flashlights_aw36515_pins_hwen_low = "/fragment@49/__overlay__/aw36515hwen_low";
		flashlights_ocp81375_pins_default = "/fragment@51/__overlay__/ocp81375default";
		flashlights_ocp81375_pins_hwen_high = "/fragment@51/__overlay__/ocp81375hwen_high";
		flashlights_ocp81375_pins_hwen_low = "/fragment@51/__overlay__/ocp81375hwen_low";
		gpslna_pins_init = "/fragment@12/__overlay__/gpslna@0";
		gpslna_pins_oh = "/fragment@12/__overlay__/gpslna@1";
		gpslna_pins_ol = "/fragment@12/__overlay__/gpslna@2";
		i2c_lcd_bias_mtk = "/fragment@27/__overlay__/i2c_lcd_bias@3e";
		irtx_gpio_led_default = "/fragment@15/__overlay__/irtx_gpio_led_def@gpio12";
		irtx_gpio_led_set = "/fragment@15/__overlay__/irtx_gpio_led_set@gpio12";
		led0 = "/fragment@2/__overlay__/led@0";
		led1 = "/fragment@2/__overlay__/led@1";
		led2 = "/fragment@2/__overlay__/led@2";
		led3 = "/fragment@2/__overlay__/led@3";
		led4 = "/fragment@2/__overlay__/led@4";
		led5 = "/fragment@2/__overlay__/led@5";
		led6 = "/fragment@2/__overlay__/led@6";
		mtkfb_pins_default = "/fragment@16/__overlay__/dispdefault";
		mtkfb_pins_lcd_bias_enn0 = "/fragment@16/__overlay__/lcd_bias_enn0_gpio";
		mtkfb_pins_lcd_bias_enn1 = "/fragment@16/__overlay__/lcd_bias_enn1_gpio";
		mtkfb_pins_lcd_bias_enp0 = "/fragment@16/__overlay__/lcd_bias_enp0_gpio";
		mtkfb_pins_lcd_bias_enp1 = "/fragment@16/__overlay__/lcd_bias_enp1_gpio";
		mtkfb_pins_lcm_reset0 = "/fragment@16/__overlay__/lcm_rst_out0_gpio";
		mtkfb_pins_lcm_reset1 = "/fragment@16/__overlay__/lcm_rst_out1_gpio";
		nfc_mtk = "/fragment@24/__overlay__/nfc@08";
		slave_charger_mtk = "/fragment@28/__overlay__/slave_charger@4b";
		strobe_main_mtk = "/fragment@27/__overlay__/strobe_main@63";
		subpmic_pmu_mtk = "/fragment@26/__overlay__/subpmic_pmu@34";
		tran_audio = "/fragment@2/__overlay__/tran_audio";
		tran_touch = "/fragment@5/__overlay__/touch@0";
		usb_type_c_mtk = "/fragment@26/__overlay__/usb_type_c@4e";
		vibrator0 = "/fragment@2/__overlay__/vibrator@0";
	};

	fragment@0 {
		target = <0xffffffff>;

		__overlay__ {

			reserve-memory-scp_share {
				alignment = <0x0 0x1000000>;
				alloc-ranges = <0x0 0x40000000 0x0 0x50000000>;
				compatible = "mediatek,reserve-memory-scp_share";
				no-map;
				size = <0x0 0xd00000>;
			};
		};
	};

	fragment@1 {
		target = <0xffffffff>;

		__overlay__ {
			atag,videolfb-fb_base_h = <0x0>;
			atag,videolfb-fb_base_l = "~`P";
			atag,videolfb-fps = <0x1770>;
			atag,videolfb-islcm_inited = <0x0>;
			atag,videolfb-islcmfound = <0x1>;
			atag,videolfb-lcmname = "hx83112b_fhdp_dsi_cmd_auo_rt5081_drv";
			atag,videolfb-vramSize = <0x17e8000>;
		};
	};

	fragment@10 {
		target = <0xffffffff>;

		__overlay__ {
			mt6370,intr_gpio = <0xffffffff 0x14 0x0>;
			mt6370,intr_gpio_num = <0x14>;
		};
	};

	fragment@11 {
		target = <0xffffffff>;

		__overlay__ {
			mt6370pd,intr_gpio = <0xffffffff 0x29 0x0>;
			mt6370pd,intr_gpio_num = <0x29>;
		};
	};

	fragment@12 {
		target = <0xffffffff>;

		__overlay__ {

			consys_default {
				phandle = <0xc>;
			};

			gpslna@0 {
				phandle = <0xd>;

				pins_cmd_dat {
					bias-disable;
					output-low;
					pinmux = <0x5b00>;
					slew-rate = <0x0>;
				};
			};

			gpslna@1 {
				phandle = <0xe>;

				pins_cmd_dat {
					output-high;
					pinmux = <0x5b00>;
					slew-rate = <0x1>;
				};
			};

			gpslna@2 {
				phandle = <0xf>;

				pins_cmd_dat {
					output-low;
					pinmux = <0x5b00>;
					slew-rate = <0x1>;
				};
			};
		};
	};

	fragment@13 {
		target = <0xffffffff>;

		__overlay__ {
			pinctrl-0 = <0xc>;
			pinctrl-1 = <0xd>;
			pinctrl-2 = <0xe>;
			pinctrl-3 = <0xf>;
			pinctrl-names = "default", "gps_lna_state_init", "gps_lna_state_oh", "gps_lna_state_ol";
			status = "okay";
		};
	};

	fragment@14 {
		target = <0xffffffff>;

		__overlay__ {
			pinctrl-0 = <0x10>;
			pinctrl-1 = <0x11>;
			pinctrl-names = "irtx_gpio_led_default", "irtx_gpio_led_set";
			status = "okay";
		};
	};

	fragment@15 {
		target = <0xffffffff>;

		__overlay__ {

			irtx_gpio_led_def@gpio12 {
				phandle = <0x10>;

				pins_cmd_dat {
					bias-disable;
					input-schmitt-enable = <0x0>;
					output-low;
					pinmux = <0xc00>;
					slew-rate = <0x1>;
				};
			};

			irtx_gpio_led_set@gpio12 {
				phandle = <0x11>;

				pins_cmd_dat {
					output-high;
					pinmux = <0xc01>;
					slew-rate = <0x1>;
				};
			};
		};
	};

	fragment@16 {
		target = <0xffffffff>;

		__overlay__ {

			dispdefault {
				phandle = <0x12>;
			};

			lcd_bias_enn0_gpio {
				phandle = <0x17>;

				pins_cmd_dat {
					output-low;
					pinmux = <0x9800>;
					slew-rate = <0x1>;
				};
			};

			lcd_bias_enn1_gpio {
				phandle = <0x18>;

				pins_cmd_dat {
					output-high;
					pinmux = <0x9800>;
					slew-rate = <0x1>;
				};
			};

			lcd_bias_enp0_gpio {
				phandle = <0x15>;

				pins_cmd_dat {
					output-low;
					pinmux = <0x9900>;
					slew-rate = <0x1>;
				};
			};

			lcd_bias_enp1_gpio {
				phandle = <0x16>;

				pins_cmd_dat {
					output-high;
					pinmux = <0x9900>;
					slew-rate = <0x1>;
				};
			};

			lcm_rst_out0_gpio {
				phandle = <0x13>;

				pins_cmd_dat {
					output-low;
					pinmux = <0x2d00>;
					slew-rate = <0x1>;
				};
			};

			lcm_rst_out1_gpio {
				phandle = <0x14>;

				pins_cmd_dat {
					output-high;
					pinmux = <0x2d00>;
					slew-rate = <0x1>;
				};
			};
		};
	};

	fragment@17 {
		target = <0xffffffff>;

		__overlay__ {
			pinctrl-0 = <0x12>;
			pinctrl-1 = <0x13>;
			pinctrl-2 = <0x14>;
			pinctrl-3 = <0x15>;
			pinctrl-4 = <0x16>;
			pinctrl-5 = <0x17>;
			pinctrl-6 = <0x18>;
			pinctrl-names = "dispdefault", "lcm_rst_out0_gpio", "lcm_rst_out1_gpio", "lcd_bias_enp0_gpio", "lcd_bias_enp1_gpio", "lcd_bias_enn0_gpio", "lcd_bias_enn1_gpio";
			status = "okay";
		};
	};

	fragment@18 {
		target = <0xffffffff>;

		__overlay__ {

			adc_channel@ {
				compatible = "mediatek,adc_channel";
				mediatek,adc_fdd_rf_params_dynamic_custom_ch = <0x4>;
				mediatek,temperature0 = <0x0>;
				mediatek,temperature1 = <0x1>;
				status = "okay";
			};
		};
	};

	fragment@19 {
		target = <0xffffffff>;

		__overlay__ {
			io-channels = <0xffffffff 0x4>;
		};
	};

	fragment@2 {
		target = <0xffffffff>;

		__overlay__ {

			fingerprint {
				compatible = "mediatek,mt6753-fingerprint";
				debounce = <0x7 0x0>;
				fpc,gpio_irq = <0xffffffff 0x7 0x0>;
				interrupt-parent = <0xffffffff>;
				interrupts = <0x7 0x1 0x7 0x0>;
				phandle = <0x5c>;
				pinctrl-0 = <0x1>;
				pinctrl-1 = <0x2>;
				pinctrl-2 = <0x3>;
				pinctrl-3 = <0x4>;
				pinctrl-4 = <0x5>;
				pinctrl-names = "fingerprint_default", "fingerprint_pin_irq", "fingerprint_eint_pull_down", "fingerprint_reset_high", "fingerprint_reset_low", "fingerprint_power_high", "fingerprint_power_low";
				status = "okay";
			};

			led@0 {
				compatible = "mediatek,red";
				data = <0x1>;
				led_mode = <0x0>;
				phandle = <0x53>;
				pwm_config = <0x0 0x0 0x0 0x0 0x0>;
			};

			led@1 {
				compatible = "mediatek,green";
				data = <0x1>;
				led_mode = <0x0>;
				phandle = <0x54>;
				pwm_config = <0x0 0x0 0x0 0x0 0x0>;
			};

			led@2 {
				compatible = "mediatek,blue";
				data = <0x2>;
				led_mode = <0x3>;
				phandle = <0x55>;
				pwm_config = <0x0 0x0 0x0 0x0 0x0>;
			};

			led@3 {
				compatible = "mediatek,jogball-backlight";
				data = <0x1>;
				led_mode = <0x0>;
				phandle = <0x56>;
				pwm_config = <0x0 0x0 0x0 0x0 0x0>;
			};

			led@4 {
				compatible = "mediatek,keyboard-backlight";
				data = <0x1>;
				led_mode = <0x0>;
				phandle = <0x57>;
				pwm_config = <0x0 0x0 0x0 0x0 0x0>;
			};

			led@5 {
				compatible = "mediatek,button-backlight";
				data = <0x1>;
				led_mode = <0x0>;
				phandle = <0x58>;
				pwm_config = <0x0 0x0 0x0 0x0 0x0>;
			};

			led@6 {
				compatible = "mediatek,lcd-backlight";
				data = <0x1>;
				led_mode = <0x5>;
				phandle = <0x59>;
				pwm_config = <0x0 0x0 0x0 0x0 0x0>;
			};

			tran_audio {
				compatible = "tran_audio,audio";
				extamp_gpio = <0xffffffff 0x27 0x0>;
				extamp_mode = <0x2>;
				extamp_speech_mode = <0x2>;
				phandle = <0x5b>;
				real_2in1_receiver_mode = <0x6>;
			};

			vibrator@0 {
				compatible = "mediatek,vibrator";
				phandle = <0x5a>;
				vib_limit = <0x9>;
				vib_timer = <0x19>;
				vib_vol = <0xb>;
			};
		};
	};

	fragment@20 {
		target = <0xffffffff>;

		__overlay__ {
			mediatek,clkbuf-config = <0x2 0x1 0x1 0x2 0x0 0x0 0x0>;
			mediatek,clkbuf-driving-current = <0x1 0x1 0x1 0x1 0x1 0x1 0x1>;
			mediatek,clkbuf-quantity = <0x7>;
			status = "okay";
		};
	};

	fragment@21 {
		target = <0xffffffff>;

		__overlay__ {
			#address-cells = <0x1>;
			#size-cells = <0x0>;
			clock-frequency = <0x61a80>;
			mediatek,use-open-drain;

			cap_touch@14 {
				compatible = "mediatek,cap_touch";
				phandle = <0x5f>;
				reg = <0x14>;
				status = "okay";
			};
		};
	};

	fragment@22 {
		target = <0xffffffff>;

		__overlay__ {
			#address-cells = <0x1>;
			#size-cells = <0x0>;
			clock-frequency = <0x61a80>;
			mediatek,use-open-drain;
		};
	};

	fragment@23 {
		target = <0xffffffff>;

		__overlay__ {
			#address-cells = <0x1>;
			#size-cells = <0x0>;
			clock-frequency = <0x61a80>;
			mediatek,use-open-drain;

			camera_main@1a {
				compatible = "mediatek,camera_main";
				phandle = <0x61>;
				reg = <0x1a>;
				status = "okay";
			};

			camera_main_af@0c {
				compatible = "mediatek,camera_main_af";
				phandle = <0x63>;
				reg = <0xc>;
				status = "okay";
			};

			camera_main_eeprom@50 {
				compatible = "mediatek,camera_main_eeprom";
				phandle = <0x62>;
				reg = <0x50>;
				status = "okay";
			};

			camera_main_three@18 {
				compatible = "mediatek,camera_main_three";
				phandle = <0x60>;
				reg = <0x18>;
				status = "okay";
			};

			ccu_sensor_i2c_2_hw@11 {
				compatible = "mediatek,ccu_sensor_i2c_2_hw";
				phandle = <0x64>;
				reg = <0x11>;
				status = "okay";
			};
		};
	};

	fragment@24 {
		target = <0xffffffff>;

		__overlay__ {
			#address-cells = <0x1>;
			#size-cells = <0x0>;
			clock-frequency = <0x61a80>;
			mediatek,use-open-drain;

			nfc@08 {
				compatible = "mediatek,nfc";
				phandle = <0x65>;
				reg = <0x8>;
				status = "okay";
			};
		};
	};

	fragment@25 {
		target = <0xffffffff>;

		__overlay__ {
			#address-cells = <0x1>;
			#size-cells = <0x0>;
			clock-frequency = <0x61a80>;
			mediatek,use-open-drain;

			camera_main_two@10 {
				compatible = "mediatek,camera_main_two";
				phandle = <0x66>;
				reg = <0x10>;
				status = "okay";
			};

			camera_sub@2d {
				compatible = "mediatek,camera_sub";
				phandle = <0x67>;
				reg = <0x2d>;
				status = "okay";
			};

			camera_sub_eeprom@52 {
				compatible = "mediatek,camera_sub_eeprom";
				phandle = <0x68>;
				reg = <0x52>;
				status = "okay";
			};

			ccu_sensor_i2c_4_hw@12 {
				compatible = "mediatek,ccu_sensor_i2c_4_hw";
				phandle = <0x69>;
				reg = <0x12>;
				status = "okay";
			};
		};
	};

	fragment@26 {
		target = <0xffffffff>;

		__overlay__ {
			#address-cells = <0x1>;
			#size-cells = <0x0>;
			clock-frequency = <0x61a80>;
			mediatek,use-open-drain;

			subpmic_pmu@34 {
				compatible = "mediatek,subpmic_pmu";
				phandle = <0x6a>;
				reg = <0x34>;
				status = "okay";
			};

			usb_type_c@4e {
				compatible = "mediatek,usb_type_c";
				phandle = <0x6b>;
				reg = <0x4e>;
				status = "okay";
			};
		};
	};

	fragment@27 {
		target = <0xffffffff>;

		__overlay__ {
			#address-cells = <0x1>;
			#size-cells = <0x0>;
			clock-frequency = <0x61a80>;
			mediatek,use-open-drain;

			i2c_lcd_bias@3e {
				compatible = "mediatek,i2c_lcd_bias";
				phandle = <0x6c>;
				reg = <0x3e>;
				status = "okay";
			};

			strobe_main@63 {
				compatible = "mediatek,strobe_main";
				phandle = <0x6d>;
				reg = <0x63>;
				status = "okay";
			};
		};
	};

	fragment@28 {
		target = <0xffffffff>;

		__overlay__ {
			#address-cells = <0x1>;
			#size-cells = <0x0>;
			clock-frequency = <0x61a80>;
			mediatek,use-open-drain;

			camera_sub_two@16 {
				compatible = "mediatek,camera_sub_two";
				phandle = <0x6e>;
				reg = <0x16>;
				status = "okay";
			};

			slave_charger@4b {
				compatible = "mediatek,slave_charger";
				phandle = <0x6f>;
				reg = <0x4b>;
				status = "okay";
			};
		};
	};

	fragment@29 {
		target = <0xffffffff>;

		__overlay__ {
			#address-cells = <0x1>;
			#size-cells = <0x0>;
			clock-frequency = <0x61a80>;
			mediatek,use-open-drain;
		};
	};

	fragment@3 {
		target = <0xffffffff>;

		__overlay__ {

			fingerprint@0 {
				compatible = "sunwave-fp";
				reg = <0x0>;
				spi-max-frequency = <0x7a1200>;
				status = "okay";
			};
		};
	};

	fragment@30 {
		target = <0xffffffff>;

		__overlay__ {
			GPIO_SIM1_HOT_PLUG = <0xffffffff 0x2f 0x0>;
			GPIO_SIM1_SCLK = <0xffffffff 0xac 0x0>;
			GPIO_SIM1_SIO = <0xffffffff 0xae 0x0>;
			GPIO_SIM1_SRST = <0xffffffff 0xad 0x0>;
			GPIO_SIM2_SCLK = <0xffffffff 0x9d 0x0>;
			GPIO_SIM2_SIO = <0xffffffff 0x9b 0x0>;
			GPIO_SIM2_SRST = <0xffffffff 0x9c 0x0>;
		};
	};

	fragment@31 {
		target = <0xffffffff>;

		__overlay__ {
			gpio_init_default = <0x0 0x0 0x1 0x1 0x0 0x0 0x0 0x1 0x0 0x0 0x0 0x1 0x0 0x0 0x2 0x0 0x0 0x0 0x1 0x0 0x1 0x3 0x0 0x0 0x0 0x1 0x0 0x1 0x4 0x0 0x0 0x0 0x1 0x1 0x0 0x5 0x0 0x0 0x0 0x1 0x1 0x0 0x6 0x0 0x1 0x0 0x1 0x0 0x0 0x7 0x0 0x0 0x0 0x1 0x0 0x0 0x8 0x0 0x0 0x0 0x1 0x1 0x0 0x9 0x0 0x0 0x0 0x1 0x1 0x0 0xa 0x0 0x0 0x0 0x1 0x1 0x0 0xb 0x1 0x0 0x0 0x1 0x0 0x0 0xc 0x2 0x0 0x0 0x1 0x0 0x0 0xd 0x2 0x0 0x0 0x1 0x0 0x0 0xe 0x2 0x1 0x0 0x0 0x0 0x0 0xf 0x2 0x1 0x0 0x0 0x0 0x0 0x10 0x2 0x1 0x0 0x0 0x0 0x0 0x11 0x0 0x0 0x0 0x1 0x0 0x1 0x12 0x0 0x0 0x0 0x1 0x1 0x1 0x13 0x0 0x0 0x0 0x1 0x1 0x1 0x14 0x0 0x0 0x0 0x1 0x1 0x1 0x15 0x5 0x0 0x0 0x1 0x0 0x0 0x16 0x5 0x0 0x0 0x1 0x0 0x0 0x17 0x0 0x1 0x0 0x0 0x0 0x0 0x18 0x5 0x0 0x0 0x1 0x0 0x0 0x19 0x2 0x1 0x0 0x0 0x0 0x0 0x1a 0x2 0x0 0x0 0x1 0x0 0x0 0x1b 0x2 0x1 0x0 0x0 0x0 0x0 0x1c 0x2 0x1 0x0 0x0 0x0 0x0 0x1d 0x0 0x0 0x0 0x1 0x0 0x0 0x1e 0x0 0x0 0x0 0x1 0x0 0x0 0x1f 0x0 0x0 0x0 0x1 0x0 0x0 0x20 0x1 0x0 0x0 0x1 0x0 0x0 0x21 0x1 0x1 0x0 0x1 0x0 0x0 0x22 0x1 0x1 0x0 0x1 0x0 0x0 0x23 0x1 0x1 0x0 0x1 0x0 0x0 0x24 0x0 0x0 0x0 0x1 0x0 0x0 0x25 0x0 0x0 0x0 0x1 0x0 0x0 0x26 0x0 0x0 0x0 0x1 0x0 0x0 0x27 0x0 0x1 0x0 0x0 0x0 0x1 0x28 0x0 0x0 0x0 0x1 0x0 0x0 0x29 0x0 0x0 0x0 0x1 0x1 0x1 0x2a 0x0 0x1 0x0 0x0 0x0 0x1 0x2b 0x1 0x1 0x0 0x0 0x0 0x0 0x2c 0x1 0x0 0x0 0x1 0x0 0x0 0x2d 0x0 0x1 0x0 0x1 0x0 0x0 0x2e 0x0 0x0 0x0 0x1 0x0 0x0 0x2f 0x1 0x0 0x0 0x1 0x1 0x0 0x30 0x1 0x0 0x0 0x1 0x1 0x1 0x31 0x1 0x0 0x0 0x1 0x1 0x1 0x32 0x1 0x0 0x0 0x1 0x1 0x1 0x33 0x1 0x0 0x0 0x1 0x1 0x1 0x34 0x0 0x0 0x0 0x1 0x0 0x0 0x35 0x0 0x0 0x0 0x1 0x0 0x0 0x36 0x0 0x0 0x0 0x1 0x0 0x0 0x37 0x1 0x0 0x0 0x1 0x0 0x0 0x38 0x1 0x0 0x0 0x1 0x0 0x0 0x39 0x1 0x0 0x0 0x1 0x0 0x0 0x3a 0x0 0x0 0x0 0x1 0x0 0x0 0x3b 0x1 0x0 0x0 0x1 0x0 0x0 0x3c 0x1 0x0 0x0 0x1 0x0 0x0 0x3d 0x1 0x0 0x0 0x1 0x0 0x0 0x3e 0x1 0x0 0x0 0x1 0x0 0x0 0x3f 0x1 0x0 0x0 0x1 0x0 0x0 0x40 0x1 0x0 0x0 0x1 0x0 0x0 0x41 0x0 0x1 0x0 0x0 0x0 0x0 0x42 0x0 0x1 0x0 0x0 0x0 0x0 0x43 0x0 0x0 0x0 0x1 0x0 0x0 0x44 0x0 0x0 0x0 0x1 0x0 0x0 0x45 0x1 0x0 0x0 0x1 0x0 0x0 0x46 0x1 0x0 0x0 0x1 0x0 0x0 0x47 0x1 0x0 0x0 0x1 0x0 0x0 0x48 0x1 0x0 0x0 0x1 0x0 0x0 0x49 0x1 0x0 0x0 0x1 0x0 0x0 0x4a 0x1 0x0 0x0 0x1 0x0 0x0 0x4b 0x1 0x0 0x0 0x1 0x0 0x0 0x4c 0x1 0x0 0x0 0x1 0x0 0x0 0x4d 0x0 0x0 0x0 0x1 0x0 0x0 0x4e 0x0 0x0 0x0 0x1 0x0 0x0 0x4f 0x0 0x1 0x0 0x0 0x0 0x0 0x50 0x0 0x0 0x0 0x1 0x0 0x0 0x51 0x2 0x0 0x0 0x1 0x1 0x1 0x52 0x1 0x0 0x0 0x1 0x1 0x1 0x53 0x1 0x0 0x0 0x1 0x1 0x1 0x54 0x2 0x0 0x0 0x1 0x1 0x1 0x55 0x2 0x0 0x0 0x1 0x0 0x0 0x56 0x2 0x1 0x0 0x0 0x0 0x0 0x57 0x2 0x1 0x0 0x0 0x0 0x0 0x58 0x2 0x1 0x0 0x0 0x0 0x0 0x59 0x1 0x0 0x0 0x1 0x1 0x1 0x5a 0x1 0x0 0x0 0x1 0x1 0x1 0x5b 0x0 0x1 0x0 0x1 0x0 0x0 0x5c 0x1 0x1 0x0 0x0 0x0 0x0 0x5d 0x1 0x0 0x0 0x1 0x1 0x0 0x5e 0x1 0x0 0x0 0x1 0x1 0x0 0x5f 0x1 0x0 0x0 0x1 0x1 0x0 0x60 0x1 0x1 0x0 0x0 0x0 0x0 0x61 0x0 0x1 0x0 0x0 0x0 0x0 0x62 0x0 0x1 0x0 0x0 0x0 0x0 0x63 0x1 0x1 0x0 0x0 0x0 0x0 0x64 0x1 0x1 0x0 0x0 0x0 0x0 0x65 0x0 0x1 0x0 0x0 0x0 0x0 0x66 0x0 0x1 0x0 0x0 0x0 0x0 0x67 0x1 0x0 0x0 0x1 0x1 0x1 0x68 0x1 0x0 0x0 0x1 0x1 0x1 0x69 0x1 0x0 0x0 0x1 0x1 0x1 0x6a 0x1 0x0 0x0 0x1 0x1 0x1 0x6b 0x0 0x1 0x0 0x0 0x0 0x0 0x6c 0x1 0x1 0x0 0x0 0x0 0x0 0x6d 0x0 0x1 0x0 0x0 0x0 0x0 0x6e 0x0 0x1 0x0 0x0 0x0 0x0 0x6f 0x1 0x1 0x0 0x0 0x0 0x0 0x70 0x0 0x1 0x0 0x0 0x0 0x0 0x71 0x0 0x0 0x0 0x1 0x0 0x0 0x72 0x0 0x0 0x0 0x1 0x0 0x0 0x73 0x0 0x0 0x0 0x1 0x0 0x0 0x74 0x0 0x0 0x0 0x1 0x0 0x0 0x75 0x0 0x0 0x0 0x1 0x0 0x0 0x76 0x0 0x0 0x0 0x1 0x0 0x0 0x77 0x0 0x0 0x0 0x1 0x0 0x0 0x78 0x0 0x0 0x0 0x1 0x0 0x0 0x79 0x0 0x0 0x0 0x1 0x0 0x0 0x86 0x1 0x0 0x0 0x1 0x0 0x1 0x87 0x1 0x1 0x0 0x0 0x0 0x0 0x88 0x1 0x1 0x0 0x0 0x0 0x0 0x89 0x1 0x1 0x0 0x0 0x0 0x0 0x8a 0x1 0x1 0x0 0x0 0x0 0x0 0x8b 0x1 0x1 0x0 0x0 0x0 0x0 0x8c 0x1 0x0 0x0 0x1 0x0 0x0 0x8d 0x1 0x0 0x0 0x1 0x0 0x0 0x8e 0x1 0x0 0x0 0x1 0x0 0x0 0x8f 0x1 0x0 0x0 0x1 0x0 0x0 0x90 0x1 0x0 0x0 0x1 0x0 0x0 0x91 0x1 0x1 0x0 0x0 0x0 0x0 0x92 0x1 0x1 0x0 0x0 0x0 0x0 0x93 0x1 0x1 0x0 0x0 0x0 0x0 0x94 0x1 0x1 0x0 0x0 0x0 0x0 0x95 0x1 0x1 0x0 0x0 0x0 0x0 0x96 0x4 0x0 0x0 0x1 0x1 0x0 0x97 0x4 0x1 0x0 0x0 0x0 0x0 0x98 0x0 0x1 0x0 0x1 0x0 0x0 0x99 0x0 0x1 0x0 0x1 0x0 0x0 0x9a 0x1 0x1 0x0 0x0 0x0 0x0 0x9b 0x1 0x0 0x0 0x1 0x1 0x0 0x9c 0x1 0x1 0x0 0x0 0x0 0x0 0x9d 0x1 0x1 0x0 0x0 0x0 0x0 0x9e 0x1 0x1 0x0 0x0 0x0 0x0 0x9f 0x0 0x1 0x0 0x0 0x0 0x0 0xa0 0x0 0x1 0x0 0x0 0x0 0x0 0xa1 0x1 0x0 0x0 0x1 0x1 0x1 0xa2 0x1 0x0 0x0 0x1 0x1 0x1 0xa3 0x1 0x0 0x0 0x1 0x1 0x1 0xa4 0x1 0x0 0x0 0x1 0x1 0x1 0xa5 0x0 0x1 0x0 0x0 0x0 0x0 0xa6 0x0 0x1 0x0 0x0 0x0 0x0 0xa7 0x1 0x0 0x0 0x1 0x0 0x0 0xa8 0x1 0x0 0x0 0x1 0x0 0x0 0xa9 0x0 0x1 0x0 0x0 0x0 0x0 0xaa 0x1 0x0 0x0 0x1 0x1 0x1 0xab 0x1 0x1 0x0 0x0 0x0 0x1 0xac 0x1 0x1 0x0 0x0 0x0 0x0 0xad 0x1 0x1 0x0 0x0 0x0 0x0 0xae 0x1 0x0 0x0 0x1 0x1 0x0 0xaf 0x1 0x0 0x0 0x1 0x1 0x1 0xb0 0x1 0x0 0x0 0x1 0x1 0x1 0xb2 0x0 0x1 0x0 0x0 0x0 0x0 0xb3 0x0 0x1 0x0 0x0 0x0 0x0 0xb4 0x0 0x0 0x0 0x1 0x0 0x0 0xb5 0x0 0x0 0x0 0x1 0x0 0x0 0xb6 0x0 0x0 0x0 0x1 0x0 0x0 0xb7 0x0 0x0 0x0 0x1 0x0 0x0 0xb8 0x0 0x0 0x0 0x1 0x0 0x0 0xb9 0x0 0x0 0x0 0x1 0x0 0x0 0xba 0x0 0x0 0x0 0x1 0x0 0x0>;
		};
	};

	fragment@32 {
		target = <0xffffffff>;

		__overlay__ {
			interrupt-parent = <0xffffffff>;
			interrupts = <0x1 0x2 0x1 0x0>;
			status = "okay";
		};
	};

	fragment@33 {
		target = <0xffffffff>;

		__overlay__ {
			deb-gpios = <0xffffffff 0x29 0x0>;
			debounce = <0xfa00>;
			interrupt-parent = <0xffffffff>;
			interrupts = <0x29 0x8 0x29 0x0>;
			status = "okay";
		};
	};

	fragment@34 {
		target = <0xffffffff>;

		__overlay__ {
			interrupt-parent = <0xffffffff>;
			interrupts = <0x2c 0x1 0x2c 0x1>;
			status = "okay";
		};
	};

	fragment@35 {
		target = <0xffffffff>;

		__overlay__ {
			interrupt-parent = <0xffffffff>;
			interrupts = <0x90 0x4 0xb4 0x0>;
			status = "okay";
		};
	};

	fragment@36 {
		target = <0xffffffff>;

		__overlay__ {
			compatible = "mediatek,md1_sim1_hot_plug_eint-eint";
			debounce = <0x0 0x2710>;
			dedicated = <0x0 0x0>;
			interrupts = <0x0 0x8>;
			sockettype = <0x0 0x0>;
			src_pin = <0x0 0x1>;
			status = "okay";
		};
	};

	fragment@37 {
		target = <0xffffffff>;

		__overlay__ {
			regulator-default-on = <0x1>;
			regulator-name = "vcama1";
			status = "okay";
		};
	};

	fragment@38 {
		target = <0xffffffff>;

		__overlay__ {
			regulator-default-on = <0x1>;
			regulator-name = "vcama2";
			status = "okay";
		};
	};

	fragment@39 {
		target = <0xffffffff>;

		__overlay__ {
			regulator-default-on = <0x1>;
			regulator-name = "vsim1";
			status = "okay";
		};
	};

	fragment@4 {
		target = <0xffffffff>;

		__overlay__ {

			fingerprint_default {
				phandle = <0x1>;
			};

			gpio7_eint {
				phandle = <0x2>;

				pins_cmd_dat {
					bias-disable;
					pinmux = <0x700>;
					slew-rate = <0x0>;
				};
			};

			gpio7_eint_pull_down {
				phandle = <0x3>;

				pins_cmd_dat {
					bias-pull-down = <0x0>;
					output-low;
					pinmux = <0x700>;
					slew-rate = <0x0>;
				};
			};

			rst_out_one {
				phandle = <0x4>;

				pins_cmd_dat {
					bias-disable;
					output-high;
					pinmux = <0x600>;
					slew-rate = <0x1>;
				};
			};

			rst_out_zero {
				phandle = <0x5>;

				pins_cmd_dat {
					bias-disable;
					output-low;
					pinmux = <0x600>;
					slew-rate = <0x1>;
				};
			};
		};
	};

	fragment@40 {
		target = <0xffffffff>;

		__overlay__ {
			regulator-default-on = <0x1>;
			regulator-name = "vsim2";
			status = "okay";
		};
	};

	fragment@41 {
		target = <0xffffffff>;

		__overlay__ {
			regulator-default-on = <0x1>;
			regulator-name = "vcamd";
			status = "okay";
		};
	};

	fragment@42 {
		target = <0xffffffff>;

		__overlay__ {
			regulator-default-on = <0x1>;
			regulator-name = "vcamio";
			status = "okay";
		};
	};

	fragment@43 {
		target = <0xffffffff>;

		__overlay__ {
			regulator-default-on = <0x1>;
			regulator-name = "vldo28";
			status = "okay";
		};
	};

	fragment@44 {
		target = <0xffffffff>;

		__overlay__ {
			status = "okay";
			vcama_main2-supply = <0xffffffff>;
			vcama_main3-supply = <0xffffffff>;
			vcama_sub2-supply = <0xffffffff>;
			vcamaf-supply = <0xffffffff>;
			vcamd_main2-supply = <0xffffffff>;
			vcamd_sub-supply = <0xffffffff>;
			vcamd_sub2-supply = <0xffffffff>;
			vcamio-supply = <0xffffffff>;
			vcamio_main2-supply = <0xffffffff>;
			vcamio_sub-supply = <0xffffffff>;
			vcamio_sub2-supply = <0xffffffff>;
		};
	};

	fragment@45 {
		target = <0xffffffff>;

		__overlay__ {
			status = "okay";
			vtouch-supply = <0xffffffff>;
		};
	};

	fragment@46 {
		target = <0xffffffff>;

		__overlay__ {
			mediatek,kpd-hw-dl-key0 = <0x0>;
			mediatek,kpd-hw-dl-key1 = <0x1>;
			mediatek,kpd-hw-dl-key2 = <0x8>;
			mediatek,kpd-hw-factory-key = <0x1>;
			mediatek,kpd-hw-init-map = <0x73 0x72 0x0 0x0 0x0 0x0 0x0 0x0 0x0 0x0 0x0 0x0 0x0 0x0 0x0 0x0 0x0 0x0 0x0 0x0 0x0 0x0 0x0 0x0 0x0 0x0 0x0 0x0 0x0 0x0 0x0 0x0 0x0 0x0 0x0 0x0 0x0 0x0 0x0 0x0 0x0 0x0 0x0 0x0 0x0 0x0 0x0 0x0 0x0 0x0 0x0 0x0 0x0 0x0 0x0 0x0 0x0 0x0 0x0 0x0 0x0 0x0 0x0 0x0 0x0 0x0 0x0 0x0 0x0 0x0 0x0 0x0>;
			mediatek,kpd-hw-map-num = <0x48>;
			mediatek,kpd-hw-pwrkey = <0x8>;
			mediatek,kpd-hw-recovery-key = <0x0>;
			mediatek,kpd-key-debounce = <0x400>;
			mediatek,kpd-pwkey-gpio-din = <0x0>;
			mediatek,kpd-pwrkey-eint-gpio = <0x0>;
			mediatek,kpd-sw-pwrkey = <0x74>;
			mediatek,kpd-use-extend-type = <0x0>;
			status = "okay";
		};
	};

	fragment@47 {
		target = <0xffffffff>;

		__overlay__ {

			camdefault {
				phandle = <0x19>;
			};

			camera0_mclk_2mA@gpio100 {
				phandle = <0x31>;

				pins_cmd_dat {
					drive-strength = <0x2>;
					pinmux = <0x6401>;
				};
			};

			camera0_mclk_4mA@gpio100 {
				phandle = <0x32>;

				pins_cmd_dat {
					drive-strength = <0x4>;
					pinmux = <0x6401>;
				};
			};

			camera0_mclk_6mA@gpio100 {
				phandle = <0x33>;

				pins_cmd_dat {
					drive-strength = <0x6>;
					pinmux = <0x6401>;
				};
			};

			camera0_mclk_8mA@gpio100 {
				phandle = <0x34>;

				pins_cmd_dat {
					drive-strength = <0x7>;
					pinmux = <0x6401>;
				};
			};

			camera0_mclk_gpio_mode@gpio100 {
				phandle = <0x30>;

				pins_cmd_dat {
					drive-strength = <0x4>;
					pinmux = <0x6400>;
				};
			};

			camera0_rst_output_high@gpio102 {
				phandle = <0x1b>;

				pins_cmd_dat {
					output-high;
					pinmux = <0x6600>;
				};
			};

			camera0_rst_output_low@gpio102 {
				phandle = <0x1a>;

				pins_cmd_dat {
					output-low;
					pinmux = <0x6600>;
				};
			};

			camera0_vcama_output_high@gpio23 {
				phandle = <0x2a>;

				pins_cmd_dat {
					output-high;
					pinmux = <0x1700>;
				};
			};

			camera0_vcama_output_low@gpio23 {
				phandle = <0x2b>;

				pins_cmd_dat {
					output-low;
					pinmux = <0x1700>;
				};
			};

			camera0_vcamd_output_high@gpio79 {
				phandle = <0x2c>;

				pins_cmd_dat {
					output-high;
					pinmux = <0x4f00>;
				};
			};

			camera0_vcamd_output_low@gpio79 {
				phandle = <0x2d>;

				pins_cmd_dat {
					output-low;
					pinmux = <0x4f00>;
				};
			};

			camera1_mclk_2mA@gpio99 {
				phandle = <0x36>;

				pins_cmd_dat {
					drive-strength = <0x2>;
					pinmux = <0x6301>;
				};
			};

			camera1_mclk_4mA@gpio99 {
				phandle = <0x37>;

				pins_cmd_dat {
					drive-strength = <0x4>;
					pinmux = <0x6301>;
				};
			};

			camera1_mclk_6mA@gpio99 {
				phandle = <0x38>;

				pins_cmd_dat {
					drive-strength = <0x6>;
					pinmux = <0x6301>;
				};
			};

			camera1_mclk_8mA@gpio99 {
				phandle = <0x39>;

				pins_cmd_dat {
					drive-strength = <0x7>;
					pinmux = <0x6301>;
				};
			};

			camera1_mclk_gpio_mode@gpio99 {
				phandle = <0x35>;

				pins_cmd_dat {
					drive-strength = <0x4>;
					pinmux = <0x6300>;
				};
			};

			camera1_pdn_output_high@gpio97 {
				phandle = <0x1f>;

				pins_cmd_dat {
					output-high;
					pinmux = <0x6100>;
				};
			};

			camera1_pdn_output_low@gpio97 {
				phandle = <0x1e>;

				pins_cmd_dat {
					output-low;
					pinmux = <0x6100>;
					slew-rate = <0x1>;
				};
			};

			camera1_rst_output_high@gpio101 {
				phandle = <0x1d>;

				pins_cmd_dat {
					output-high;
					pinmux = <0x6500>;
				};
			};

			camera1_rst_output_low@gpio101 {
				phandle = <0x1c>;

				pins_cmd_dat {
					output-low;
					pinmux = <0x6500>;
				};
			};

			camera1_vcama_output_high@gpio23 {
				phandle = <0x2e>;

				pins_cmd_dat {
					output-high;
					pinmux = <0x1700>;
				};
			};

			camera1_vcama_output_low@gpio23 {
				phandle = <0x2f>;

				pins_cmd_dat {
					output-low;
					pinmux = <0x1700>;
				};
			};

			camera2_mclk_2mA@gpio108 {
				phandle = <0x3b>;

				pins_cmd_dat {
					drive-strength = <0x2>;
					pinmux = <0x6c01>;
				};
			};

			camera2_mclk_4mA@gpio108 {
				phandle = <0x3c>;

				pins_cmd_dat {
					drive-strength = <0x4>;
					pinmux = <0x6c01>;
				};
			};

			camera2_mclk_6mA@gpio108 {
				phandle = <0x3d>;

				pins_cmd_dat {
					drive-strength = <0x6>;
					pinmux = <0x6c01>;
				};
			};

			camera2_mclk_8mA@gpio108 {
				phandle = <0x3e>;

				pins_cmd_dat {
					drive-strength = <0x7>;
					pinmux = <0x6c01>;
				};
			};

			camera2_mclk_gpio_mode@gpio108 {
				phandle = <0x3a>;

				pins_cmd_dat {
					drive-strength = <0x4>;
					pinmux = <0x6c00>;
				};
			};

			camera2_pdn_output_high@gpio107 {
				phandle = <0x23>;

				pins_cmd_dat {
					output-high;
					pinmux = <0x6b00>;
				};
			};

			camera2_pdn_output_low@gpio107 {
				phandle = <0x22>;

				pins_cmd_dat {
					output-low;
					pinmux = <0x6b00>;
				};
			};

			camera2_rst_output_high@gpio109 {
				phandle = <0x21>;

				pins_cmd_dat {
					output-high;
					pinmux = <0x6d00>;
				};
			};

			camera2_rst_output_low@gpio109 {
				phandle = <0x20>;

				pins_cmd_dat {
					output-low;
					pinmux = <0x6d00>;
				};
			};

			camera3_mclk_2mA@gpio111 {
				phandle = <0x40>;

				pins_cmd_dat {
					drive-strength = <0x2>;
					pinmux = <0x6f01>;
				};
			};

			camera3_mclk_4mA@gpio111 {
				phandle = <0x41>;

				pins_cmd_dat {
					drive-strength = <0x4>;
					pinmux = <0x6f01>;
				};
			};

			camera3_mclk_6mA@gpio111 {
				phandle = <0x42>;

				pins_cmd_dat {
					drive-strength = <0x6>;
					pinmux = <0x6f01>;
				};
			};

			camera3_mclk_8mA@gpio111 {
				phandle = <0x43>;

				pins_cmd_dat {
					drive-strength = <0x7>;
					pinmux = <0x6f01>;
				};
			};

			camera3_mclk_gpio_mode@gpio111 {
				phandle = <0x3f>;

				pins_cmd_dat {
					drive-strength = <0x4>;
					pinmux = <0x6f00>;
				};
			};

			camera3_pdn_output_high@gpio110 {
				phandle = <0x27>;

				pins_cmd_dat {
					output-high;
					pinmux = <0x6e00>;
				};
			};

			camera3_pdn_output_low@gpio110 {
				phandle = <0x26>;

				pins_cmd_dat {
					output-low;
					pinmux = <0x6e00>;
				};
			};

			camera3_rst_output_high@gpio112 {
				phandle = <0x25>;

				pins_cmd_dat {
					output-high;
					pinmux = <0x7000>;
				};
			};

			camera3_rst_output_low@gpio112 {
				phandle = <0x24>;

				pins_cmd_dat {
					output-low;
					pinmux = <0x7000>;
				};
			};

			camera4_mclk_2mA@gpio108 {
				phandle = <0x45>;

				pins_cmd_dat {
					drive-strength = <0x2>;
					pinmux = <0x6c01>;
				};
			};

			camera4_mclk_4mA@gpio108 {
				phandle = <0x46>;

				pins_cmd_dat {
					drive-strength = <0x4>;
					pinmux = <0x6c01>;
				};
			};

			camera4_mclk_6mA@gpio108 {
				phandle = <0x47>;

				pins_cmd_dat {
					drive-strength = <0x6>;
					pinmux = <0x6c01>;
				};
			};

			camera4_mclk_8mA@gpio108 {
				phandle = <0x48>;

				pins_cmd_dat {
					drive-strength = <0x7>;
					pinmux = <0x6c01>;
				};
			};

			camera4_mclk_gpio_mode@gpio108 {
				phandle = <0x44>;

				pins_cmd_dat {
					drive-strength = <0x4>;
					pinmux = <0x6c00>;
				};
			};

			camera4_pdn_output_high@gpio159 {
				phandle = <0x29>;

				pins_cmd_dat {
					output-high;
					pinmux = <0x9f00>;
				};
			};

			camera4_pdn_output_low@gpio159 {
				phandle = <0x28>;

				pins_cmd_dat {
					output-low;
					pinmux = <0x9f00>;
				};
			};

			camera_mipi_switch_en_high@gpio65 {
				phandle = <0x4a>;

				pins_cmd_dat {
					output-high;
					pinmux = <0x4100>;
				};
			};

			camera_mipi_switch_en_low@gpio65 {
				phandle = <0x49>;

				pins_cmd_dat {
					output-low;
					pinmux = <0x4100>;
				};
			};

			camera_mipi_switch_sel_high@gpio66 {
				phandle = <0x4c>;

				pins_cmd_dat {
					output-high;
					pinmux = <0x4200>;
				};
			};

			camera_mipi_switch_sel_low@gpio66 {
				phandle = <0x4b>;

				pins_cmd_dat {
					output-low;
					pinmux = <0x4200>;
				};
			};
		};
	};

	fragment@48 {
		target = <0xffffffff>;

		__overlay__ {
			cam0_vcamio-supply = <0xffffffff>;
			cam1_vcamd-supply = <0xffffffff>;
			cam1_vcamio-supply = <0xffffffff>;
			cam2_vcama-supply = <0xffffffff>;
			cam2_vcamd-supply = <0xffffffff>;
			cam2_vcamio-supply = <0xffffffff>;
			cam3_vcama-supply = <0xffffffff>;
			cam3_vcamd-supply = <0xffffffff>;
			cam3_vcamio-supply = <0xffffffff>;
			cam4_vcama-supply = <0xffffffff>;
			cam4_vcamio-supply = <0xffffffff>;
			pinctrl-0 = <0x19>;
			pinctrl-1 = <0x1a>;
			pinctrl-10 = <0x23>;
			pinctrl-11 = <0x24>;
			pinctrl-12 = <0x25>;
			pinctrl-13 = <0x26>;
			pinctrl-14 = <0x27>;
			pinctrl-15 = <0x28>;
			pinctrl-16 = <0x29>;
			pinctrl-17 = <0x2a>;
			pinctrl-18 = <0x2b>;
			pinctrl-19 = <0x2c>;
			pinctrl-2 = <0x1b>;
			pinctrl-20 = <0x2d>;
			pinctrl-21 = <0x2e>;
			pinctrl-22 = <0x2f>;
			pinctrl-23 = <0x30>;
			pinctrl-24 = <0x31>;
			pinctrl-25 = <0x32>;
			pinctrl-26 = <0x33>;
			pinctrl-27 = <0x34>;
			pinctrl-28 = <0x35>;
			pinctrl-29 = <0x36>;
			pinctrl-3 = <0x1c>;
			pinctrl-30 = <0x37>;
			pinctrl-31 = <0x38>;
			pinctrl-32 = <0x39>;
			pinctrl-33 = <0x3a>;
			pinctrl-34 = <0x3b>;
			pinctrl-35 = <0x3c>;
			pinctrl-36 = <0x3d>;
			pinctrl-37 = <0x3e>;
			pinctrl-38 = <0x3f>;
			pinctrl-39 = <0x40>;
			pinctrl-4 = <0x1d>;
			pinctrl-40 = <0x41>;
			pinctrl-41 = <0x42>;
			pinctrl-42 = <0x43>;
			pinctrl-43 = <0x44>;
			pinctrl-44 = <0x45>;
			pinctrl-45 = <0x46>;
			pinctrl-46 = <0x47>;
			pinctrl-47 = <0x48>;
			pinctrl-48 = <0x49>;
			pinctrl-49 = <0x4a>;
			pinctrl-5 = <0x1e>;
			pinctrl-50 = <0x4b>;
			pinctrl-51 = <0x4c>;
			pinctrl-6 = <0x1f>;
			pinctrl-7 = <0x20>;
			pinctrl-8 = <0x21>;
			pinctrl-9 = <0x22>;
			pinctrl-names = "default", "cam0_rst0", "cam0_rst1", "cam1_rst0", "cam1_rst1", "cam1_pnd0", "cam1_pnd1", "cam2_rst0", "cam2_rst1", "cam2_pnd0", "cam2_pnd1", "cam3_rst0", "cam3_rst1", "cam3_pnd0", "cam3_pnd1", "cam4_pnd0", "cam4_pnd1", "cam0_vcama_on", "cam0_vcama_off", "cam0_vcamd_on", "cam0_vcamd_off", "cam1_vcama_on", "cam1_vcama_off", "cam0_mclk_off", "cam0_mclk_2mA", "cam0_mclk_4mA", "cam0_mclk_6mA", "cam0_mclk_8mA", "cam1_mclk_off", "cam1_mclk_2mA", "cam1_mclk_4mA", "cam1_mclk_6mA", "cam1_mclk_8mA", "cam2_mclk_off", "cam2_mclk_2mA", "cam2_mclk_4mA", "cam2_mclk_6mA", "cam2_mclk_8mA", "cam3_mclk_off", "cam3_mclk_2mA", "cam3_mclk_4mA", "cam3_mclk_6mA", "cam3_mclk_8mA", "cam4_mclk_off", "cam4_mclk_2mA", "cam4_mclk_4mA", "cam4_mclk_6mA", "cam4_mclk_8mA", "cam_mipi_switch_en_0", "cam_mipi_switch_en_1", "cam_mipi_switch_sel_0", "cam_mipi_switch_sel_1";
			status = "okay";
		};
	};

	fragment@49 {
		target = <0xffffffff>;

		__overlay__ {

			aw36515default {
				phandle = <0x4d>;
			};

			aw36515hwen_high {
				phandle = <0x4e>;

				pins_cmd_dat {
					output-high;
					pinmux = <0xa900>;
					slew-rate = <0x1>;
				};
			};

			aw36515hwen_low {
				phandle = <0x4f>;

				pins_cmd_dat {
					output-low;
					pinmux = <0xa900>;
					slew-rate = <0x1>;
				};
			};
		};
	};

	fragment@5 {
		target = <0xffffffff>;

		__overlay__ {

			touch@0 {
				compatible = "novatek,NVT-ts-spi", "focaltech,fts";
				novatek,mp-support-dt;
				novatek,spi-rd-fast-addr = <0x3f310>;
				novatek,swrst-n8-addr = <0x3f0fe>;
				phandle = <0x5d>;
				reg = <0x0>;
				spi-max-frequency = <0xcf8500>;
				status = "ok";

				novatek-mp-criteria-6232@0 {
					#address-cells = <0x1>;
					#size-cells = <0x0>;
					AIN_KEY = <0x0 0x1 0x2 0xff>;
					AIN_X = <0x0 0x1 0x2 0x3 0x4 0x5 0x6 0x7 0x8 0x9 0xa 0xb 0xc 0xd 0xe 0xf 0x10 0x11>;
					AIN_Y = <0x0 0x1 0x2 0x3 0x4 0x5 0x6 0x7 0x8 0x9 0xa 0xb 0xc 0xd 0xe 0xf 0x10 0x11 0x12 0x13 0x14 0x15 0x16 0x17 0x18 0x19 0x1a 0x1b 0x1c 0x1d 0x1e 0x1f>;
					IC_KEY_CFG_SIZE = <0x4>;
					IC_X_CFG_SIZE = <0x12>;
					IC_Y_CFG_SIZE = <0x20>;
					PS_Config_Diff_Test_Frame = <0x32>;
					PS_Config_Lmt_FW_CC_N = <0x2a 0xffff0001 0x2a 0x2b 0x2b 0x2b 0x2b 0x2b 0x2c 0x2f 0x2d 0x2c 0x2c 0x2c 0x2c 0x2c 0x2c 0x2c 0x2c 0x2a 0x2a 0x2a 0x2a 0x2b 0x2b 0x2b 0x2d 0x2c 0x2c 0x2c 0x2c 0x2c 0x2c 0x2c 0x2c 0x2d 0x2c 0x2b 0x2b 0x2b 0x2b 0x2b 0x2b 0x2b 0x2c 0x2e 0x2d 0x2d 0x2d 0x2d 0x2d 0x2d 0x2d 0x2d 0x2c 0x2c 0x2c 0x2c 0x2c 0x2c 0x2c 0x2c 0x2d 0x2d 0x2c 0x2c 0x2c 0x2c 0x2c 0x2c 0x2c 0x2d 0x2c 0x2c 0x2c 0x2c 0x2c 0x2c 0x2c 0x2c 0x2d 0x2f 0x2d 0x2d 0x2d 0x2d 0x2d 0x2d 0x2d 0x2e 0x2c 0x2c 0x2c 0x2c 0x2c 0x2c 0x2c 0x2c 0x2d 0x2d 0x2c 0x2c 0x2c 0x2c 0x2c 0x2c 0x2c 0x2d 0x2c 0x2c 0x2b 0x2c 0x2c 0x2c 0x2c 0x2c 0x2c 0x2f 0x2d 0x2d 0x2d 0x2d 0x2d 0x2d 0x2d 0x2e 0x2c 0x2c 0x2c 0x2c 0x2c 0x2c 0x2c 0x2c 0x2d 0x2d 0x2c 0x2c 0x2c 0x2c 0x2c 0x2c 0x2c 0x2d 0x2c 0x2c 0x2c 0x2c 0x2c 0x2c 0x2c 0x2c 0x2d 0x2f 0x2d 0x2d 0x2d 0x2d 0x2d 0x2d 0x2d 0x2f 0x2d 0x2d 0x2c 0x2d 0x2d 0x2d 0x2d 0x2d 0x2e 0x2e 0x2d 0x2d 0x2d 0x2d 0x2d 0x2d 0x2d 0x2d 0x2c 0x2c 0x2c 0x2c 0x2c 0x2c 0x2c 0x2c 0x2d 0x2f 0x2e 0x2e 0x2e 0x2d 0x2d 0x2d 0x2d 0x2f 0x2d 0x2d 0x2c 0x2d 0x2c 0x2c 0x2c 0x2c 0x2d 0x2e 0x2d 0x2d 0x2d 0x2d 0x2d 0x2d 0x2d 0x2d 0x2e 0x2e 0x2e 0x2e 0x2e 0x2e 0x2e 0x2e 0x2f 0x31 0x2f 0x2f 0x2f 0x2f 0x2f 0x2f 0x2f 0x30 0x2d 0x2d 0x2d 0x2d 0x2d 0x2d 0x2d 0x2d 0x2e 0x2f 0x2e 0x2e 0x2e 0x2e 0x2e 0x2d 0x2e 0x2f 0x2f 0x2f 0x2e 0x2f 0x2e 0x2e 0x2e 0x2e 0x2f 0x31 0x30 0x30 0x30 0x2f 0x2f 0x2f 0x2f 0x30 0x2d 0x2d 0x2d 0x2d 0x2d 0x2d 0x2d 0x2d 0x2e 0x30 0x2f 0x2f 0x2f 0x2e 0x2e 0x2e 0x2e 0x2f 0x2f 0x2f 0x2f 0x2f 0x2f 0x2e 0x2e 0x2f 0x2f 0x31 0x30 0x30 0x30 0x30 0x30 0x2f 0x2f 0x30 0x2e 0x2e 0x2d 0x2d 0x2d 0x2d 0x2d 0x2d 0x2f 0x30 0x2f 0x2f 0x2f 0x2f 0x2f 0x2e 0x2e 0x2f 0x2f 0x2f 0x2f 0x2f 0x2f 0x2f 0x2f 0x2f 0x30 0x31 0x30 0x30 0x30 0x30 0x2f 0x2f 0x2f 0x30 0x2d 0x2d 0x2d 0x2d 0x2d 0x2d 0x2d 0x2d 0x2f 0x30 0x2f 0x2f 0x2f 0x2e 0x2e 0x2e 0x2e 0x2f 0x2f 0x2f 0x2f 0x2f 0x2f 0x2f 0x2f 0x2f 0x30 0x32 0x30 0x30 0x30 0x30 0x30 0x30 0x30 0x30 0x2e 0x2e 0x2e 0x2e 0x2d 0x2d 0x2d 0x2d 0x2f 0x30 0x2f 0x2f 0x2f 0x2f 0x2f 0x2e 0x2e 0x2f 0x2f 0x2f 0x2f 0x2f 0x2e 0x2e 0x2e 0x2e 0x2f 0x31 0x30 0x30 0x30 0x30 0x2f 0x2f 0x2f 0x30 0x2e 0x2e 0x2d 0x2d 0x2d 0x2d 0x2d 0x2d 0x2e 0x30 0x2f 0x2f 0x2f 0x2f 0x2f 0x2e 0x2f 0x2f 0x2f 0x2f 0x2f 0x2f 0x2f 0x2f 0x2e 0x2e 0x2f 0x30 0x2f 0x2f 0x30 0x30 0x2f 0x2f 0x30 0x30 0x2e 0x2e 0x2d 0x2d 0x2d 0x2d 0x2d 0x2d 0x2e 0x2f 0x2d 0x2d 0x2e 0x2d 0x2d 0x2d 0x2e 0x2f 0x2f 0x2f 0x2f 0x2f 0x2f 0x2e 0x2e 0x2e 0x2f 0x30 0x2f 0x2f 0x2f 0x2f 0x2f 0x2f 0x30 0x30 0x2e 0x2e 0x2e 0x2d 0x2d 0x2d 0x2d 0x2d 0x2e 0x2f 0x2e 0x2e 0x2e 0x2e 0x2e 0x2e 0x2e 0x2f 0x2d 0x2d 0x2d 0x2d 0x2d 0x2d 0x2c 0x2c 0x2d 0x30 0x2f 0x2f 0x2f 0x2f 0x2f 0x2f 0x30 0x30 0x2e 0x2e 0x2e 0x2e 0x2d 0x2d 0x2d 0x2d 0x2e 0x2f 0x2d 0x2d 0x2d 0x2d 0x2d 0x2d 0x2e 0x2f 0x2d 0x2e 0x2d 0x2d 0x2d 0x2d 0x2d 0x2c 0x2d 0x30 0x2f 0x2f 0x2f 0x2f 0x2f 0x2f 0x30 0x30 0x2f 0x2f 0x2f 0x2f 0x2e 0x2e 0x2d 0x2d 0x2f 0x2f 0x2d 0x2e 0x2e 0x2e 0x2e 0x2e 0x2f 0x2f 0x0 0x0 0x0>;
					PS_Config_Lmt_FW_CC_P = <0x5d 0xffff 0x5f 0x60 0x60 0x60 0x60 0x60 0x61 0x68 0x64 0x63 0x63 0x63 0x61 0x61 0x61 0x61 0x63 0x5f 0x5d 0x5f 0x5f 0x60 0x60 0x60 0x64 0x63 0x61 0x61 0x61 0x61 0x61 0x61 0x63 0x64 0x61 0x60 0x60 0x60 0x60 0x60 0x60 0x60 0x63 0x67 0x66 0x64 0x64 0x64 0x64 0x64 0x66 0x66 0x63 0x61 0x61 0x61 0x61 0x61 0x61 0x61 0x64 0x64 0x63 0x63 0x61 0x61 0x61 0x63 0x63 0x64 0x61 0x61 0x61 0x61 0x61 0x61 0x61 0x61 0x64 0x68 0x66 0x66 0x66 0x64 0x64 0x66 0x66 0x67 0x63 0x63 0x61 0x63 0x63 0x63 0x63 0x63 0x64 0x66 0x63 0x63 0x63 0x63 0x63 0x63 0x63 0x64 0x61 0x61 0x60 0x61 0x61 0x61 0x61 0x61 0x63 0x68 0x66 0x66 0x66 0x66 0x66 0x66 0x66 0x67 0x63 0x63 0x63 0x63 0x63 0x63 0x63 0x63 0x66 0x66 0x63 0x63 0x63 0x63 0x63 0x63 0x63 0x64 0x61 0x61 0x61 0x61 0x61 0x61 0x61 0x61 0x64 0x68 0x66 0x66 0x66 0x66 0x66 0x66 0x66 0x68 0x64 0x64 0x63 0x64 0x64 0x64 0x64 0x64 0x67 0x67 0x66 0x66 0x64 0x64 0x64 0x64 0x64 0x66 0x63 0x63 0x63 0x63 0x63 0x63 0x63 0x63 0x66 0x6a 0x67 0x67 0x67 0x66 0x66 0x66 0x66 0x68 0x64 0x64 0x63 0x64 0x63 0x63 0x63 0x63 0x66 0x67 0x64 0x64 0x64 0x64 0x64 0x64 0x64 0x66 0x67 0x67 0x67 0x67 0x67 0x67 0x67 0x67 0x6a 0x6e 0x6a 0x6a 0x6a 0x6a 0x6a 0x6a 0x6a 0x6b 0x66 0x64 0x64 0x64 0x64 0x64 0x64 0x64 0x67 0x6a 0x67 0x67 0x67 0x67 0x67 0x66 0x67 0x68 0x68 0x68 0x67 0x68 0x67 0x67 0x67 0x67 0x6a 0x6e 0x6b 0x6b 0x6b 0x6a 0x6a 0x6a 0x6a 0x6b 0x66 0x66 0x64 0x64 0x64 0x64 0x64 0x64 0x67 0x6b 0x68 0x68 0x68 0x67 0x67 0x67 0x67 0x68 0x68 0x68 0x68 0x68 0x68 0x67 0x67 0x68 0x6a 0x6e 0x6b 0x6b 0x6b 0x6b 0x6b 0x6a 0x6a 0x6d 0x67 0x67 0x66 0x66 0x66 0x66 0x66 0x66 0x68 0x6b 0x68 0x68 0x68 0x68 0x68 0x67 0x67 0x6a 0x68 0x68 0x68 0x68 0x68 0x68 0x68 0x68 0x6b 0x6e 0x6b 0x6b 0x6b 0x6b 0x6a 0x6a 0x6a 0x6d 0x66 0x66 0x66 0x66 0x66 0x66 0x66 0x66 0x68 0x6b 0x68 0x68 0x68 0x67 0x67 0x67 0x67 0x68 0x6a 0x68 0x68 0x68 0x68 0x68 0x68 0x68 0x6b 0x6f 0x6d 0x6d 0x6d 0x6b 0x6b 0x6b 0x6b 0x6d 0x67 0x67 0x67 0x67 0x66 0x66 0x66 0x66 0x68 0x6b 0x68 0x68 0x68 0x68 0x68 0x67 0x67 0x6a 0x6a 0x68 0x68 0x68 0x67 0x67 0x67 0x67 0x6a 0x6e 0x6b 0x6b 0x6b 0x6b 0x6a 0x6a 0x6a 0x6d 0x67 0x67 0x66 0x66 0x66 0x66 0x66 0x66 0x67 0x6b 0x68 0x68 0x68 0x68 0x68 0x67 0x68 0x6a 0x6a 0x6a 0x68 0x68 0x68 0x68 0x67 0x67 0x6a 0x6d 0x6a 0x6a 0x6b 0x6b 0x6a 0x6a 0x6b 0x6d 0x67 0x67 0x66 0x66 0x66 0x64 0x64 0x64 0x67 0x68 0x66 0x66 0x67 0x66 0x66 0x66 0x67 0x68 0x6a 0x6a 0x68 0x68 0x68 0x67 0x67 0x67 0x6a 0x6d 0x6a 0x6a 0x6a 0x6a 0x6a 0x6a 0x6b 0x6d 0x67 0x67 0x67 0x66 0x66 0x64 0x64 0x64 0x67 0x6a 0x67 0x67 0x67 0x67 0x67 0x67 0x67 0x6a 0x66 0x66 0x66 0x66 0x64 0x64 0x63 0x63 0x66 0x6d 0x68 0x68 0x68 0x68 0x68 0x6a 0x6b 0x6d 0x67 0x67 0x67 0x67 0x66 0x66 0x64 0x64 0x67 0x68 0x64 0x64 0x66 0x66 0x66 0x66 0x67 0x6a 0x66 0x67 0x66 0x66 0x66 0x64 0x64 0x63 0x66 0x6d 0x68 0x68 0x68 0x68 0x6a 0x6a 0x6b 0x6d 0x68 0x68 0x68 0x68 0x67 0x67 0x66 0x66 0x68 0x6a 0x66 0x67 0x67 0x67 0x67 0x67 0x68 0x6a 0x13a 0x13a 0x13a>;
					PS_Config_Lmt_FW_Diff_N = <0xffffffce 0xffff0001 0xffffffce 0xffffffce 0xffffffce 0xffffffce 0xffffffce 0xffffffce 0xffffffce 0xffffffce 0xffffffce 0xffffffce 0xffffffce 0xffffffce 0xffffffce 0xffffffce 0xffffffce 0xffffffce 0xffffffce 0xffffffce 0xffffffce 0xffffffce 0xffffffce 0xffffffce 0xffffffce 0xffffffce 0xffffffce 0xffffffce 0xffffffce 0xffffffce 0xffffffce 0xffffffce 0xffffffce 0xffffffce 0xffffffce 0xffffffce 0xffffffce 0xffffffce 0xffffffce 0xffffffce 0xffffffce 0xffffffce 0xffffffce 0xffffffce 0xffffffce 0xffffffce 0xffffffce 0xffffffce 0xffffffce 0xffffffce 0xffffffce 0xffffffce 0xffffffce 0xffffffce 0xffffffce 0xffffffce 0xffffffce 0xffffffce 0xffffffce 0xffffffce 0xffffffce 0xffffffce 0xffffffce 0xffffffce 0xffffffce 0xffffffce 0xffffffce 0xffffffce 0xffffffce 0xffffffce 0xffffffce 0xffffffce 0xffffffce 0xffffffce 0xffffffce 0xffffffce 0xffffffce 0xffffffce 0xffffffce 0xffffffce 0xffffffce 0xffffffce 0xffffffce 0xffffffce 0xffffffce 0xffffffce 0xffffffce 0xffffffce 0xffffffce 0xffffffce 0xffffffce 0xffffffce 0xffffffce 0xffffffce 0xffffffce 0xffffffce 0xffffffce 0xffffffce 0xffffffce 0xffffffce 0xffffffce 0xffffffce 0xffffffce 0xffffffce 0xffffffce 0xffffffce 0xffffffce 0xffffffce 0xffffffce 0xffffffce 0xffffffce 0xffffffce 0xffffffce 0xffffffce 0xffffffce 0xffffffce 0xffffffce 0xffffffce 0xffffffce 0xffffffce 0xffffffce 0xffffffce 0xffffffce 0xffffffce 0xffffffce 0xffffffce 0xffffffce 0xffffffce 0xffffffce 0xffffffce 0xffffffce 0xffffffce 0xffffffce 0xffffffce 0xffffffce 0xffffffce 0xffffffce 0xffffffce 0xffffffce 0xffffffce 0xffffffce 0xffffffce 0xffffffce 0xffffffce 0xffffffce 0xffffffce 0xffffffce 0xffffffce 0xffffffce 0xffffffce 0xffffffce 0xffffffce 0xffffffce 0xffffffce 0xffffffce 0xffffffce 0xffffffce 0xffffffce 0xffffffce 0xffffffce 0xffffffce 0xffffffce 0xffffffce 0xffffffce 0xffffffce 0xffffffce 0xffffffce 0xffffffce 0xffffffce 0xffffffce 0xffffffce 0xffffffce 0xffffffce 0xffffffce 0xffffffce 0xffffffce 0xffffffce 0xffffffce 0xffffffce 0xffffffce 0xffffffce 0xffffffce 0xffffffce 0xffffffce 0xffffffce 0xffffffce 0xffffffce 0xffffffce 0xffffffce 0xffffffce 0xffffffce 0xffffffce 0xffffffce 0xffffffce 0xffffffce 0xffffffce 0xffffffce 0xffffffce 0xffffffce 0xffffffce 0xffffffce 0xffffffce 0xffffffce 0xffffffce 0xffffffce 0xffffffce 0xffffffce 0xffffffce 0xffffffce 0xffffffce 0xffffffce 0xffffffce 0xffffffce 0xffffffce 0xffffffce 0xffffffce 0xffffffce 0xffffffce 0xffffffce 0xffffffce 0xffffffce 0xffffffce 0xffffffce 0xffffffce 0xffffffce 0xffffffce 0xffffffce 0xffffffce 0xffffffce 0xffffffce 0xffffffce 0xffffffce 0xffffffce 0xffffffce 0xffffffce 0xffffffce 0xffffffce 0xffffffce 0xffffffce 0xffffffce 0xffffffce 0xffffffce 0xffffffce 0xffffffce 0xffffffce 0xffffffce 0xffffffce 0xffffffce 0xffffffce 0xffffffce 0xffffffce 0xffffffce 0xffffffce 0xffffffce 0xffffffce 0xffffffce 0xffffffce 0xffffffce 0xffffffce 0xffffffce 0xffffffce 0xffffffce 0xffffffce 0xffffffce 0xffffffce 0xffffffce 0xffffffce 0xffffffce 0xffffffce 0xffffffce 0xffffffce 0xffffffce 0xffffffce 0xffffffce 0xffffffce 0xffffffce 0xffffffce 0xffffffce 0xffffffce 0xffffffce 0xffffffce 0xffffffce 0xffffffce 0xffffffce 0xffffffce 0xffffffce 0xffffffce 0xffffffce 0xffffffce 0xffffffce 0xffffffce 0xffffffce 0xffffffce 0xffffffce 0xffffffce 0xffffffce 0xffffffce 0xffffffce 0xffffffce 0xffffffce 0xffffffce 0xffffffce 0xffffffce 0xffffffce 0xffffffce 0xffffffce 0xffffffce 0xffffffce 0xffffffce 0xffffffce 0xffffffce 0xffffffce 0xffffffce 0xffffffce 0xffffffce 0xffffffce 0xffffffce 0xffffffce 0xffffffce 0xffffffce 0xffffffce 0xffffffce 0xffffffce 0xffffffce 0xffffffce 0xffffffce 0xffffffce 0xffffffce 0xffffffce 0xffffffce 0xffffffce 0xffffffce 0xffffffce 0xffffffce 0xffffffce 0xffffffce 0xffffffce 0xffffffce 0xffffffce 0xffffffce 0xffffffce 0xffffffce 0xffffffce 0xffffffce 0xffffffce 0xffffffce 0xffffffce 0xffffffce 0xffffffce 0xffffffce 0xffffffce 0xffffffce 0xffffffce 0xffffffce 0xffffffce 0xffffffce 0xffffffce 0xffffffce 0xffffffce 0xffffffce 0xffffffce 0xffffffce 0xffffffce 0xffffffce 0xffffffce 0xffffffce 0xffffffce 0xffffffce 0xffffffce 0xffffffce 0xffffffce 0xffffffce 0xffffffce 0xffffffce 0xffffffce 0xffffffce 0xffffffce 0xffffffce 0xffffffce 0xffffffce 0xffffffce 0xffffffce 0xffffffce 0xffffffce 0xffffffce 0xffffffce 0xffffffce 0xffffffce 0xffffffce 0xffffffce 0xffffffce 0xffffffce 0xffffffce 0xffffffce 0xffffffce 0xffffffce 0xffffffce 0xffffffce 0xffffffce 0xffffffce 0xffffffce 0xffffffce 0xffffffce 0xffffffce 0xffffffce 0xffffffce 0xffffffce 0xffffffce 0xffffffce 0xffffffce 0xffffffce 0xffffffce 0xffffffce 0xffffffce 0xffffffce 0xffffffce 0xffffffce 0xffffffce 0xffffffce 0xffffffce 0xffffffce 0xffffffce 0xffffffce 0xffffffce 0xffffffce 0xffffffce 0xffffffce 0xffffffce 0xffffffce 0xffffffce 0xffffffce 0xffffffce 0xffffffce 0xffffffce 0xffffffce 0xffffffce 0xffffffce 0xffffffce 0xffffffce 0xffffffce 0xffffffce 0xffffffce 0xffffffce 0xffffffce 0xffffffce 0xffffffce 0xffffffce 0xffffffce 0xffffffce 0xffffffce 0xffffffce 0xffffffce 0xffffffce 0xffffffce 0xffffffce 0xffffffce 0xffffffce 0xffffffce 0xffffffce 0xffffffce 0xffffffce 0xffffffce 0xffffffce 0xffffffce 0xffffffce 0xffffffce 0xffffffce 0xffffffce 0xffffffce 0xffffffce 0xffffffce 0xffffffce 0xffffffce 0xffffffce 0xffffffce 0xffffffce 0xffffffce 0xffffffce 0xffffffce 0xffffffce 0xffffffce 0xffffffce 0xffffffce 0xffffffce 0xffffffce 0xffffffce 0xffffffce 0xffffffce 0xffffffce 0xffffffce 0xffffffce 0xffffffce 0xffffffce 0xffffffce 0xffffffce 0xffffffce 0xffffffce 0xffffffce 0xffffffce 0xffffffce 0xffffffce 0xffffffce 0xffffffce 0xffffffce 0xffffffce 0xffffffce 0xffffffce 0xffffffce 0xffffffce 0xffffffce 0xffffffce 0xffffffce 0xffffffce 0xffffffce 0xffffffce 0xffffffce 0xffffffce 0xffffffce 0xffffffce 0xffffffce 0xffffffce 0xffffffce 0xffffffce 0xffffffce 0xffffffce 0xffffffce 0xffffffce 0xffffffce 0xffffffce 0xffffffce 0xffffffce 0xffffffce 0xffffffce 0xffffffce 0xffffffce 0xffffffce 0xffffffce 0xffffffce 0xffffffce 0xffffffce 0xffffffce 0xffffffce 0xffffffce 0xffffffce 0xffffffce 0xffffffce 0xffffffce 0xffffffce 0xffffffce 0xffffffce 0xffffffce 0xffffffce 0xffffffce 0xffffffce 0xffffffce 0xffffffce 0xffffffce 0xffffffce 0xffffffce 0xffffffce 0xffffffce 0xffffffce 0xffffffce 0xffffffce 0xffffffce 0xffffffce 0xffffffce 0xffffffce 0xffffffce 0xffffffce 0xffffffce 0xffffffce 0xffffffce 0xffffffce 0xffffffce 0xffffffce 0xffffffb5 0xffffffb5 0xffffffb5>;
					PS_Config_Lmt_FW_Diff_P = <0x32 0xffff 0x32 0x32 0x32 0x32 0x32 0x32 0x32 0x32 0x32 0x32 0x32 0x32 0x32 0x32 0x32 0x32 0x32 0x32 0x32 0x32 0x32 0x32 0x32 0x32 0x32 0x32 0x32 0x32 0x32 0x32 0x32 0x32 0x32 0x32 0x32 0x32 0x32 0x32 0x32 0x32 0x32 0x32 0x32 0x32 0x32 0x32 0x32 0x32 0x32 0x32 0x32 0x32 0x32 0x32 0x32 0x32 0x32 0x32 0x32 0x32 0x32 0x32 0x32 0x32 0x32 0x32 0x32 0x32 0x32 0x32 0x32 0x32 0x32 0x32 0x32 0x32 0x32 0x32 0x32 0x32 0x32 0x32 0x32 0x32 0x32 0x32 0x32 0x32 0x32 0x32 0x32 0x32 0x32 0x32 0x32 0x32 0x32 0x32 0x32 0x32 0x32 0x32 0x32 0x32 0x32 0x32 0x32 0x32 0x32 0x32 0x32 0x32 0x32 0x32 0x32 0x32 0x32 0x32 0x32 0x32 0x32 0x32 0x32 0x32 0x32 0x32 0x32 0x32 0x32 0x32 0x32 0x32 0x32 0x32 0x32 0x32 0x32 0x32 0x32 0x32 0x32 0x32 0x32 0x32 0x32 0x32 0x32 0x32 0x32 0x32 0x32 0x32 0x32 0x32 0x32 0x32 0x32 0x32 0x32 0x32 0x32 0x32 0x32 0x32 0x32 0x32 0x32 0x32 0x32 0x32 0x32 0x32 0x32 0x32 0x32 0x32 0x32 0x32 0x32 0x32 0x32 0x32 0x32 0x32 0x32 0x32 0x32 0x32 0x32 0x32 0x32 0x32 0x32 0x32 0x32 0x32 0x32 0x32 0x32 0x32 0x32 0x32 0x32 0x32 0x32 0x32 0x32 0x32 0x32 0x32 0x32 0x32 0x32 0x32 0x32 0x32 0x32 0x32 0x32 0x32 0x32 0x32 0x32 0x32 0x32 0x32 0x32 0x32 0x32 0x32 0x32 0x32 0x32 0x32 0x32 0x32 0x32 0x32 0x32 0x32 0x32 0x32 0x32 0x32 0x32 0x32 0x32 0x32 0x32 0x32 0x32 0x32 0x32 0x32 0x32 0x32 0x32 0x32 0x32 0x32 0x32 0x32 0x32 0x32 0x32 0x32 0x32 0x32 0x32 0x32 0x32 0x32 0x32 0x32 0x32 0x32 0x32 0x32 0x32 0x32 0x32 0x32 0x32 0x32 0x32 0x32 0x32 0x32 0x32 0x32 0x32 0x32 0x32 0x32 0x32 0x32 0x32 0x32 0x32 0x32 0x32 0x32 0x32 0x32 0x32 0x32 0x32 0x32 0x32 0x32 0x32 0x32 0x32 0x32 0x32 0x32 0x32 0x32 0x32 0x32 0x32 0x32 0x32 0x32 0x32 0x32 0x32 0x32 0x32 0x32 0x32 0x32 0x32 0x32 0x32 0x32 0x32 0x32 0x32 0x32 0x32 0x32 0x32 0x32 0x32 0x32 0x32 0x32 0x32 0x32 0x32 0x32 0x32 0x32 0x32 0x32 0x32 0x32 0x32 0x32 0x32 0x32 0x32 0x32 0x32 0x32 0x32 0x32 0x32 0x32 0x32 0x32 0x32 0x32 0x32 0x32 0x32 0x32 0x32 0x32 0x32 0x32 0x32 0x32 0x32 0x32 0x32 0x32 0x32 0x32 0x32 0x32 0x32 0x32 0x32 0x32 0x32 0x32 0x32 0x32 0x32 0x32 0x32 0x32 0x32 0x32 0x32 0x32 0x32 0x32 0x32 0x32 0x32 0x32 0x32 0x32 0x32 0x32 0x32 0x32 0x32 0x32 0x32 0x32 0x32 0x32 0x32 0x32 0x32 0x32 0x32 0x32 0x32 0x32 0x32 0x32 0x32 0x32 0x32 0x32 0x32 0x32 0x32 0x32 0x32 0x32 0x32 0x32 0x32 0x32 0x32 0x32 0x32 0x32 0x32 0x32 0x32 0x32 0x32 0x32 0x32 0x32 0x32 0x32 0x32 0x32 0x32 0x32 0x32 0x32 0x32 0x32 0x32 0x32 0x32 0x32 0x32 0x32 0x32 0x32 0x32 0x32 0x32 0x32 0x32 0x32 0x32 0x32 0x32 0x32 0x32 0x32 0x32 0x32 0x32 0x32 0x32 0x32 0x32 0x32 0x32 0x32 0x32 0x32 0x32 0x32 0x32 0x32 0x32 0x32 0x32 0x32 0x32 0x32 0x32 0x32 0x32 0x32 0x32 0x32 0x32 0x32 0x32 0x32 0x32 0x32 0x32 0x32 0x32 0x32 0x32 0x32 0x32 0x32 0x32 0x32 0x32 0x32 0x32 0x32 0x32 0x32 0x32 0x32 0x32 0x32 0x32 0x32 0x32 0x32 0x32 0x32 0x32 0x32 0x32 0x32 0x32 0x32 0x32 0x32 0x32 0x32 0x32 0x32 0x32 0x32 0x32 0x32 0x32 0x32 0x32 0x32 0x32 0x32 0x4b 0x4b 0x4b>;
					PS_Config_Lmt_FW_Rawdata_N = <0x3bc 0xffff0001 0x3bb 0x3c1 0x3c6 0x3be 0x3b8 0x3ba 0x3c4 0x3ca 0x3be 0x3c2 0x3c5 0x3c4 0x3ba 0x3bb 0x3bb 0x3c4 0x3be 0x3be 0x3c2 0x3b8 0x3c1 0x3c7 0x3c6 0x3c7 0x3b7 0x3b7 0x3c1 0x3c0 0x3c0 0x3c6 0x3c0 0x3bd 0x3bd 0x3c2 0x3c4 0x3c2 0x3b8 0x3ba 0x3be 0x3bc 0x3b7 0x3be 0x3bc 0x3b7 0x3bd 0x3be 0x3c0 0x3ba 0x3be 0x3c2 0x3bc 0x3c0 0x3b7 0x3b7 0x3bb 0x3bd 0x3c2 0x3bb 0x3c6 0x3c7 0x3b2 0x3c1 0x3bf 0x3bd 0x3bc 0x3c4 0x3b7 0x3b5 0x3b8 0x3bb 0x3c6 0x3ce 0x3bd 0x3ce 0x3c9 0x3d0 0x3c8 0x3c2 0x3c7 0x3c3 0x3c6 0x3cc 0x3c4 0x3c0 0x3c5 0x3c6 0x3cb 0x3ab 0x3c3 0x3c6 0x3be 0x3cc 0x3c9 0x3be 0x3c3 0x3c8 0x3ba 0x3c9 0x3c6 0x3c8 0x3c3 0x3be 0x3c1 0x3c1 0x3bc 0x3c0 0x3c3 0x3c8 0x3c2 0x3c4 0x3c6 0x3cb 0x3c9 0x3c3 0x3c4 0x3bd 0x3c3 0x3c2 0x3c0 0x3bd 0x3ba 0x3bb 0x3c0 0x3c0 0x3c8 0x3ba 0x3bd 0x3c0 0x3bf 0x3b8 0x3b7 0x3bb 0x3be 0x3be 0x3c0 0x3c4 0x3c0 0x3bd 0x3bd 0x3be 0x3c1 0x3c4 0x3c8 0x3ba 0x3bf 0x3b8 0x3b6 0x3b8 0x3b5 0x3bd 0x3c4 0x3c1 0x3c6 0x3c0 0x3ca 0x3cc 0x3cb 0x3c2 0x3c6 0x3c1 0x3ba 0x3ba 0x3c3 0x3bc 0x3c4 0x3c0 0x3c3 0x3c5 0x3be 0x3ba 0x3b8 0x3bb 0x3be 0x3be 0x3c1 0x3c1 0x3bd 0x3b9 0x3be 0x3bd 0x3be 0x3c0 0x3be 0x3c1 0x3b8 0x3bd 0x3c2 0x3c0 0x3c6 0x3c2 0x3bb 0x3bb 0x3c3 0x3c3 0x3c5 0x3b8 0x3b8 0x3b5 0x3c9 0x3b7 0x3c5 0x3c8 0x3c7 0x3c1 0x3c0 0x3be 0x3c0 0x3ba 0x3b7 0x3b6 0x3bb 0x3bc 0x3b1 0x3c1 0x3c9 0x3c1 0x3c7 0x3bb 0x3c4 0x3c1 0x3c3 0x3bf 0x3c2 0x3c6 0x3c1 0x3c4 0x3c4 0x3b2 0x3b5 0x3ba 0x3bd 0x3c5 0x3c3 0x3c2 0x3c3 0x3bd 0x3c3 0x3bd 0x3c0 0x3c5 0x3bc 0x3c3 0x3bf 0x3bd 0x3bc 0x3b4 0x3b1 0x3c1 0x3c1 0x3be 0x3c0 0x3c3 0x3c3 0x3be 0x3ca 0x3c5 0x3c7 0x3c4 0x3c3 0x3c1 0x3c0 0x3be 0x3c0 0x3b4 0x3bf 0x3bb 0x3bb 0x3b8 0x3b5 0x3be 0x3bd 0x3bb 0x3c1 0x3c5 0x3c9 0x3bb 0x3c3 0x3bc 0x3be 0x3c0 0x3be 0x3b2 0x3ae 0x3c1 0x3be 0x3c4 0x3c3 0x3b9 0x3b8 0x3b7 0x3c0 0x3bc 0x3c1 0x3be 0x3c5 0x3c3 0x3be 0x3ba 0x3be 0x3ba 0x3ba 0x3c1 0x3b5 0x3bd 0x3c6 0x3bb 0x3b9 0x3bd 0x3bb 0x3bd 0x3bb 0x3b8 0x3ba 0x3c5 0x3c3 0x3c4 0x3c0 0x3bb 0x3c4 0x3b8 0x3be 0x3bd 0x3ca 0x3c9 0x3be 0x3c2 0x3bb 0x3b8 0x3bb 0x3c0 0x3c1 0x3c1 0x3c0 0x3be 0x3bd 0x3bd 0x3c4 0x3c4 0x3c4 0x3be 0x3c4 0x3c6 0x3b8 0x3bd 0x3c1 0x3c0 0x3c3 0x3c3 0x3c0 0x3ba 0x3c3 0x3c2 0x3c4 0x3be 0x3c5 0x3c7 0x3c4 0x3b9 0x3c0 0x3c4 0x3c4 0x3c2 0x3c8 0x3c3 0x3c6 0x3c6 0x3bf 0x3be 0x3c0 0x3bd 0x3bf 0x3ba 0x3c2 0x3bb 0x3c6 0x3bd 0x3bd 0x3bf 0x3be 0x3b2 0x3c1 0x3c1 0x3c4 0x3c4 0x3c1 0x3bf 0x3d4 0x3c0 0x3c6 0x3ca 0x3c7 0x3b5 0x3bd 0x3c2 0x3cf 0x3bf 0x3b2 0x3b4 0x3c4 0x3c4 0x3c9 0x3cc 0x3c0 0x3bd 0x3bd 0x3ba 0x3be 0x3b2 0x3ba 0x3bf 0x3b1 0x3c0 0x3bd 0x3be 0x3bb 0x3b7 0x3bf 0x3c5 0x3c3 0x3c6 0x3c6 0x3b7 0x3bb 0x3bd 0x3bf 0x3bb 0x3bd 0x3c4 0x3c6 0x3c1 0x3c3 0x3bb 0x3bd 0x3c3 0x3be 0x3c1 0x3c1 0x3bb 0x3c0 0x3be 0x3be 0x3c4 0x3b8 0x3c3 0x3c3 0x3c3 0x3be 0x3bc 0x3c6 0x3c1 0x3bf 0x3c0 0x3b8 0x3bc 0x3bd 0x3bd 0x3c7 0x3cc 0x3cf 0x3c0 0x3be 0x3c8 0x3cb 0x3c7 0x3b9 0x3bb 0x3c7 0x3c7 0x3bd 0x3b9 0x3bf 0x3c3 0x3ca 0x3ce 0x3c3 0x3c3 0x3c8 0x3be 0x3bd 0x3ba 0x3c1 0x3c4 0x3c4 0x3c5 0x3be 0x3c0 0x3b5 0x3bf 0x3bc 0x3c9 0x3be 0x3c0 0x3b5 0x3b9 0x3c1 0x3bd 0x3b9 0x3bb 0x3be 0x3c3 0x3c6 0x3b8 0x3c2 0x3b9 0x3c8 0x3cc 0x3c7 0x3af 0x3bc 0x3c3 0x3b5 0x3c4 0x3c7 0x3ca 0x3bd 0x3c1 0x3c1 0x3b5 0x3cf 0x3b0 0x3c2 0x3be 0x3bd 0x3b2 0x3bb 0x3be 0x3bc 0x3b8 0x3c3 0x3b8 0x3b9 0x3c3 0x3be 0x3bf 0x3bf 0x3c7 0x3c0 0x3c1 0x3cd 0x3ba 0x3cb 0x3c7 0x3b4 0x3bb 0x3cf 0x3c4 0x3ca 0x3b9 0x3c8 0x3c2 0x3c3 0x3c3 0x3bc 0x3c2 0x3ca 0x3bc 0x3c0 0x3c2 0x3bd 0x3bd 0x3c1 0x3b1 0x3c9 0x3c9 0x3c9 0x3cc 0x3bc 0x3c4 0x3c9 0x3c4 0x3c3 0x3c4 0x3b7 0x3ca 0xf0 0xf0 0xf0>;
					PS_Config_Lmt_FW_Rawdata_P = <0x8b7 0xffff 0x8b6 0x8c2 0x8cf 0x8bb 0x8ad 0x8b2 0x8c9 0x8d9 0x8bd 0x8c5 0x8cc 0x8c9 0x8b2 0x8b6 0x8b4 0x8cb 0x8bd 0x8bd 0x8c5 0x8ad 0x8c2 0x8d0 0x8cf 0x8d0 0x8ac 0x8ab 0x8c4 0x8c0 0x8c1 0x8ce 0x8c0 0x8ba 0x8ba 0x8c5 0x8c9 0x8c5 0x8ad 0x8b3 0x8bd 0x8b7 0x8ab 0x8bb 0x8b7 0x8ac 0x8b9 0x8bb 0x8c1 0x8b2 0x8bb 0x8c5 0x8b7 0x8c0 0x8ac 0x8ac 0x8b4 0x8ba 0x8c5 0x8b6 0x8cf 0x8d0 0x89f 0x8c4 0x8be 0x8ba 0x8b7 0x8c9 0x8ab 0x8a6 0x8af 0x8b4 0x8ce 0x8e1 0x8ba 0x8e1 0x8d5 0x8e5 0x8d3 0x8c5 0x8d2 0x8c8 0x8ce 0x8dd 0x8c9 0x8c0 0x8cc 0x8ce 0x8da 0x88f 0x8c8 0x8ce 0x8bb 0x8dc 0x8d5 0x8bd 0x8c7 0x8d3 0x8b2 0x8d6 0x8cf 0x8d3 0x8c8 0x8bd 0x8c4 0x8c4 0x8b7 0x8c1 0x8c8 0x8d3 0x8c5 0x8c9 0x8cf 0x8da 0x8d5 0x8c8 0x8c9 0x8b9 0x8c7 0x8c5 0x8c1 0x8ba 0x8b3 0x8b6 0x8c1 0x8c0 0x8d3 0x8b2 0x8b9 0x8c1 0x8be 0x8ad 0x8ac 0x8b4 0x8bd 0x8bb 0x8c0 0x8cb 0x8c1 0x8b9 0x8ba 0x8bd 0x8c4 0x8c9 0x8d3 0x8b3 0x8be 0x8af 0x8a9 0x8af 0x8a8 0x8b9 0x8cb 0x8c2 0x8ce 0x8c1 0x8d9 0x8dd 0x8da 0x8c5 0x8cf 0x8c4 0x8b3 0x8b3 0x8c7 0x8b7 0x8c9 0x8c1 0x8c7 0x8cc 0x8bd 0x8b2 0x8af 0x8b6 0x8bb 0x8bd 0x8c2 0x8c4 0x8b9 0x8b0 0x8bd 0x8ba 0x8bd 0x8c1 0x8bd 0x8c4 0x8ad 0x8b9 0x8c5 0x8c0 0x8cf 0x8c5 0x8b6 0x8b6 0x8c8 0x8c7 0x8cc 0x8af 0x8ad 0x8a8 0x8d5 0x8ab 0x8cc 0x8d3 0x8d2 0x8c2 0x8c0 0x8bb 0x8c1 0x8b3 0x8ac 0x8a9 0x8b4 0x8b7 0x89d 0x8c2 0x8d5 0x8c2 0x8d0 0x8b6 0x8c9 0x8c4 0x8c8 0x8be 0x8c5 0x8ce 0x8c4 0x8cb 0x8cb 0x8a1 0x8a8 0x8b2 0x8b9 0x8cc 0x8c8 0x8c5 0x8c8 0x8b9 0x8c8 0x8ba 0x8c1 0x8cc 0x8b7 0x8c8 0x8be 0x8b9 0x8b7 0x8a4 0x89d 0x8c4 0x8c4 0x8bd 0x8c0 0x8c7 0x8c8 0x8bb 0x8d7 0x8cc 0x8d2 0x8cb 0x8c7 0x8c2 0x8c1 0x8bb 0x8c0 0x8a4 0x8be 0x8b4 0x8b4 0x8af 0x8a8 0x8bd 0x8ba 0x8b6 0x8c4 0x8cc 0x8d5 0x8b6 0x8c7 0x8b7 0x8bb 0x8c0 0x8bd 0x8a1 0x897 0x8c2 0x8bd 0x8cb 0x8c7 0x8b0 0x8ad 0x8ac 0x8c1 0x8b7 0x8c2 0x8bb 0x8cc 0x8c7 0x8bd 0x8b3 0x8bd 0x8b2 0x8b3 0x8c2 0x8a6 0x8b9 0x8cf 0x8b4 0x8b0 0x8ba 0x8b4 0x8b9 0x8b4 0x8af 0x8b3 0x8cc 0x8c7 0x8c9 0x8c0 0x8b6 0x8c9 0x8ad 0x8bb 0x8b9 0x8d9 0x8d5 0x8bd 0x8c5 0x8b6 0x8ad 0x8b4 0x8c0 0x8c4 0x8c2 0x8c1 0x8bd 0x8ba 0x8ba 0x8c9 0x8cb 0x8cb 0x8bb 0x8cb 0x8ce 0x8ad 0x8ba 0x8c2 0x8c1 0x8c7 0x8c7 0x8c0 0x8b2 0x8c8 0x8c5 0x8cb 0x8bd 0x8cc 0x8d0 0x8c9 0x8b0 0x8c1 0x8c9 0x8c9 0x8c5 0x8d3 0x8c8 0x8ce 0x8cf 0x8be 0x8bb 0x8c1 0x8b9 0x8be 0x8b2 0x8c5 0x8b6 0x8ce 0x8ba 0x8ba 0x8be 0x8bd 0x89f 0x8c2 0x8c4 0x8cb 0x8c9 0x8c2 0x8be 0x8ef 0x8c0 0x8ce 0x8d9 0x8d2 0x8a6 0x8b9 0x8c5 0x8e3 0x8be 0x8a1 0x8a5 0x8c9 0x8cb 0x8d6 0x8dd 0x8c1 0x8ba 0x8b9 0x8b2 0x8bb 0x8a1 0x8b3 0x8be 0x89e 0x8c0 0x8b9 0x8bb 0x8b4 0x8ac 0x8be 0x8cc 0x8c7 0x8ce 0x8cf 0x8ac 0x8b4 0x8ba 0x8be 0x8b4 0x8b9 0x8c9 0x8ce 0x8c2 0x8c7 0x8b6 0x8b9 0x8c8 0x8bb 0x8c4 0x8c2 0x8b6 0x8c1 0x8bd 0x8bb 0x8cb 0x8ad 0x8c7 0x8c7 0x8c7 0x8bd 0x8b7 0x8cf 0x8c4 0x8be 0x8c0 0x8ad 0x8b7 0x8b9 0x8b9 0x8d2 0x8dc 0x8e4 0x8c1 0x8bd 0x8d3 0x8da 0x8d0 0x8b0 0x8b4 0x8d2 0x8d2 0x8ba 0x8b0 0x8be 0x8c7 0x8d9 0x8e1 0x8c7 0x8c8 0x8d3 0x8bb 0x8ba 0x8b2 0x8c2 0x8c9 0x8cb 0x8cc 0x8bb 0x8c0 0x8a8 0x8be 0x8b7 0x8d6 0x8bd 0x8c0 0x8a6 0x8b0 0x8c4 0x8ba 0x8b0 0x8b4 0x8bb 0x8c8 0x8cf 0x8af 0x8c5 0x8b0 0x8d3 0x8dd 0x8d2 0x89a 0x8b7 0x8c7 0x8a6 0x8cb 0x8d0 0x8d7 0x8ba 0x8c4 0x8c2 0x8a6 0x8e3 0x89b 0x8c5 0x8bd 0x8b9 0x89f 0x8b4 0x8bd 0x8b7 0x8ad 0x8c7 0x8af 0x8b0 0x8c7 0x8bb 0x8be 0x8be 0x8d2 0x8c1 0x8c2 0x8de 0x8b2 0x8da 0x8d0 0x8a5 0x8b4 0x8e4 0x8c9 0x8d9 0x8b0 0x8d3 0x8c5 0x8c7 0x8c7 0x8b7 0x8c5 0x8d9 0x8b7 0x8c1 0x8c5 0x8ba 0x8b9 0x8c2 0x89e 0x8d5 0x8d5 0x8d6 0x8dc 0x8b7 0x8cb 0x8d6 0x8cb 0x8c7 0x8cb 0x8ab 0x8d7 0xa00 0xa00 0xa00>;
					PS_Config_Lmt_Open_Rawdata_N = <0x435 0xffff0001 0x429 0x449 0x478 0x492 0x4b4 0x4c7 0x4b7 0x48f 0x4d3 0x4c3 0x4bd 0x4ab 0x49f 0x492 0x478 0x462 0x3fe 0x475 0x47d 0x4a6 0x4d1 0x4e4 0x4ef 0x4fc 0x4c1 0x49c 0x4b1 0x49a 0x481 0x46b 0x457 0x443 0x425 0x417 0x3f8 0x414 0x431 0x454 0x47e 0x492 0x4af 0x4be 0x4ae 0x49f 0x4b6 0x4a5 0x48d 0x47a 0x46a 0x45e 0x43e 0x42f 0x40e 0x42d 0x44b 0x46f 0x498 0x4ae 0x4cc 0x4dd 0x4ce 0x49e 0x4b1 0x4a1 0x488 0x475 0x465 0x459 0x436 0x423 0x40c 0x42a 0x446 0x46c 0x492 0x4aa 0x4c6 0x4d8 0x4c9 0x4bc 0x4cc 0x4bc 0x4a1 0x48d 0x47e 0x46f 0x44b 0x43d 0x420 0x43e 0x45a 0x483 0x4a7 0x4c1 0x4de 0x4f2 0x4e3 0x4bc 0x4cb 0x4b9 0x49d 0x48b 0x47b 0x469 0x445 0x433 0x424 0x441 0x462 0x487 0x4aa 0x4c2 0x4e2 0x4f3 0x4e9 0x4da 0x4e6 0x4d5 0x4b7 0x4a5 0x493 0x481 0x45b 0x44c 0x433 0x453 0x471 0x49e 0x4c0 0x4d8 0x4fb 0x50d 0x505 0x4df 0x4e9 0x4d8 0x4ba 0x4a8 0x497 0x47e 0x459 0x448 0x43c 0x45e 0x47f 0x4ab 0x4ce 0x4e5 0x4fe 0x510 0x508 0x507 0x510 0x500 0x4e9 0x4d5 0x4c3 0x4a7 0x47d 0x46e 0x457 0x47a 0x49e 0x4cb 0x4ec 0x505 0x51b 0x52c 0x526 0x502 0x50a 0x4fa 0x4e6 0x4cf 0x4bd 0x49f 0x475 0x462 0x45f 0x484 0x4a7 0x4d8 0x4f6 0x50e 0x525 0x538 0x532 0x528 0x52e 0x51b 0x509 0x4f2 0x4e2 0x4bf 0x495 0x481 0x46c 0x496 0x4b9 0x4ee 0x50b 0x525 0x53c 0x550 0x54d 0x530 0x535 0x522 0x510 0x4f8 0x4e7 0x4bf 0x496 0x480 0x473 0x496 0x4c0 0x4e4 0x4fb 0x514 0x52e 0x541 0x541 0x548 0x549 0x536 0x522 0x50c 0x4f4 0x4c2 0x494 0x483 0x478 0x49e 0x4c9 0x4ed 0x505 0x51f 0x538 0x54a 0x54d 0x550 0x550 0x53d 0x529 0x511 0x4f6 0x4c0 0x494 0x47d 0x48f 0x4b6 0x4e1 0x505 0x520 0x536 0x54f 0x55f 0x563 0x572 0x56f 0x55d 0x546 0x531 0x511 0x4da 0x4ae 0x499 0x490 0x4b6 0x4e2 0x501 0x51f 0x53a 0x555 0x567 0x56e 0x57a 0x576 0x563 0x54e 0x535 0x511 0x4dc 0x4ae 0x496 0x49b 0x4c2 0x4ec 0x511 0x52c 0x547 0x55c 0x574 0x57a 0x594 0x589 0x577 0x561 0x549 0x521 0x4ec 0x4ba 0x4aa 0x4a5 0x4cd 0x4fb 0x51b 0x536 0x551 0x56a 0x57f 0x589 0x59a 0x58e 0x57d 0x565 0x550 0x529 0x4f3 0x4c2 0x4ae 0x4c0 0x4ea 0x519 0x53b 0x553 0x570 0x586 0x59d 0x5a7 0x5bf 0x5b2 0x5a0 0x58b 0x577 0x549 0x510 0x4db 0x4c9 0x4c6 0x4ed 0x51e 0x540 0x55a 0x575 0x590 0x5a6 0x5b2 0x5c2 0x5b3 0x5a1 0x58b 0x575 0x546 0x50c 0x4d9 0x4c3 0x4d5 0x4ff 0x52f 0x552 0x56b 0x588 0x5a1 0x5b6 0x5c5 0x5d9 0x5ca 0x5b9 0x5a4 0x58c 0x55e 0x51f 0x4ec 0x4d9 0x4db 0x505 0x538 0x557 0x574 0x58c 0x5a6 0x5ba 0x5c9 0x5e1 0x5d3 0x5c2 0x5ad 0x595 0x55f 0x523 0x4ef 0x4d9 0x4f3 0x51d 0x543 0x567 0x583 0x59f 0x5b5 0x5ca 0x5d3 0x5f4 0x5e8 0x5d7 0x5c1 0x5a9 0x574 0x532 0x507 0x4f3 0x503 0x531 0x556 0x579 0x592 0x5ad 0x5ca 0x5dd 0x5e5 0x604 0x5fa 0x5eb 0x5d2 0x5b8 0x584 0x542 0x517 0x4ff 0x4e0 0x524 0x546 0x566 0x582 0x59d 0x5b5 0x5c6 0x5cb 0x5e8 0x5de 0x5d1 0x5bb 0x5a6 0x570 0x534 0x50c 0x4e3 0x4e6 0x52c 0x54f 0x56d 0x587 0x5a2 0x5b9 0x5cd 0x5d1 0x5ee 0x5e5 0x5d6 0x5c1 0x5aa 0x577 0x53b 0x513 0x4e5 0x4ff 0x547 0x568 0x588 0x5a2 0x5bb 0x5d4 0x5e5 0x5e8 0x601 0x5f8 0x5eb 0x5d3 0x5bb 0x586 0x54a 0x521 0x4f8 0x50c 0x557 0x576 0x595 0x5b2 0x5c6 0x5e3 0x5f2 0x5f4 0x602 0x5fa 0x5f0 0x5d5 0x5bb 0x586 0x54a 0x51f 0x4f0 0x505 0x554 0x57a 0x5af 0x5e2 0x5f9 0x609 0x612 0x5fa 0x5f0 0x612 0x609 0x5f8 0x5e8 0x5d1 0x5bf 0x5a3 0x570 0x531 0x582 0x5a7 0x5da 0x609 0x61a 0x628 0x631 0x61b 0x5e5 0x600 0x5f8 0x5eb 0x5da 0x5c7 0x5b5 0x597 0x566 0x534 0x5a6 0x5d0 0x606 0x637 0x649 0x653 0x65a 0x649 0x639 0x654 0x64a 0x63d 0x62a 0x616 0x605 0x5e5 0x595 0x553 0x5b8 0x5f4 0x62a 0x658 0x669 0x672 0x676 0x667 0x63d 0x653 0x64c 0x63e 0x62e 0x61b 0x60a 0x5d4 0x59b 0xfffffe01 0xfffffe01 0xfffffe01>;
					PS_Config_Lmt_Open_Rawdata_P = <0x9d2 0xffff 0x9b5 0xa00 0xa6f 0xaab 0xaf9 0xb26 0xb00 0xaa3 0xb42 0xb1e 0xb0e 0xae6 0xac8 0xaaa 0xa6f 0xa3b 0x951 0xa66 0xa79 0xad9 0xb3d 0xb6b 0xb84 0xba1 0xb18 0xac3 0xaf2 0xabd 0xa84 0xa4f 0xa22 0x9f2 0x9ac 0x98c 0x943 0x984 0x9c8 0xa19 0xa7b 0xaab 0xaee 0xb11 0xaeb 0xaca 0xafe 0xad8 0xaa0 0xa73 0xa4d 0xa31 0x9e6 0x9c4 0x977 0x9be 0xa04 0xa58 0xab9 0xaed 0xb33 0xb59 0xb36 0xac7 0xaf4 0xacd 0xa93 0xa68 0xa41 0xa26 0x9d5 0x9a7 0x971 0x9b7 0x9f9 0xa53 0xaaa 0xae2 0xb25 0xb4d 0xb2a 0xb0c 0xb33 0xb0d 0xace 0xa9e 0xa7d 0xa5a 0xa06 0x9e4 0x9a1 0x9e6 0xa29 0xa88 0xadc 0xb18 0xb5d 0xb8a 0xb68 0xb0d 0xb30 0xb06 0xac4 0xa9a 0xa76 0xa4a 0x9f8 0x9cc 0x9a9 0x9ee 0xa3a 0xa92 0xae2 0xb1a 0xb65 0xb8c 0xb76 0xb53 0xb6e 0xb46 0xb02 0xad6 0xaae 0xa84 0xa2a 0xa07 0x9ce 0xa18 0xa5e 0xac7 0xb17 0xb4f 0xb9f 0xbc9 0xbb6 0xb5e 0xb75 0xb4f 0xb07 0xadd 0xab6 0xa7b 0xa26 0x9fd 0x9e3 0xa31 0xa7e 0xae6 0xb37 0xb6c 0xba7 0xbd0 0xbbf 0xbbc 0xbd1 0xbab 0xb76 0xb46 0xb1e 0xadc 0xa7a 0xa56 0xa20 0xa72 0xac7 0xb30 0xb7c 0xbb6 0xbea 0xc11 0xc05 0xbb1 0xbc3 0xb9d 0xb6e 0xb38 0xb0e 0xaca 0xa66 0xa3a 0xa34 0xa89 0xadb 0xb4d 0xb95 0xbcd 0xc01 0xc2d 0xc21 0xc09 0xc16 0xbea 0xbc0 0xb8b 0xb65 0xb14 0xab1 0xa84 0xa53 0xab3 0xb05 0xb81 0xbc4 0xc01 0xc37 0xc67 0xc5e 0xc1b 0xc28 0xbfb 0xbd0 0xb99 0xb70 0xb13 0xab5 0xa81 0xa62 0xab3 0xb15 0xb69 0xb9f 0xbd9 0xc17 0xc42 0xc44 0xc53 0xc56 0xc29 0xbfb 0xbc7 0xb8f 0xb1a 0xaaf 0xa87 0xa6f 0xac7 0xb2a 0xb7e 0xbb6 0xbf3 0xc2d 0xc59 0xc60 0xc67 0xc67 0xc39 0xc0c 0xbd4 0xb93 0xb15 0xaaf 0xa7a 0xaa4 0xaff 0xb64 0xbb8 0xbf5 0xc29 0xc63 0xc88 0xc92 0xcb5 0xcae 0xc84 0xc4f 0xc1d 0xbd4 0xb53 0xaeb 0xabc 0xaa5 0xafe 0xb65 0xbae 0xbf3 0xc33 0xc71 0xc9c 0xcad 0xcc9 0xcbf 0xc92 0xc61 0xc28 0xbd4 0xb57 0xaed 0xab3 0xabf 0xb1a 0xb7d 0xbd4 0xc11 0xc50 0xc83 0xcb9 0xcc9 0xd04 0xcec 0xcc2 0xc8d 0xc56 0xbf8 0xb7c 0xb09 0xae2 0xad8 0xb34 0xb9f 0xbea 0xc29 0xc68 0xca2 0xcd4 0xcec 0xd13 0xcf7 0xcce 0xc98 0xc67 0xc0c 0xb8e 0xb1b 0xaed 0xb17 0xb79 0xbe6 0xc36 0xc6e 0xcb0 0xce3 0xd1a 0xd32 0xd68 0xd4a 0xd21 0xcef 0xcc0 0xc56 0xbd1 0xb54 0xb2c 0xb23 0xb80 0xbf1 0xc41 0xc7d 0xcbc 0xcfb 0xd2e 0xd4a 0xd6f 0xd4e 0xd22 0xcef 0xcbc 0xc4f 0xbc7 0xb50 0xb1e 0xb46 0xba8 0xc18 0xc6b 0xca6 0xce8 0xd22 0xd55 0xd76 0xda5 0xd83 0xd5a 0xd2b 0xcf3 0xc86 0xbf4 0xb7d 0xb50 0xb54 0xbb6 0xc2d 0xc76 0xcbb 0xcf3 0xd2e 0xd5d 0xd80 0xdb8 0xd98 0xd6f 0xd3e 0xd08 0xc8a 0xbfe 0xb83 0xb50 0xb8e 0xbee 0xc48 0xc9c 0xcde 0xd1e 0xd52 0xd82 0xd97 0xde5 0xdc9 0xda0 0xd6e 0xd35 0xcb9 0xc1f 0xbbc 0xb8e 0xbb2 0xc1d 0xc73 0xcc5 0xcff 0xd40 0xd82 0xdae 0xdc1 0xe0b 0xdf3 0xdd0 0xd95 0xd59 0xcdf 0xc45 0xbe0 0xba8 0xb61 0xbff 0xc4e 0xc99 0xcdb 0xd1a 0xd51 0xd79 0xd84 0xdc8 0xdb1 0xd92 0xd60 0xd2e 0xcb0 0xc24 0xbc7 0xb68 0xb6f 0xc13 0xc63 0xcaa 0xce6 0xd25 0xd5a 0xd8a 0xd94 0xdd6 0xdc2 0xd9e 0xd6e 0xd37 0xcc0 0xc34 0xbd7 0xb6c 0xba8 0xc50 0xc9f 0xce9 0xd25 0xd5f 0xd9b 0xdc2 0xdc8 0xe02 0xded 0xdd0 0xd97 0xd60 0xce3 0xc57 0xbf8 0xb98 0xbc7 0xc76 0xcbf 0xd06 0xd4a 0xd79 0xdbe 0xddf 0xde4 0xe05 0xdf3 0xddb 0xd9c 0xd60 0xce3 0xc59 0xbf4 0xb85 0xbb8 0xc6f 0xcc9 0xd43 0xdbb 0xdf0 0xe15 0xe2a 0xdf2 0xddb 0xe2b 0xe15 0xded 0xdc8 0xd94 0xd6a 0xd27 0xcb1 0xc1e 0xcdb 0xd32 0xda9 0xe15 0xe3d 0xe5f 0xe74 0xe40 0xdc2 0xe01 0xded 0xdcf 0xda9 0xd7c 0xd51 0xd0c 0xc99 0xc25 0xd2e 0xd90 0xe0f 0xe80 0xeac 0xec2 0xed2 0xeaa 0xe86 0xec4 0xead 0xe8e 0xe63 0xe35 0xe0c 0xdc2 0xd06 0xc6c 0xd59 0xde5 0xe62 0xecd 0xef6 0xf0a 0xf13 0xef0 0xe90 0xec2 0xeb1 0xe91 0xe6b 0xe3f 0xe17 0xd99 0xd16 0x1400 0x1400 0x1400>;
					PS_Config_Lmt_Short_Rawdata_N = <0x2c70 0x2c70 0x2c70 0x2c70 0x2c70 0x2c70 0x2c70 0x2c70 0x2c70 0x2c70 0x2c70 0x2c70 0x2c70 0x2c70 0x2c70 0x2c70 0x2c70 0x2c70 0x2c70 0x2c70 0x2c70 0x2c70 0x2c70 0x2c70 0x2c70 0x2c70 0x2c70 0x2c70 0x2c70 0x2c70 0x2c70 0x2c70 0x2c70 0x2c70 0x2c70 0x2c70 0x2c70 0x2c70 0x2c70 0x2c70 0x2c70 0x2c70 0x2c70 0x2c70 0x2c70 0x2c70 0x2c70 0x2c70 0x2c70 0x2c70 0x2c70 0x2c70 0x2c70 0x2c70 0x2c70 0x2c70 0x2c70 0x2c70 0x2c70 0x2c70 0x2c70 0x2c70 0x2c70 0x2c70 0x2c70 0x2c70 0x2c70 0x2c70 0x2c70 0x2c70 0x2c70 0x2c70 0x2c70 0x2c70 0x2c70 0x2c70 0x2c70 0x2c70 0x2c70 0x2c70 0x2c70 0x2c70 0x2c70 0x2c70 0x2c70 0x2c70 0x2c70 0x2c70 0x2c70 0x2c70 0x2c70 0x2c70 0x2c70 0x2c70 0x2c70 0x2c70 0x2c70 0x2c70 0x2c70 0x2c70 0x2c70 0x2c70 0x2c70 0x2c70 0x2c70 0x2c70 0x2c70 0x2c70 0x2c70 0x2c70 0x2c70 0x2c70 0x2c70 0x2c70 0x2c70 0x2c70 0x2c70 0x2c70 0x2c70 0x2c70 0x2c70 0x2c70 0x2c70 0x2c70 0x2c70 0x2c70 0x2c70 0x2c70 0x2c70 0x2c70 0x2c70 0x2c70 0x2c70 0x2c70 0x2c70 0x2c70 0x2c70 0x2c70 0x2c70 0x2c70 0x2c70 0x2c70 0x2c70 0x2c70 0x2c70 0x2c70 0x2c70 0x2c70 0x2c70 0x2c70 0x2c70 0x2c70 0x2c70 0x2c70 0x2c70 0x2c70 0x2c70 0x2c70 0x2c70 0x2c70 0x2c70 0x2c70 0x2c70 0x2c70 0x2c70 0x2c70 0x2c70 0x2c70 0x2c70 0x2c70 0x2c70 0x2c70 0x2c70 0x2c70 0x2c70 0x2c70 0x2c70 0x2c70 0x2c70 0x2c70 0x2c70 0x2c70 0x2c70 0x2c70 0x2c70 0x2c70 0x2c70 0x2c70 0x2c70 0x2c70 0x2c70 0x2c70 0x2c70 0x2c70 0x2c70 0x2c70 0x2c70 0x2c70 0x2c70 0x2c70 0x2c70 0x2c70 0x2c70 0x2c70 0x2c70 0x2c70 0x2c70 0x2c70 0x2c70 0x2c70 0x2c70 0x2c70 0x2c70 0x2c70 0x2c70 0x2c70 0x2c70 0x2c70 0x2c70 0x2c70 0x2c70 0x2c70 0x2c70 0x2c70 0x2c70 0x2c70 0x2c70 0x2c70 0x2c70 0x2c70 0x2c70 0x2c70 0x2c70 0x2c70 0x2c70 0x2c70 0x2c70 0x2c70 0x2c70 0x2c70 0x2c70 0x2c70 0x2c70 0x2c70 0x2c70 0x2c70 0x2c70 0x2c70 0x2c70 0x2c70 0x2c70 0x2c70 0x2c70 0x2c70 0x2c70 0x2c70 0x2c70 0x2c70 0x2c70 0x2c70 0x2c70 0x2c70 0x2c70 0x2c70 0x2c70 0x2c70 0x2c70 0x2c70 0x2c70 0x2c70 0x2c70 0x2c70 0x2c70 0x2c70 0x2c70 0x2c70 0x2c70 0x2c70 0x2c70 0x2c70 0x2c70 0x2c70 0x2c70 0x2c70 0x2c70 0x2c70 0x2c70 0x2c70 0x2c70 0x2c70 0x2c70 0x2c70 0x2c70 0x2c70 0x2c70 0x2c70 0x2c70 0x2c70 0x2c70 0x2c70 0x2c70 0x2c70 0x2c70 0x2c70 0x2c70 0x2c70 0x2c70 0x2c70 0x2c70 0x2c70 0x2c70 0x2c70 0x2c70 0x2c70 0x2c70 0x2c70 0x2c70 0x2c70 0x2c70 0x2c70 0x2c70 0x2c70 0x2c70 0x2c70 0x2c70 0x2c70 0x2c70 0x2c70 0x2c70 0x2c70 0x2c70 0x2c70 0x2c70 0x2c70 0x2c70 0x2c70 0x2c70 0x2c70 0x2c70 0x2c70 0x2c70 0x2c70 0x2c70 0x2c70 0x2c70 0x2c70 0x2c70 0x2c70 0x2c70 0x2c70 0x2c70 0x2c70 0x2c70 0x2c70 0x2c70 0x2c70 0x2c70 0x2c70 0x2c70 0x2c70 0x2c70 0x2c70 0x2c70 0x2c70 0x2c70 0x2c70 0x2c70 0x2c70 0x2c70 0x2c70 0x2c70 0x2c70 0x2c70 0x2c70 0x2c70 0x2c70 0x2c70 0x2c70 0x2c70 0x2c70 0x2c70 0x2c70 0x2c70 0x2c70 0x2c70 0x2c70 0x2c70 0x2c70 0x2c70 0x2c70 0x2c70 0x2c70 0x2c70 0x2c70 0x2c70 0x2c70 0x2c70 0x2c70 0x2c70 0x2c70 0x2c70 0x2c70 0x2c70 0x2c70 0x2c70 0x2c70 0x2c70 0x2c70 0x2c70 0x2c70 0x2c70 0x2c70 0x2c70 0x2c70 0x2c70 0x2c70 0x2c70 0x2c70 0x2c70 0x2c70 0x2c70 0x2c70 0x2c70 0x2c70 0x2c70 0x2c70 0x2c70 0x2c70 0x2c70 0x2c70 0x2c70 0x2c70 0x2c70 0x2c70 0x2c70 0x2c70 0x2c70 0x2c70 0x2c70 0x2c70 0x2c70 0x2c70 0x2c70 0x2c70 0x2c70 0x2c70 0x2c70 0x2c70 0x2c70 0x2c70 0x2c70 0x2c70 0x2c70 0x2c70 0x2c70 0x2c70 0x2c70 0x2c70 0x2c70 0x2c70 0x2c70 0x2c70 0x2c70 0x2c70 0x2c70 0x2c70 0x2c70 0x2c70 0x2c70 0x2c70 0x2c70 0x2c70 0x2c70 0x2c70 0x2c70 0x2c70 0x2c70 0x2c70 0x2c70 0x2c70 0x2c70 0x2c70 0x2c70 0x2c70 0x2c70 0x2c70 0x2c70 0x2c70 0x2c70 0x2c70 0x2c70 0x2c70 0x2c70 0x2c70 0x2c70 0x2c70 0x2c70 0x2c70 0x2c70 0x2c70 0x2c70 0x2c70 0x2c70 0x2c70 0x2c70 0x2c70 0x2c70 0x2c70 0x2c70 0x2c70 0x2c70 0x2c70 0x2c70 0x2c70 0x2c70 0x2c70 0x2c70 0x2c70 0x2c70 0x2c70 0x2c70 0x2c70 0x2c70 0x2c70 0x2c70 0x2c70 0x2c70 0x2c70 0x2c70 0x2c70 0x2c70 0x2c70 0x2c70 0x2c70 0x2c70 0x2c70 0x2c70 0x2c70 0x2c70 0x2c70 0x2c70 0x2c70 0x2c70 0x2c70 0x2c70 0x2c70 0x2c70 0x2c70 0x2c70 0x2c70 0x2c70 0x2c70 0x2c70 0x2c70 0x2c70 0x2c70 0x2c70 0x2c70 0x2c70 0x2c70 0x2c70 0x2c70 0x2c70 0x2c70 0x2c70 0x2c70 0x2c70 0x2c70 0x2c70 0x2c70 0x2c70 0x2c70 0x2c70 0x2c70 0x2c70 0x2c70 0x2710 0x2710 0x2710>;
					PS_Config_Lmt_Short_Rawdata_P = <0x36b8 0x36b8 0x36b8 0x36b8 0x36b8 0x36b8 0x36b8 0x36b8 0x36b8 0x36b8 0x36b8 0x36b8 0x36b8 0x36b8 0x36b8 0x36b8 0x36b8 0x36b8 0x36b8 0x36b8 0x36b8 0x36b8 0x36b8 0x36b8 0x36b8 0x36b8 0x36b8 0x36b8 0x36b8 0x36b8 0x36b8 0x36b8 0x36b8 0x36b8 0x36b8 0x36b8 0x36b8 0x36b8 0x36b8 0x36b8 0x36b8 0x36b8 0x36b8 0x36b8 0x36b8 0x36b8 0x36b8 0x36b8 0x36b8 0x36b8 0x36b8 0x36b8 0x36b8 0x36b8 0x36b8 0x36b8 0x36b8 0x36b8 0x36b8 0x36b8 0x36b8 0x36b8 0x36b8 0x36b8 0x36b8 0x36b8 0x36b8 0x36b8 0x36b8 0x36b8 0x36b8 0x36b8 0x36b8 0x36b8 0x36b8 0x36b8 0x36b8 0x36b8 0x36b8 0x36b8 0x36b8 0x36b8 0x36b8 0x36b8 0x36b8 0x36b8 0x36b8 0x36b8 0x36b8 0x36b8 0x36b8 0x36b8 0x36b8 0x36b8 0x36b8 0x36b8 0x36b8 0x36b8 0x36b8 0x36b8 0x36b8 0x36b8 0x36b8 0x36b8 0x36b8 0x36b8 0x36b8 0x36b8 0x36b8 0x36b8 0x36b8 0x36b8 0x36b8 0x36b8 0x36b8 0x36b8 0x36b8 0x36b8 0x36b8 0x36b8 0x36b8 0x36b8 0x36b8 0x36b8 0x36b8 0x36b8 0x36b8 0x36b8 0x36b8 0x36b8 0x36b8 0x36b8 0x36b8 0x36b8 0x36b8 0x36b8 0x36b8 0x36b8 0x36b8 0x36b8 0x36b8 0x36b8 0x36b8 0x36b8 0x36b8 0x36b8 0x36b8 0x36b8 0x36b8 0x36b8 0x36b8 0x36b8 0x36b8 0x36b8 0x36b8 0x36b8 0x36b8 0x36b8 0x36b8 0x36b8 0x36b8 0x36b8 0x36b8 0x36b8 0x36b8 0x36b8 0x36b8 0x36b8 0x36b8 0x36b8 0x36b8 0x36b8 0x36b8 0x36b8 0x36b8 0x36b8 0x36b8 0x36b8 0x36b8 0x36b8 0x36b8 0x36b8 0x36b8 0x36b8 0x36b8 0x36b8 0x36b8 0x36b8 0x36b8 0x36b8 0x36b8 0x36b8 0x36b8 0x36b8 0x36b8 0x36b8 0x36b8 0x36b8 0x36b8 0x36b8 0x36b8 0x36b8 0x36b8 0x36b8 0x36b8 0x36b8 0x36b8 0x36b8 0x36b8 0x36b8 0x36b8 0x36b8 0x36b8 0x36b8 0x36b8 0x36b8 0x36b8 0x36b8 0x36b8 0x36b8 0x36b8 0x36b8 0x36b8 0x36b8 0x36b8 0x36b8 0x36b8 0x36b8 0x36b8 0x36b8 0x36b8 0x36b8 0x36b8 0x36b8 0x36b8 0x36b8 0x36b8 0x36b8 0x36b8 0x36b8 0x36b8 0x36b8 0x36b8 0x36b8 0x36b8 0x36b8 0x36b8 0x36b8 0x36b8 0x36b8 0x36b8 0x36b8 0x36b8 0x36b8 0x36b8 0x36b8 0x36b8 0x36b8 0x36b8 0x36b8 0x36b8 0x36b8 0x36b8 0x36b8 0x36b8 0x36b8 0x36b8 0x36b8 0x36b8 0x36b8 0x36b8 0x36b8 0x36b8 0x36b8 0x36b8 0x36b8 0x36b8 0x36b8 0x36b8 0x36b8 0x36b8 0x36b8 0x36b8 0x36b8 0x36b8 0x36b8 0x36b8 0x36b8 0x36b8 0x36b8 0x36b8 0x36b8 0x36b8 0x36b8 0x36b8 0x36b8 0x36b8 0x36b8 0x36b8 0x36b8 0x36b8 0x36b8 0x36b8 0x36b8 0x36b8 0x36b8 0x36b8 0x36b8 0x36b8 0x36b8 0x36b8 0x36b8 0x36b8 0x36b8 0x36b8 0x36b8 0x36b8 0x36b8 0x36b8 0x36b8 0x36b8 0x36b8 0x36b8 0x36b8 0x36b8 0x36b8 0x36b8 0x36b8 0x36b8 0x36b8 0x36b8 0x36b8 0x36b8 0x36b8 0x36b8 0x36b8 0x36b8 0x36b8 0x36b8 0x36b8 0x36b8 0x36b8 0x36b8 0x36b8 0x36b8 0x36b8 0x36b8 0x36b8 0x36b8 0x36b8 0x36b8 0x36b8 0x36b8 0x36b8 0x36b8 0x36b8 0x36b8 0x36b8 0x36b8 0x36b8 0x36b8 0x36b8 0x36b8 0x36b8 0x36b8 0x36b8 0x36b8 0x36b8 0x36b8 0x36b8 0x36b8 0x36b8 0x36b8 0x36b8 0x36b8 0x36b8 0x36b8 0x36b8 0x36b8 0x36b8 0x36b8 0x36b8 0x36b8 0x36b8 0x36b8 0x36b8 0x36b8 0x36b8 0x36b8 0x36b8 0x36b8 0x36b8 0x36b8 0x36b8 0x36b8 0x36b8 0x36b8 0x36b8 0x36b8 0x36b8 0x36b8 0x36b8 0x36b8 0x36b8 0x36b8 0x36b8 0x36b8 0x36b8 0x36b8 0x36b8 0x36b8 0x36b8 0x36b8 0x36b8 0x36b8 0x36b8 0x36b8 0x36b8 0x36b8 0x36b8 0x36b8 0x36b8 0x36b8 0x36b8 0x36b8 0x36b8 0x36b8 0x36b8 0x36b8 0x36b8 0x36b8 0x36b8 0x36b8 0x36b8 0x36b8 0x36b8 0x36b8 0x36b8 0x36b8 0x36b8 0x36b8 0x36b8 0x36b8 0x36b8 0x36b8 0x36b8 0x36b8 0x36b8 0x36b8 0x36b8 0x36b8 0x36b8 0x36b8 0x36b8 0x36b8 0x36b8 0x36b8 0x36b8 0x36b8 0x36b8 0x36b8 0x36b8 0x36b8 0x36b8 0x36b8 0x36b8 0x36b8 0x36b8 0x36b8 0x36b8 0x36b8 0x36b8 0x36b8 0x36b8 0x36b8 0x36b8 0x36b8 0x36b8 0x36b8 0x36b8 0x36b8 0x36b8 0x36b8 0x36b8 0x36b8 0x36b8 0x36b8 0x36b8 0x36b8 0x36b8 0x36b8 0x36b8 0x36b8 0x36b8 0x36b8 0x36b8 0x36b8 0x36b8 0x36b8 0x36b8 0x36b8 0x36b8 0x36b8 0x36b8 0x36b8 0x36b8 0x36b8 0x36b8 0x36b8 0x36b8 0x36b8 0x36b8 0x36b8 0x36b8 0x36b8 0x36b8 0x36b8 0x36b8 0x36b8 0x36b8 0x36b8 0x36b8 0x36b8 0x36b8 0x36b8 0x36b8 0x36b8 0x36b8 0x36b8 0x36b8 0x36b8 0x36b8 0x36b8 0x36b8 0x36b8 0x36b8 0x36b8 0x36b8 0x36b8 0x36b8 0x36b8 0x36b8 0x36b8 0x36b8 0x36b8 0x36b8 0x36b8 0x36b8 0x36b8 0x36b8 0x36b8 0x36b8 0x36b8 0x36b8 0x36b8 0x36b8 0x36b8 0x36b8 0x36b8 0x36b8 0x36b8 0x36b8 0x36b8 0x36b8 0x36b8 0x36b8 0x36b8 0x36b8 0x36b8 0x36b8 0x36b8 0x36b8 0x36b8 0x36b8 0x36b8 0x36b8 0x36b8 0x36b8 0x36b8>;
					X_Channel = <0x12>;
					Y_Channel = <0x20>;
					compatible = "novatek-mp-criteria-6232";
				};
			};
		};
	};

	fragment@50 {
		target = <0xffffffff>;

		__overlay__ {
			pinctrl-0 = <0x4d>;
			pinctrl-1 = <0x4e>;
			pinctrl-2 = <0x4f>;
			pinctrl-names = "aw36515default", "aw36515hwen_high", "aw36515hwen_low";
			status = "okay";
		};
	};

	fragment@51 {
		target = <0xffffffff>;

		__overlay__ {

			ocp81375default {
				phandle = <0x50>;
			};

			ocp81375hwen_high {
				phandle = <0x51>;

				pins_cmd_dat {
					output-high;
					pinmux = <0xa900>;
					slew-rate = <0x1>;
				};
			};

			ocp81375hwen_low {
				phandle = <0x52>;

				pins_cmd_dat {
					output-low;
					pinmux = <0xa900>;
					slew-rate = <0x1>;
				};
			};
		};
	};

	fragment@52 {
		target = <0xffffffff>;

		__overlay__ {
			pinctrl-0 = <0x50>;
			pinctrl-1 = <0x51>;
			pinctrl-2 = <0x52>;
			pinctrl-names = "ocp81375default", "ocp81375hwen_high", "ocp81375hwen_low";
			status = "okay";
		};
	};

	fragment@6 {
		target = <0xffffffff>;

		__overlay__ {
			pinctrl-0 = <0x6>;
			pinctrl-1 = <0x7>;
			pinctrl-2 = <0x8>;
			pinctrl-3 = <0x9>;
			pinctrl-4 = <0xa>;
			pinctrl-5 = <0xb>;
			pinctrl-names = "default", "state_eint_as_int", "state_eint_output0", "state_eint_output1", "state_rst_output0", "state_rst_output1";
			status = "okay";
			tpd-filter-custom-prameters = <0x0 0x0 0x0 0x0 0x0 0x0 0x0 0x0 0x0 0x0 0x0 0x0>;
			tpd-filter-custom-speed = <0x0 0x0 0x0>;
			tpd-filter-enable = <0x0>;
			tpd-filter-pixel-density = <0xa8>;
			tpd-key-dim-local = <0x5a 0x373 0x64 0x28 0xe6 0x373 0x64 0x28 0x172 0x373 0x64 0x28 0x0 0x0 0x0 0x0>;
			tpd-key-local = <0x8b 0xac 0x9e 0x0>;
			tpd-key-num = <0x3>;
			tpd-max-touch-num = <0xa>;
			tpd-resolution = <0x2d0 0x668>;
			use-tpd-button = <0x0>;
		};
	};

	fragment@7 {
		target = <0xffffffff>;

		__overlay__ {

			eint0default {
				phandle = <0x6>;
			};

			eint1default {
				phandle = <0x5e>;
			};

			eint@0 {
				phandle = <0x7>;

				pins_cmd_dat {
					bias-disable;
					pinmux = <0x100>;
					slew-rate = <0x0>;
				};
			};

			eintoutput0 {
				phandle = <0x8>;

				pins_cmd_dat {
					output-low;
					pinmux = <0x100>;
					slew-rate = <0x1>;
				};
			};

			eintoutput1 {
				phandle = <0x9>;

				pins_cmd_dat {
					output-high;
					pinmux = <0x100>;
					slew-rate = <0x1>;
				};
			};

			rstoutput0 {
				phandle = <0xa>;

				pins_cmd_dat {
					output-low;
					pinmux = <0x0>;
					slew-rate = <0x1>;
				};
			};

			rstoutput1 {
				phandle = <0xb>;

				pins_cmd_dat {
					output-high;
					pinmux = <0x0>;
					slew-rate = <0x1>;
				};
			};
		};
	};

	fragment@8 {
		target = <0xffffffff>;

		__overlay__ {
			clock-frequency = <0x61a80>;

			mtk-usb@60 {
				compatible = "mediatek,mtk-usb";
				reg = <0x60>;
				status = "okay";
			};
		};
	};

	fragment@9 {
		target = <0xffffffff>;

		__overlay__ {
			accdet-mic-mode = <0x1>;
			accdet-mic-vol = <0x6>;
			accdet-plugout-debounce = <0x1>;
			headset-eint-level-pol = <0x8>;
			headset-four-key-threshold = <0x0 0x3a 0x79 0xc0 0x190>;
			headset-mode-setting = <0x500 0x500 0x1 0x1f0 0x800 0x800 0x20 0x44>;
			headset-three-key-threshold = <0x0 0x50 0xdc 0x190>;
			headset-three-key-threshold-CDD = <0x0 0x79 0xc0 0x258>;
			status = "okay";
		};
	};
};
