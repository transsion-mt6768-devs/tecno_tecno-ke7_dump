/dts-v1/;

/ {
	#address-cells = <0x2>;
	#size-cells = <0x2>;
	compatible = "mediatek,MT6768";
	interrupt-parent = <0x1>;
	model = "MT6768";

	__symbols__ {
		MCDI_CLUSTER = "/cpus/idle-states/mcdi-cluster";
		MCDI_CPU = "/cpus/idle-states/mcdi-cpu";
		STANDBY = "/cpus/idle-states/standby";
		SUSPEND = "/cpus/idle-states/suspend";
		accdet = "/accdet";
		afe = "/mt6768-afe-pcm@11220000";
		apdma = "/dma-controller@11000980";
		apmixed = "/apmixed@1000c000";
		apuart0 = "/serial@11002000";
		apuart1 = "/serial@11003000";
		aud_clk_miso_off = "/pinctrl/aud_clk_miso_off";
		aud_clk_miso_on = "/pinctrl/aud_clk_miso_on";
		aud_clk_mosi_off = "/pinctrl/aud_clk_mosi_off";
		aud_clk_mosi_on = "/pinctrl/aud_clk_mosi_on";
		aud_dat_miso_off = "/pinctrl/aud_dat_miso_off";
		aud_dat_miso_on = "/pinctrl/aud_dat_miso_on";
		aud_dat_mosi_off = "/pinctrl/aud_dat_mosi_off";
		aud_dat_mosi_on = "/pinctrl/aud_dat_mosi_on";
		aud_gpio_i2s0_off = "/pinctrl/aud_gpio_i2s0_off";
		aud_gpio_i2s0_on = "/pinctrl/aud_gpio_i2s0_on";
		aud_gpio_i2s1_off = "/pinctrl/aud_gpio_i2s1_off";
		aud_gpio_i2s1_on = "/pinctrl/aud_gpio_i2s1_on";
		aud_gpio_i2s2_off = "/pinctrl/aud_gpio_i2s2_off";
		aud_gpio_i2s2_on = "/pinctrl/aud_gpio_i2s2_on";
		aud_gpio_i2s3_off = "/pinctrl/aud_gpio_i2s3_off";
		aud_gpio_i2s3_on = "/pinctrl/aud_gpio_i2s3_on";
		audio = "/audio@11220000";
		auxadc = "/auxadc@11001000";
		bat_gm30 = "/battery";
		camsys = "/camsys@1a000000";
		charger = "/charger";
		chosen = "/chosen";
		clk26m = "/clocks/clk26m";
		clk32k = "/clocks/clk32k";
		consys = "/consys@18002000";
		cpu0 = "/cpus/cpu@000";
		cpu1 = "/cpus/cpu@001";
		cpu2 = "/cpus/cpu@002";
		cpu3 = "/cpus/cpu@003";
		cpu4 = "/cpus/cpu@100";
		cpu5 = "/cpus/cpu@101";
		cpu6 = "/cpus/cpu@102";
		cpu7 = "/cpus/cpu@103";
		cpu_dbgapb = "/cpu_dbgapb@0e010000";
		dcm = "/dcm";
		dfd_cache = "/dfd_cache";
		disp_color0 = "/disp_color0@1400f000";
		disp_mutex0 = "/disp_mutex0@14001000";
		doe_dvfs_cl0 = "/cpus/cpu-map/cluster0/doe";
		doe_dvfs_cl1 = "/cpus/cpu-map/cluster1/doe";
		drcc = "/drcc";
		dsi_te = "/dsi_te";
		dvfsp = "/dvfsp@00110800";
		dvfsrc = "/dvfsrc@10012000";
		eem_fsm = "/eem_fsm@1100b000";
		eint = "/apirq@1000b000";
		flashlight_core = "/flashlight_core";
		flashlights_aw36515 = "/flashlights_aw36515";
		flashlights_mt6370 = "/flashlights_mt6370";
		flashlights_ocp81375 = "/flashlights_ocp81375";
		gce = "/gce@10238000";
		gce_mbox = "/gce_mbox@10238000";
		gic = "/interrupt-controller";
		goodix_fp = "/fingerprint";
		gpio = "/gpio@10005000";
		gpio_usage_mapping = "/gpio";
		hwrng = "/hwrng";
		i2c0 = "/i2c0@11007000";
		i2c1 = "/i2c1@11008000";
		i2c2 = "/i2c2@11009000";
		i2c3 = "/i2c3@1100f000";
		i2c4 = "/i2c4@11011000";
		i2c5 = "/i2c5@11016000";
		i2c6 = "/i2c6@1100d000";
		i2c7 = "/i2c7@11004000";
		i2c8 = "/i2c8@11005000";
		i2c_common = "/i2c_common";
		idlebus26m = "/cpus/idle-states/idlebus26m";
		idledram = "/cpus/idle-states/idledram";
		idlesyspll = "/cpus/idle-states/idlesyspll";
		imgsys = "/imgsys@15020000";
		infracfg_ao = "/infracfg_ao@10001000";
		io_cfg_bl = "/io_cfg_bl@10002600";
		io_cfg_lb = "/io_cfg_lb@10002400";
		io_cfg_lm = "/io_cfg_lm@10002200";
		io_cfg_lt = "/io_cfg_lt@10002000";
		io_cfg_rb = "/io_cfg_rb@10002a00";
		io_cfg_rm = "/io_cfg_rm@10002800";
		io_cfg_rt = "/io_cfg_rt@10002c00";
		io_cfg_tl = "/io_cfg_tl@10002e00";
		irq_nfc = "/irq_nfc";
		irtx_pwm = "/irtx_pwm";
		kd_camera_hw1 = "/kd_camera_hw1@1a040000";
		keypad = "/kp@10010000";
		lk_charger = "/lk_charger";
		main_pmic = "/pwrap@1000d000/mt6358-pmic";
		mcdi = "/mcdi@0010fc00";
		mcucfg = "/mcucfg@0c530000";
		md1_sim1_hot_plug_eint = "/md1_sim1_hot_plug_eint";
		md1_sim2_hot_plug_eint = "/md1_sim2_hot_plug_eint";
		md_auxadc = "/md_auxadc";
		mdcldma = "/mdcldma@10014000";
		mdp_ccorr = "/mdp_ccorr0@14005000";
		mdp_rdma0 = "/mdp_rdma0@14004000";
		mdp_rsz0 = "/mdp_rsz0@14006000";
		mdp_rsz1 = "/mdp_rsz1@14007000";
		mdp_tdshp0 = "/mdp_tdshp0@1400a000";
		mdp_wdma0 = "/mdp_wdma0@14008000";
		mdp_wrot0 = "/mdp_wrot0@14009000";
		memory_ssmr_features = "/memory-ssmr-features";
		mfg_cfg = "/mfg_cfg@13000000";
		mipi_rx_ana_csi0a = "/mipi_rx_ana_csi0a@11c10000";
		mipi_rx_ana_csi0b = "/mipi_rx_ana_csi0b@11c11000";
		mipi_rx_ana_csi1a = "/mipi_rx_ana_csi1a@11c12000";
		mipi_rx_ana_csi1b = "/mipi_rx_ana_csi1b@11c13000";
		mipi_rx_ana_csi2a = "/mipi_rx_ana_csi2a@11c14000";
		mipi_rx_ana_csi2b = "/mipi_rx_ana_csi2b@11c15000";
		mmsys_config = "/mmsys_config@14000000";
		mrdump_ext_rst = "/mrdump_ext_rst";
		msdc0 = "/msdc@11230000";
		msdc0_pins_default = "/pinctrl/msdc0@default";
		msdc0_pins_hs200 = "/pinctrl/msdc0@hs200";
		msdc0_pins_hs400 = "/pinctrl/msdc0@hs400";
		msdc0_register_setting_default = "/pinctrl/msdc0@register_default";
		msdc1 = "/msdc@11240000";
		msdc1_pins_ddr50 = "/pinctrl/msdc1@ddr50";
		msdc1_pins_default = "/pinctrl/msdc1@default";
		msdc1_pins_sdr104 = "/pinctrl/msdc1@sdr104";
		msdc1_pins_sdr50 = "/pinctrl/msdc1@sdr50";
		msdc1_register_setting_default = "/pinctrl/msdc1@register_default";
		mt6358_misc = "/pwrap@1000d000/mt6358-pmic/mt6358_misc";
		mt6358_rtc = "/pwrap@1000d000/mt6358-pmic/mt6358_rtc";
		mt6358_snd = "/mt6358_snd";
		mt6358regulator = "/pwrap@1000d000/mt6358-pmic/mt6358regulator";
		mt6370_pmu = "/mt6370_pmu_dts";
		mt6370_typec = "/type_c_port0";
		mt_charger = "/mt_charger";
		mt_cpufreq = "/mt_cpufreq";
		mt_pmic_va09_ldo_reg = "/pwrap@1000d000/mt6358-pmic/mt6358regulator/ldo_va09";
		mt_pmic_va12_ldo_reg = "/pwrap@1000d000/mt6358-pmic/mt6358regulator/ldo_va12";
		mt_pmic_vaud28_ldo_reg = "/pwrap@1000d000/mt6358-pmic/mt6358regulator/ldo_vaud28";
		mt_pmic_vaux18_ldo_reg = "/pwrap@1000d000/mt6358-pmic/mt6358regulator/ldo_vaux18";
		mt_pmic_vbif28_ldo_reg = "/pwrap@1000d000/mt6358-pmic/mt6358regulator/ldo_vbif28";
		mt_pmic_vcama1_ldo_reg = "/pwrap@1000d000/mt6358-pmic/mt6358regulator/ldo_vcama1";
		mt_pmic_vcama2_ldo_reg = "/pwrap@1000d000/mt6358-pmic/mt6358regulator/ldo_vcama2";
		mt_pmic_vcamd_ldo_reg = "/pwrap@1000d000/mt6358-pmic/mt6358regulator/ldo_vcamd";
		mt_pmic_vcamio_ldo_reg = "/pwrap@1000d000/mt6358-pmic/mt6358regulator/ldo_vcamio";
		mt_pmic_vcn18_ldo_reg = "/pwrap@1000d000/mt6358-pmic/mt6358regulator/ldo_vcn18";
		mt_pmic_vcn28_ldo_reg = "/pwrap@1000d000/mt6358-pmic/mt6358regulator/ldo_vcn28";
		mt_pmic_vcn33_bt_ldo_reg = "/pwrap@1000d000/mt6358-pmic/mt6358regulator/ldo_vcn33_bt";
		mt_pmic_vcn33_wifi_ldo_reg = "/pwrap@1000d000/mt6358-pmic/mt6358regulator/ldo_vcn33_wifi";
		mt_pmic_vcore_buck_reg = "/pwrap@1000d000/mt6358-pmic/mt6358regulator/buck_vcore";
		mt_pmic_vdram1_buck_reg = "/pwrap@1000d000/mt6358-pmic/mt6358regulator/buck_vdram1";
		mt_pmic_vdram2_ldo_reg = "/pwrap@1000d000/mt6358-pmic/mt6358regulator/ldo_vdram2";
		mt_pmic_vefuse_ldo_reg = "/pwrap@1000d000/mt6358-pmic/mt6358regulator/ldo_vefuse";
		mt_pmic_vemc_ldo_reg = "/pwrap@1000d000/mt6358-pmic/mt6358regulator/ldo_vemc";
		mt_pmic_vfe28_ldo_reg = "/pwrap@1000d000/mt6358-pmic/mt6358regulator/ldo_vfe28";
		mt_pmic_vgpu_buck_reg = "/pwrap@1000d000/mt6358-pmic/mt6358regulator/buck_vgpu";
		mt_pmic_vibr_ldo_reg = "/pwrap@1000d000/mt6358-pmic/mt6358regulator/ldo_vibr";
		mt_pmic_vio18_ldo_reg = "/pwrap@1000d000/mt6358-pmic/mt6358regulator/ldo_vio18";
		mt_pmic_vio28_ldo_reg = "/pwrap@1000d000/mt6358-pmic/mt6358regulator/ldo_vio28";
		mt_pmic_vldo28_ldo_reg = "/pwrap@1000d000/mt6358-pmic/mt6358regulator/ldo_vldo28";
		mt_pmic_vmc_ldo_reg = "/pwrap@1000d000/mt6358-pmic/mt6358regulator/ldo_vmc";
		mt_pmic_vmch_ldo_reg = "/pwrap@1000d000/mt6358-pmic/mt6358regulator/ldo_vmch";
		mt_pmic_vmodem_buck_reg = "/pwrap@1000d000/mt6358-pmic/mt6358regulator/buck_vmodem";
		mt_pmic_vpa_buck_reg = "/pwrap@1000d000/mt6358-pmic/mt6358regulator/buck_vpa";
		mt_pmic_vproc11_buck_reg = "/pwrap@1000d000/mt6358-pmic/mt6358regulator/buck_vproc11";
		mt_pmic_vproc12_buck_reg = "/pwrap@1000d000/mt6358-pmic/mt6358regulator/buck_vproc12";
		mt_pmic_vrf12_ldo_reg = "/pwrap@1000d000/mt6358-pmic/mt6358regulator/ldo_vrf12";
		mt_pmic_vrf18_ldo_reg = "/pwrap@1000d000/mt6358-pmic/mt6358regulator/ldo_vrf18";
		mt_pmic_vs1_buck_reg = "/pwrap@1000d000/mt6358-pmic/mt6358regulator/buck_vs1";
		mt_pmic_vs2_buck_reg = "/pwrap@1000d000/mt6358-pmic/mt6358regulator/buck_vs2";
		mt_pmic_vsim1_ldo_reg = "/pwrap@1000d000/mt6358-pmic/mt6358regulator/ldo_vsim1";
		mt_pmic_vsim2_ldo_reg = "/pwrap@1000d000/mt6358-pmic/mt6358regulator/ldo_vsim2";
		mt_pmic_vsram_gpu_ldo_reg = "/pwrap@1000d000/mt6358-pmic/mt6358regulator/ldo_vsram_gpu";
		mt_pmic_vsram_others_ldo_reg = "/pwrap@1000d000/mt6358-pmic/mt6358regulator/ldo_vsram_others";
		mt_pmic_vsram_proc11_ldo_reg = "/pwrap@1000d000/mt6358-pmic/mt6358regulator/ldo_vsram_proc11";
		mt_pmic_vsram_proc12_ldo_reg = "/pwrap@1000d000/mt6358-pmic/mt6358regulator/ldo_vsram_proc12";
		mt_pmic_vusb_ldo_reg = "/pwrap@1000d000/mt6358-pmic/mt6358regulator/ldo_vusb";
		mt_pmic_vxo22_ldo_reg = "/pwrap@1000d000/mt6358-pmic/mt6358regulator/ldo_vxo22";
		mtkfb = "/mtkfb@0";
		nfc = "/nfc";
		odm = "/odm";
		otg_iddig = "/otg_iddig";
		pericfg = "/pericfg@10003000";
		pio = "/pinctrl";
		pmic = "/pwrap@1000d000/mt6358-pmic/mt-pmic";
		pmic_auxadc = "/pwrap@1000d000/mt6358-pmic/mt635x-auxadc";
		pmic_clock_buffer_ctrl = "/pmic_clock_buffer_ctrl";
		pwrap = "/pwrap@1000d000";
		pwraph = "/pwraphal@";
		radio_md_cfg = "/radio_md_cfg";
		reserved_memory = "/reserved-memory";
		scpsys = "/scpsys@10001000";
		sleep = "/sleep@10006000";
		smart_pa = "/smart_pa";
		smi_larb0 = "/smi_larb0@14003000";
		smi_larb1 = "/smi_larb1@16010000";
		smi_larb2 = "/smi_larb2@15021000";
		smi_larb3 = "/smi_larb3@1a002000";
		smi_larb4 = "/smi_larb4@17010000";
		snd_scp_spk = "/snd_scp_spk";
		sound = "/sound";
		spi0 = "/spi0@1100a000";
		spi1 = "/spi1@11010000";
		spi2 = "/spi2@11012000";
		spi3 = "/spi3@11013000";
		spi4 = "/spi4@11014000";
		spi5 = "/spi5@11015000";
		sysirq = "/intpol-controller@0";
		tboard_thermistor1 = "/thermal-sensor1";
		tboard_thermistor2 = "/thermal-sensor2";
		timer = "/timer";
		topckgen = "/topckgen@10000000";
		toprgu = "/toprgu@10007000";
		touch = "/touch";
		tran_battery = "/tran_battery";
		vcu = "/vcu@16000000";
		vdec_gcon = "/vdec_gcon@16000000";
		venc_gcon = "/venc_gcon@17000000";
		vow_clk_miso_off = "/pinctrl/vow_clk_miso_off";
		vow_clk_miso_on = "/pinctrl/vow_clk_miso_on";
		vow_dat_miso_off = "/pinctrl/vow_dat_miso_off";
		vow_dat_miso_on = "/pinctrl/vow_dat_miso_on";
	};

	accdet {
		compatible = "mediatek,pmic-accdet";
		phandle = <0xa7>;
	};

	aes_top0@10016000 {
		compatible = "mediatek,aes_top0";
		reg = <0x0 0x10016000 0x0 0x1000>;
	};

	amms_control {
		compatible = "mediatek,amms";
		interrupts = <0x0 0x131 0x1>;
	};

	ap_ccif0@10209000 {
		compatible = "mediatek,ap_ccif0";
		interrupts = <0x0 0xa4 0x8>;
		reg = <0x0 0x10209000 0x0 0x1000>;
	};

	ap_ccif1@1020b000 {
		compatible = "mediatek,ap_ccif1";
		interrupts = <0x0 0xa6 0x8>;
		reg = <0x0 0x1020b000 0x0 0x1000>;
	};

	ap_ccif2@1023c000 {
		compatible = "mediatek,ap_ccif2";
		interrupts = <0x0 0xa0 0x8>;
		reg = <0x0 0x1023c000 0x0 0x1000>;
	};

	ap_ccif3@1023e000 {
		compatible = "mediatek,ap_ccif3";
		interrupts = <0x0 0xa3 0x8>;
		reg = <0x0 0x1023e000 0x0 0x1000>;
	};

	ap_dma@11000000 {
		compatible = "mediatek,ap_dma";
		interrupts = <0x0 0x66 0x8>;
		reg = <0x0 0x11000000 0x0 0x1000>;
	};

	apcldmain@1021b000 {
		compatible = "mediatek,apcldmain";
		reg = <0x0 0x1021b000 0x0 0x100>;
	};

	apcldmain@1021b100 {
		compatible = "mediatek,apcldmain";
		reg = <0x0 0x1021b100 0x0 0x100>;
	};

	apcldmain_ao@10014000 {
		compatible = "mediatek,apcldmain_ao";
		reg = <0x0 0x10014000 0x0 0x400>;
	};

	apcldmamisc@1021b800 {
		compatible = "mediatek,apcldmamisc";
		interrupts = <0x0 0xb4 0x4>;
		reg = <0x0 0x1021b800 0x0 0x100>;
	};

	apcldmamisc@1021b900 {
		compatible = "mediatek,apcldmamisc";
		reg = <0x0 0x1021b900 0x0 0x400>;
	};

	apcldmamisc_ao@10014800 {
		compatible = "mediatek,apcldmamisc_ao";
		reg = <0x0 0x10014800 0x0 0x400>;
	};

	apcldmamisc_ao@10014c00 {
		compatible = "mediatek,apcldmamisc_ao";
		reg = <0x0 0x10014c00 0x0 0x400>;
	};

	apcldmaout@1021b400 {
		compatible = "mediatek,apcldmaout";
		reg = <0x0 0x1021b400 0x0 0x100>;
	};

	apcldmaout@1021b500 {
		compatible = "mediatek,apcldmaout";
		reg = <0x0 0x1021b500 0x0 0x100>;
	};

	apcldmaout_ao@10014400 {
		compatible = "mediatek,apcldmaout_ao";
		reg = <0x0 0x10014400 0x0 0x400>;
	};

	apirq@1000b000 {
		compatible = "mediatek,apirq";
		interrupts = <0x0 0xba 0x4>;
		phandle = <0x1d>;
		reg = <0x0 0x1000b000 0x0 0x1000>;
	};

	apmixed@1000c000 {
		#clock-cells = <0x1>;
		compatible = "mediatek,apmixed", "syscon";
		phandle = <0x3c>;
		reg = <0x0 0x1000c000 0x0 0x1000>;
	};

	apxgpt@10008000 {
		clocks = <0x1f>;
		compatible = "mediatek,apxgpt";
		interrupts = <0x0 0xb9 0x8>;
		reg = <0x0 0x10008000 0x0 0x1000>;
	};

	atf_logger {
		compatible = "mediatek,atf_logger";
		interrupts = <0x0 0x128 0x1>;
	};

	audio@11220000 {
		#clock-cells = <0x1>;
		compatible = "mediatek,audio", "syscon";
		phandle = <0x3d>;
		reg = <0x0 0x11220000 0x0 0x1000>;
	};

	audio_sram@11221000 {
		block_size = <0x1000>;
		compatible = "mediatek,audio_sram";
		mode_size = <0x6c00 0x9000>;
		prefer_mode = <0x1>;
		reg = <0x0 0x11221000 0x0 0x9000>;
	};

	auxadc@11001000 {
		#io-channel-cells = <0x1>;
		clock-names = "main";
		clocks = <0x21 0x21>;
		compatible = "mediatek,mt6768-auxadc";
		interrupts = <0x0 0x42 0x2>;
		mediatek,cali-efuse-index = <0x6a>;
		mediatek,cali-en-bit = <0x14>;
		mediatek,cali-ge-bit = <0xa>;
		mediatek,cali-oe-bit = <0x0>;
		phandle = <0x23>;
		reg = <0x0 0x11001000 0x0 0x1000>;
	};

	battery {
		ACTIVE_TABLE = <0x6>;
		CAR_TUNE_VALUE = <0x64>;
		COM_FG_METER_RESISTANCE = <0x64>;
		COM_R_FG_VALUE = <0x0>;
		DIFFERENCE_FULLOCV_ITH = <0xc8>;
		EMBEDDED_SEL = <0x1>;
		FG_METER_RESISTANCE = <0x64>;
		KEEP_100_PERCENT = <0x1>;
		MULTI_TEMP_GAUGE0 = <0x1>;
		PMIC_MIN_VOL = <0x82dc>;
		PMIC_SHUTDOWN_CURRENT = <0x14>;
		POWERON_SYSTEM_IBOOT = <0x1f4>;
		Q_MAX_SYS_VOLTAGE_BAT0 = <0xd16>;
		Q_MAX_SYS_VOLTAGE_BAT1 = <0xd16>;
		Q_MAX_SYS_VOLTAGE_BAT2 = <0xd16>;
		Q_MAX_SYS_VOLTAGE_BAT3 = <0xd16>;
		R_FG_VALUE = <0xa>;
		SHUTDOWN_1_TIME = <0x1e>;
		SHUTDOWN_GAUGE0_VOLTAGE = <0x84d0>;
		SHUTDOWN_GAUGE1_VBAT_EN = <0x1>;
		TEMPERATURE_T0 = <0x32>;
		TEMPERATURE_T1 = <0x19>;
		TEMPERATURE_T2 = <0xa>;
		TEMPERATURE_T3 = <0x0>;
		TEMPERATURE_T4 = <0xfffffffa>;
		TEMPERATURE_T5 = <0xfffffff6>;
		UI_LOW_LIMIT_SOC0 = <0xc8>;
		UI_LOW_LIMIT_SOC1 = <0xc8>;
		UI_LOW_LIMIT_SOC2 = <0xc8>;
		UI_LOW_LIMIT_SOC3 = <0xc8>;
		UI_LOW_LIMIT_SOC4 = <0xc8>;
		UI_LOW_LIMIT_VTH0 = <0x86c4>;
		UI_LOW_LIMIT_VTH1 = <0x86c4>;
		UI_LOW_LIMIT_VTH2 = <0x86c4>;
		UI_LOW_LIMIT_VTH3 = <0x86c4>;
		UI_LOW_LIMIT_VTH4 = <0x86c4>;
		battery0_profile_t0 = <0x0 0xaae6 0x406 0x1f7 0xaa11 0x406 0x3ee 0xa95f 0x406 0x5e6 0xa8c5 0x406 0x7dd 0xa838 0x406 0x9d4 0xa7b2 0x406 0xbcb 0xa732 0x406 0xdc3 0xa6b3 0x406 0xfba 0xa633 0x3ed 0x11b1 0xa5b9 0x3fc 0x13a8 0xa542 0x406 0x15a0 0xa4cb 0x406 0x1797 0xa453 0x406 0x198e 0xa3dc 0x406 0x1b85 0xa364 0x406 0x1d7d 0xa2f5 0x416 0x1f74 0xa280 0x40d 0x216b 0xa20d 0x410 0x2362 0xa19e 0x41a 0x255a 0xa130 0x41a 0x2751 0xa0c1 0x41a 0x2948 0xa052 0x41a 0x2b3f 0x9fe3 0x41a 0x2d36 0x9f7a 0x41a 0x2f2e 0x9f0f 0x41a 0x3125 0x9ea4 0x41a 0x331c 0x9e3f 0x41f 0x3513 0x9de1 0x437 0x370b 0x9d7b 0x41e 0x3902 0x9d1c 0x430 0x3af9 0x9cbe 0x438 0x3cf0 0x9c60 0x42b 0x3ee8 0x9c05 0x423 0x40df 0x9bb0 0x438 0x42d6 0x9b5b 0x438 0x44cd 0x9b05 0x438 0x46c5 0x9ab7 0x446 0x48bc 0x9a6a 0x45d 0x4ab3 0x9a1e 0x46a 0x4caa 0x99d1 0x46f 0x4ea1 0x9985 0x481 0x5099 0x9941 0x49b 0x5290 0x98f5 0x4c5 0x5487 0x989a 0x4ce 0x567e 0x981d 0x48a 0x5876 0x9790 0x432 0x5a6d 0x9715 0x406 0x5c64 0x96c2 0x406 0x5e5b 0x967d 0x406 0x6053 0x9641 0x406 0x624a 0x9605 0x3f3 0x6441 0x95cf 0x3e8 0x6638 0x959f 0x3f2 0x6830 0x9574 0x406 0x6a27 0x9549 0x406 0x6c1e 0x9516 0x406 0x6e15 0x94f2 0x406 0x700d 0x94ca 0x406 0x7204 0x94a4 0x406 0x73fb 0x9481 0x40c 0x75f2 0x945f 0x41a 0x77e9 0x943d 0x41a 0x79e1 0x941b 0x409 0x7bd8 0x9400 0x414 0x7dcf 0x93e7 0x42b 0x7fc6 0x93cd 0x438 0x81be 0x93b6 0x43e 0x83b5 0x93a4 0x44c 0x85ac 0x938a 0x44c 0x87a3 0x9371 0x44c 0x899b 0x9350 0x44c 0x8b92 0x9318 0x431 0x8d89 0x92d4 0x412 0x8f80 0x9295 0x406 0x9178 0x9264 0x408 0x936f 0x9242 0x419 0x9566 0x9217 0x40a 0x975d 0x91ed 0x406 0x9954 0x91c7 0x410 0x9b4c 0x91a5 0x41a 0x9d43 0x9183 0x421 0x9f3a 0x9160 0x438 0xa131 0x912c 0x438 0xa329 0x90ea 0x421 0xa520 0x90ac 0x42d 0xa717 0x9070 0x442 0xa90e 0x902a 0x43b 0xab06 0x8fdd 0x41a 0xacfd 0x8fab 0x41b 0xaef4 0x8f9a 0x435 0xb0eb 0x8f91 0x447 0xb2e3 0x8f82 0x46a 0xb4da 0x8f6c 0x4a2 0xb6d1 0x8f37 0x4d4 0xb8c8 0x8e9c 0x4d7 0xbac0 0x8d1a 0x49d 0xbcb7 0x8ae7 0x4d9 0xbeae 0x87dd 0x53f 0xc0a5 0x86ce 0x564 0xc29c 0x86ce 0x564>;
		battery0_profile_t0_col = <0x3>;
		battery0_profile_t0_num = <0x64>;
		battery0_profile_t1 = <0x0 0xab68 0x578 0x1f7 0xaa75 0x578 0x3ee 0xa9b1 0x56a 0x5e6 0xa90d 0x564 0x7dd 0xa87a 0x564 0x9d4 0xa7ed 0x55e 0xbcb 0xa767 0x546 0xdc3 0xa6ea 0x546 0xfba 0xa66c 0x546 0x11b1 0xa5f4 0x546 0x13a8 0xa57a 0x546 0x15a0 0xa4ff 0x546 0x1797 0xa489 0x546 0x198e 0xa414 0x546 0x1b85 0xa39f 0x546 0x1d7d 0xa329 0x546 0x1f74 0xa2b8 0x552 0x216b 0xa249 0x55c 0x2362 0xa1d3 0x546 0x255a 0xa15e 0x546 0x2751 0xa0f0 0x546 0x2948 0xa083 0x546 0x2b3f 0xa016 0x546 0x2d36 0x9fa9 0x546 0x2f2e 0x9f3f 0x54a 0x3125 0x9ee2 0x563 0x331c 0x9e8e 0x574 0x3513 0x9e2e 0x578 0x370b 0x9db6 0x56e 0x3902 0x9d33 0x564 0x3af9 0x9cba 0x564 0x3cf0 0x9c55 0x564 0x3ee8 0x9c12 0x58d 0x40df 0x9bcf 0x596 0x42d6 0x9b87 0x5a0 0x44cd 0x9b38 0x5aa 0x46c5 0x9ae6 0x5af 0x48bc 0x9a9a 0x5c8 0x4ab3 0x9a4f 0x5d9 0x4caa 0x9a03 0x5f1 0x4ea1 0x99b8 0x605 0x5099 0x996c 0x619 0x5290 0x9921 0x637 0x5487 0x98d3 0x65a 0x567e 0x9866 0x617 0x5876 0x97e4 0x5c5 0x5a6d 0x9763 0x566 0x5c64 0x96f6 0x526 0x5e5b 0x96a1 0x514 0x6053 0x965e 0x512 0x624a 0x9624 0x502 0x6441 0x95e9 0x500 0x6638 0x95ba 0x50c 0x6830 0x958c 0x50b 0x6a27 0x955c 0x500 0x6c1e 0x9533 0x500 0x6e15 0x9509 0x500 0x700d 0x94e7 0x510 0x7204 0x94bf 0x514 0x73fb 0x9499 0x514 0x75f2 0x947b 0x51d 0x77e9 0x9460 0x532 0x79e1 0x943f 0x532 0x7bd8 0x9426 0x532 0x7dcf 0x940c 0x53f 0x7fc6 0x93f3 0x546 0x81be 0x93da 0x546 0x83b5 0x93c3 0x54b 0x85ac 0x93b2 0x564 0x87a3 0x93a1 0x564 0x899b 0x9389 0x564 0x8b92 0x9376 0x56e 0x8d89 0x935e 0x566 0x8f80 0x933c 0x546 0x9178 0x931a 0x546 0x936f 0x92f9 0x546 0x9566 0x92d0 0x546 0x975d 0x92a6 0x546 0x9954 0x9280 0x55a 0x9b4c 0x925f 0x578 0x9d43 0x923d 0x57a 0x9f3a 0x9213 0x593 0xa131 0x91e9 0x5a5 0xa329 0x91ad 0x5aa 0xa520 0x916a 0x5aa 0xa717 0x912a 0x5b7 0xa90e 0x90ed 0x5df 0xab06 0x90a1 0x5f8 0xacfd 0x904e 0x5fa 0xaef4 0x9026 0x619 0xb0eb 0x9011 0x643 0xb2e3 0x9000 0x672 0xb4da 0x8fee 0x6b1 0xb6d1 0x8fd5 0x705 0xb8c8 0x8f9b 0x781 0xbac0 0x8ed3 0x7df 0xbcb7 0x8d3b 0x84b 0xbeae 0x8ad3 0x929 0xc0a5 0x8781 0xb11 0xc29c 0x82a0 0xec4>;
		battery0_profile_t1_col = <0x3>;
		battery0_profile_t1_num = <0x64>;
		battery0_profile_t2 = <0x0 0xab0e 0xc08 0x1f7 0xaa34 0xc08 0x3ee 0xa983 0xbf4 0x5e6 0xa8e5 0xbd0 0x7dd 0xa855 0xba6 0x9d4 0xa7d1 0xb82 0xbcb 0xa753 0xb70 0xdc3 0xa6d5 0xb46 0xfba 0xa658 0xb1d 0x11b1 0xa5df 0xafe 0x13a8 0xa56a 0xae8 0x15a0 0xa4f5 0xad5 0x1797 0xa47f 0xabb 0x198e 0xa40a 0xa91 0x1b85 0xa394 0xa7d 0x1d7d 0xa31f 0xa55 0x1f74 0xa2ae 0xa34 0x216b 0xa241 0xa28 0x2362 0xa1d3 0xa26 0x255a 0xa15d 0xa15 0x2751 0xa0f0 0x9fd 0x2948 0xa083 0x9f6 0x2b3f 0xa01a 0x9f6 0x2d36 0x9fb8 0x9ff 0x2f2e 0x9f5f 0xa1d 0x3125 0x9f13 0xa58 0x331c 0x9eb8 0xa72 0x3513 0x9e42 0xa58 0x370b 0x9db6 0xa29 0x3902 0x9d22 0x9fd 0x3af9 0x9c98 0x9dd 0x3cf0 0x9c23 0x9c4 0x3ee8 0x9bc6 0x9dd 0x40df 0x9b7e 0xa04 0x42d6 0x9b40 0xa2e 0x44cd 0x9b02 0xa46 0x46c5 0x9abf 0xa4a 0x48bc 0x9a7b 0xa5a 0x4ab3 0x9a30 0xa5a 0x4caa 0x99dd 0xa5a 0x4ea1 0x998a 0xa5a 0x5099 0x9932 0xa47 0x5290 0x98d1 0xa19 0x5487 0x9864 0x9dd 0x567e 0x97f7 0x99a 0x5876 0x978a 0x948 0x5a6d 0x9729 0x911 0x5c64 0x96d1 0x8f4 0x5e5b 0x9682 0x8e0 0x6053 0x9640 0x8ca 0x624a 0x9605 0x8ca 0x6441 0x95d2 0x8e1 0x6638 0x95a0 0x8e8 0x6830 0x9572 0x8f1 0x6a27 0x9548 0x8fc 0x6c1e 0x951e 0x900 0x6e15 0x94f4 0x919 0x700d 0x94ca 0x91a 0x7204 0x94a6 0x91a 0x73fb 0x9485 0x924 0x75f2 0x9463 0x92e 0x77e9 0x9443 0x933 0x79e1 0x942a 0x94c 0x7bd8 0x9411 0x95d 0x7dcf 0x93f8 0x974 0x7fc6 0x93e4 0x988 0x81be 0x93d3 0x99c 0x83b5 0x93c4 0x9bd 0x85ac 0x93bc 0x9f7 0x87a3 0x93ab 0xa21 0x899b 0x93a1 0xa4b 0x8b92 0x9393 0xa85 0x8d89 0x9382 0xabd 0x8f80 0x9370 0xae7 0x9178 0x9356 0xb11 0x936f 0x933d 0xb3b 0x9566 0x931d 0xb73 0x975d 0x92fb 0xbb4 0x9954 0x92d6 0xbea 0x9b4c 0x92ac 0xc21 0x9d43 0x9281 0xc75 0x9f3a 0x924e 0xcc9 0xa131 0x921c 0xd2c 0xa329 0x91e4 0xd96 0xa520 0x91a5 0xe0c 0xa717 0x9162 0xe90 0xa90e 0x911c 0xf1c 0xab06 0x90c8 0xf9a 0xacfd 0x907c 0x103f 0xaef4 0x9044 0x1119 0xb0eb 0x9020 0x122f 0xb2e3 0x9004 0x1378 0xb4da 0x8fdf 0x14f5 0xb6d1 0x8fad 0x16d3 0xb8c8 0x8f62 0x1970 0xbac0 0x8eb2 0x1c86 0xbcb7 0x8d52 0x2081 0xbeae 0x8b26 0x26a3 0xc0a5 0x880f 0x3088 0xc29c 0x83d6 0x3f16>;
		battery0_profile_t2_col = <0x3>;
		battery0_profile_t2_num = <0x64>;
		battery0_profile_t3 = <0x0 0xab22 0x1ba8 0x1f7 0xaa16 0x1ba8 0x3ee 0xa939 0x1b64 0x5e6 0xa87c 0x1b11 0x7dd 0xa7d6 0x1ab9 0x9d4 0xa741 0x1a5f 0xbcb 0xa6b3 0x1a0b 0xdc3 0xa624 0x19c0 0xfba 0xa59d 0x197b 0x11b1 0xa517 0x1923 0x13a8 0xa494 0x18cd 0x15a0 0xa419 0x188c 0x1797 0xa3a4 0x1851 0x198e 0xa32e 0x180e 0x1b85 0xa2b9 0x17d2 0x1d7d 0xa244 0x1792 0x1f74 0xa1d2 0x175b 0x216b 0xa163 0x172c 0x2362 0xa0ee 0x16f3 0x255a 0xa081 0x16ca 0x2751 0xa02b 0x16c6 0x2948 0x9fd1 0x16c0 0x2b3f 0x9f75 0x16bc 0x2d36 0x9f0e 0x16a8 0x2f2e 0x9e8f 0x166e 0x3125 0x9e08 0x1633 0x331c 0x9d7a 0x15c8 0x3513 0x9cf8 0x1581 0x370b 0x9c7f 0x1550 0x3902 0x9c10 0x152d 0x3af9 0x9bb0 0x151d 0x3cf0 0x9b65 0x1536 0x3ee8 0x9b19 0x1547 0x40df 0x9ace 0x155e 0x42d6 0x9a83 0x1568 0x44cd 0x9a37 0x1568 0x46c5 0x99ea 0x1563 0x48bc 0x9996 0x1549 0x4ab3 0x993a 0x151f 0x4caa 0x98e4 0x1518 0x4ea1 0x988b 0x14fd 0x5099 0x982f 0x14d3 0x5290 0x97d3 0x14aa 0x5487 0x9777 0x1480 0x567e 0x971a 0x1456 0x5876 0x96cd 0x1450 0x5a6d 0x9681 0x1434 0x5c64 0x963a 0x141e 0x5e5b 0x95f9 0x142a 0x6053 0x95bf 0x1450 0x624a 0x9584 0x1450 0x6441 0x9551 0x1450 0x6638 0x9524 0x146e 0x6830 0x94fa 0x148f 0x6a27 0x94d3 0x14ad 0x6c1e 0x94b2 0x14da 0x6e15 0x9490 0x1514 0x700d 0x9476 0x153f 0x7204 0x945d 0x157c 0x73fb 0x9449 0x15d1 0x75f2 0x9438 0x1630 0x77e9 0x9427 0x1688 0x79e1 0x9416 0x16f5 0x7bd8 0x9406 0x175a 0x7dcf 0x93fb 0x17e5 0x7fc6 0x93ee 0x186e 0x81be 0x93dd 0x18eb 0x83b5 0x93cd 0x1971 0x85ac 0x93bc 0x1a19 0x87a3 0x93ab 0x1a97 0x899b 0x939a 0x1b36 0x8b92 0x938a 0x1be8 0x8d89 0x9375 0x1c9a 0x8f80 0x935c 0x1d47 0x9178 0x9343 0x1e08 0x936f 0x932a 0x1ec0 0x9566 0x9302 0x1f80 0x975d 0x92de 0x2067 0x9954 0x92b9 0x2157 0x9b4c 0x928c 0x2240 0x9d43 0x9259 0x233c 0x9f3a 0x921f 0x2438 0xa131 0x91e4 0x257d 0xa329 0x91a9 0x26cd 0xa520 0x916a 0x281c 0xa717 0x912a 0x2985 0xa90e 0x90ef 0x2b26 0xab06 0x90b5 0x2cb9 0xacfd 0x9072 0x2e5a 0xaef4 0x903b 0x3028 0xb0eb 0x9009 0x3221 0xb2e3 0x8fd7 0x343d 0xb4da 0x8fa2 0x367c 0xb6d1 0x8f5f 0x390a 0xb8c8 0x8ef4 0x3c20 0xbac0 0x8e27 0x3faa 0xbcb7 0x8cb1 0x446a 0xbeae 0x8a67 0x4c01 0xc0a5 0x872f 0x54fa 0xc29c 0x83e0 0x50aa>;
		battery0_profile_t3_col = <0x3>;
		battery0_profile_t3_num = <0x64>;
		battery0_profile_t4 = <0x0 0xab72 0x353e 0x1f7 0xaa23 0x353e 0x3ee 0xa903 0x34a2 0x5e6 0xa80d 0x33a4 0x7dd 0xa735 0x3289 0x9d4 0xa670 0x3177 0xbcb 0xa5b8 0x3053 0xdc3 0xa510 0x2f57 0xfba 0xa46f 0x2e5c 0x11b1 0xa3db 0x2d86 0x13a8 0xa350 0x2cd1 0x15a0 0xa2ca 0x2c1a 0x1797 0xa245 0x2b3d 0x198e 0xa1c7 0x2aa6 0x1b85 0xa151 0x2a25 0x1d7d 0xa0ed 0x29c4 0x1f74 0xa088 0x2971 0x216b 0xa01b 0x2910 0x2362 0x9fab 0x2890 0x255a 0x9f25 0x2802 0x2751 0x9e97 0x276c 0x2948 0x9e0f 0x26c9 0x2b3f 0x9d8d 0x2645 0x2d36 0x9d12 0x25dd 0x2f2e 0x9c9f 0x2578 0x3125 0x9c3b 0x253d 0x331c 0x9be6 0x2512 0x3513 0x9b99 0x24f5 0x370b 0x9b4d 0x24ea 0x3902 0x9aff 0x24e4 0x3af9 0x9aab 0x24ce 0x3cf0 0x9a57 0x24a4 0x3ee8 0x9a03 0x248b 0x40df 0x99af 0x2465 0x42d6 0x995b 0x2454 0x44cd 0x9908 0x244d 0x46c5 0x98b2 0x2437 0x48bc 0x9856 0x240e 0x4ab3 0x9802 0x240e 0x4caa 0x97ae 0x23f9 0x4ea1 0x9760 0x23e5 0x5099 0x9714 0x23d1 0x5290 0x96c9 0x23ba 0x5487 0x967e 0x23aa 0x567e 0x963b 0x23aa 0x5876 0x95ff 0x23aa 0x5a6d 0x95c4 0x23aa 0x5c64 0x9592 0x23c6 0x5e5b 0x9568 0x23fc 0x6053 0x953e 0x2426 0x624a 0x9514 0x2450 0x6441 0x94f9 0x2491 0x6638 0x94e0 0x24eb 0x6830 0x94c7 0x2554 0x6a27 0x94ae 0x25b9 0x6c1e 0x9496 0x2613 0x6e15 0x9485 0x2690 0x700d 0x9474 0x271e 0x7204 0x9463 0x2793 0x73fb 0x9453 0x2813 0x75f2 0x9442 0x28aa 0x77e9 0x9431 0x294b 0x79e1 0x9420 0x29c9 0x7bd8 0x9410 0x2a6f 0x7dcf 0x93ff 0x2b17 0x7fc6 0x93ee 0x2bcd 0x81be 0x93da 0x2c7a 0x83b5 0x93c3 0x2d16 0x85ac 0x93b2 0x2de8 0x87a3 0x93a1 0x2ea9 0x899b 0x9389 0x2f55 0x8b92 0x9376 0x3017 0x8d89 0x9361 0x30e8 0x8f80 0x9346 0x31b0 0x9178 0x9325 0x325a 0x936f 0x930c 0x333d 0x9566 0x92eb 0x3403 0x975d 0x92ca 0x34cf 0x9954 0x92a4 0x35a8 0x9b4c 0x9278 0x3686 0x9d43 0x9246 0x3757 0x9f3a 0x9214 0x3829 0xa131 0x91e1 0x3911 0xa329 0x91a9 0x3a24 0xa520 0x916a 0x3b35 0xa717 0x912a 0x3c4f 0xa90e 0x90ef 0x3db1 0xab06 0x90b4 0x3f19 0xacfd 0x907a 0x40a1 0xaef4 0x9045 0x427a 0xb0eb 0x9013 0x44ac 0xb2e3 0x8fe1 0x4733 0xb4da 0x8fad 0x4a15 0xb6d1 0x8f72 0x4d85 0xb8c8 0x8eff 0x51f7 0xbac0 0x8e29 0x57db 0xbcb7 0x8cbb 0x601b 0xbeae 0x8aac 0x61ad 0xc0a5 0x877d 0x59b7 0xc29c 0x846c 0x5226>;
		battery0_profile_t4_col = <0x3>;
		battery0_profile_t4_num = <0x64>;
		battery0_profile_t5 = <0x0 0xab72 0x353e 0x1f7 0xaa23 0x353e 0x3ee 0xa903 0x34a2 0x5e6 0xa80d 0x33a4 0x7dd 0xa735 0x3289 0x9d4 0xa670 0x3177 0xbcb 0xa5b8 0x3053 0xdc3 0xa510 0x2f57 0xfba 0xa46f 0x2e5c 0x11b1 0xa3db 0x2d86 0x13a8 0xa350 0x2cd1 0x15a0 0xa2ca 0x2c1a 0x1797 0xa245 0x2b3d 0x198e 0xa1c7 0x2aa6 0x1b85 0xa151 0x2a25 0x1d7d 0xa0ed 0x29c4 0x1f74 0xa088 0x2971 0x216b 0xa01b 0x2910 0x2362 0x9fab 0x2890 0x255a 0x9f25 0x2802 0x2751 0x9e97 0x276c 0x2948 0x9e0f 0x26c9 0x2b3f 0x9d8d 0x2645 0x2d36 0x9d12 0x25dd 0x2f2e 0x9c9f 0x2578 0x3125 0x9c3b 0x253d 0x331c 0x9be6 0x2512 0x3513 0x9b99 0x24f5 0x370b 0x9b4d 0x24ea 0x3902 0x9aff 0x24e4 0x3af9 0x9aab 0x24ce 0x3cf0 0x9a57 0x24a4 0x3ee8 0x9a03 0x248b 0x40df 0x99af 0x2465 0x42d6 0x995b 0x2454 0x44cd 0x9908 0x244d 0x46c5 0x98b2 0x2437 0x48bc 0x9856 0x240e 0x4ab3 0x9802 0x240e 0x4caa 0x97ae 0x23f9 0x4ea1 0x9760 0x23e5 0x5099 0x9714 0x23d1 0x5290 0x96c9 0x23ba 0x5487 0x967e 0x23aa 0x567e 0x963b 0x23aa 0x5876 0x95ff 0x23aa 0x5a6d 0x95c4 0x23aa 0x5c64 0x9592 0x23c6 0x5e5b 0x9568 0x23fc 0x6053 0x953e 0x2426 0x624a 0x9514 0x2450 0x6441 0x94f9 0x2491 0x6638 0x94e0 0x24eb 0x6830 0x94c7 0x2554 0x6a27 0x94ae 0x25b9 0x6c1e 0x9496 0x2613 0x6e15 0x9485 0x2690 0x700d 0x9474 0x271e 0x7204 0x9463 0x2793 0x73fb 0x9453 0x2813 0x75f2 0x9442 0x28aa 0x77e9 0x9431 0x294b 0x79e1 0x9420 0x29c9 0x7bd8 0x9410 0x2a6f 0x7dcf 0x93ff 0x2b17 0x7fc6 0x93ee 0x2bcd 0x81be 0x93da 0x2c7a 0x83b5 0x93c3 0x2d16 0x85ac 0x93b2 0x2de8 0x87a3 0x93a1 0x2ea9 0x899b 0x9389 0x2f55 0x8b92 0x9376 0x3017 0x8d89 0x9361 0x30e8 0x8f80 0x9346 0x31b0 0x9178 0x9325 0x325a 0x936f 0x930c 0x333d 0x9566 0x92eb 0x3403 0x975d 0x92ca 0x34cf 0x9954 0x92a4 0x35a8 0x9b4c 0x9278 0x3686 0x9d43 0x9246 0x3757 0x9f3a 0x9214 0x3829 0xa131 0x91e1 0x3911 0xa329 0x91a9 0x3a24 0xa520 0x916a 0x3b35 0xa717 0x912a 0x3c4f 0xa90e 0x90ef 0x3db1 0xab06 0x90b4 0x3f19 0xacfd 0x907a 0x40a1 0xaef4 0x9045 0x427a 0xb0eb 0x9013 0x44ac 0xb2e3 0x8fe1 0x4733 0xb4da 0x8fad 0x4a15 0xb6d1 0x8f72 0x4d85 0xb8c8 0x8eff 0x51f7 0xbac0 0x8e29 0x57db 0xbcb7 0x8cbb 0x601b 0xbeae 0x8aac 0x61ad 0xc0a5 0x877d 0x59b7 0xc29c 0x846c 0x5226>;
		battery0_profile_t5_col = <0x3>;
		battery0_profile_t5_num = <0x64>;
		battery1_profile_t0 = <0x0 0xab6c 0x3d2 0x1f0 0xaacc 0x3d1 0x3e0 0xaa48 0x3cc 0x5d0 0xa9cb 0x3c7 0x7c0 0xa954 0x3c0 0x9b0 0xa8e0 0x3c0 0xba0 0xa86c 0x3c2 0xd90 0xa7f7 0x3c0 0xf80 0xa783 0x3c0 0x1170 0xa70d 0x3bd 0x1360 0xa698 0x3bb 0x1550 0xa626 0x3bc 0x1740 0xa5b4 0x3c0 0x192f 0xa542 0x3c2 0x1b1f 0xa4ce 0x3c0 0x1d0f 0xa45d 0x3c3 0x1eff 0xa3eb 0x3c3 0x20ef 0xa37b 0x3c5 0x22df 0xa30b 0x3c8 0x24cf 0xa29b 0x3cb 0x26bf 0xa22e 0x3d0 0x28af 0xa1c1 0x3d2 0x2a9f 0xa154 0x3d3 0x2c8f 0xa0e7 0x3d2 0x2e7f 0xa07d 0x3d5 0x306f 0xa015 0x3da 0x325f 0x9fad 0x3df 0x344f 0x9f46 0x3e1 0x363f 0x9ee1 0x3e4 0x382f 0x9e7e 0x3e8 0x3a1f 0x9e1c 0x3ea 0x3c0f 0x9dbc 0x3f1 0x3dff 0x9d5d 0x3f5 0x3fef 0x9cff 0x3f7 0x41df 0x9ca1 0x3fa 0x43cf 0x9c48 0x405 0x45bf 0x9bf1 0x40d 0x47af 0x9b9b 0x413 0x499e 0x9b46 0x41b 0x4b8e 0x9af1 0x424 0x4d7e 0x9a9a 0x42d 0x4f6e 0x9a42 0x435 0x515e 0x99e5 0x43a 0x534e 0x997e 0x435 0x553e 0x990a 0x41c 0x572e 0x9892 0x3f9 0x591e 0x9824 0x3d9 0x5b0e 0x97c7 0x3c5 0x5cfe 0x9777 0x3bc 0x5eee 0x9730 0x3b9 0x60de 0x96ef 0x3b6 0x62ce 0x96b2 0x3b4 0x64be 0x9679 0x3b4 0x66ae 0x9642 0x3b4 0x689e 0x960e 0x3b5 0x6a8e 0x95db 0x3b7 0x6c7e 0x95aa 0x3b9 0x6e6e 0x957c 0x3ba 0x705e 0x954f 0x3bc 0x724e 0x9524 0x3c0 0x743e 0x94fa 0x3c3 0x762e 0x94d2 0x3c6 0x781d 0x94ac 0x3cc 0x7a0d 0x9487 0x3d1 0x7bfd 0x9463 0x3d6 0x7ded 0x9441 0x3db 0x7fdd 0x941e 0x3dd 0x81cd 0x93fd 0x3e1 0x83bd 0x93dd 0x3e5 0x85ad 0x93bb 0x3e6 0x879d 0x9397 0x3e6 0x898d 0x936c 0x3de 0x8b7d 0x9337 0x3d1 0x8d6d 0x92f6 0x3c0 0x8f5d 0x92ba 0x3b7 0x914d 0x9287 0x3b8 0x933d 0x925a 0x3ba 0x952d 0x922b 0x3b7 0x971d 0x91fe 0x3bc 0x990d 0x91d2 0x3bc 0x9afd 0x91a9 0x3bd 0x9ced 0x9185 0x3c4 0x9edd 0x915c 0x3c9 0xa0cd 0x912c 0x3ca 0xa2bd 0x90f2 0x3ca 0xa4ad 0x90b4 0x3c8 0xa69d 0x9079 0x3cc 0xa88c 0x9038 0x3d1 0xaa7c 0x8fea 0x3bd 0xac6c 0x8fb1 0x3ae 0xae5c 0x8fa0 0x3b7 0xb04c 0x8f96 0x3cf 0xb23c 0x8f89 0x3e6 0xb42c 0x8f75 0x409 0xb61c 0x8f54 0x438 0xb80c 0x8f0b 0x457 0xb9fc 0x8e11 0x3ff 0xbbec 0x8c5b 0x3fa 0xbddc 0x88c5 0x406 0xbfcc 0x84d8 0x427>;
		battery1_profile_t0_col = <0x3>;
		battery1_profile_t0_num = <0x64>;
		battery1_profile_t1 = <0x0 0xabbe 0x5b4 0x1f0 0xaae8 0x5b4 0x3e0 0xaa4e 0x5ac 0x5d0 0xa9c8 0x5a5 0x7c0 0xa948 0x5ad 0x9b0 0xa8c9 0x5af 0xba0 0xa84f 0x5ac 0xd90 0xa7d6 0x5a3 0xf80 0xa75f 0x5b0 0x1170 0xa6e8 0x5b4 0x1360 0xa673 0x5a1 0x1550 0xa5fe 0x5aa 0x1740 0xa58c 0x5aa 0x192f 0xa517 0x59a 0x1b1f 0xa4a5 0x5a3 0x1d0f 0xa433 0x5a3 0x1eff 0xa3c3 0x59a 0x20ef 0xa352 0x5a2 0x22df 0xa2e4 0x5a8 0x24cf 0xa276 0x5a0 0x26bf 0xa20a 0x5a5 0x28af 0xa19c 0x5ae 0x2a9f 0xa130 0x5ad 0x2c8f 0xa0c3 0x5b4 0x2e7f 0xa057 0x5c1 0x306f 0x9fec 0x5ba 0x325f 0x9f85 0x5bd 0x344f 0x9f2a 0x5d3 0x363f 0x9edd 0x5e4 0x382f 0x9e8d 0x5ff 0x3a1f 0x9e25 0x60a 0x3c0f 0x9d9b 0x5f6 0x3dff 0x9cff 0x5eb 0x3fef 0x9c6e 0x5ec 0x41df 0x9bf7 0x5e0 0x43cf 0x9b98 0x5e4 0x45bf 0x9b4c 0x5fa 0x47af 0x9b09 0x601 0x499e 0x9ac4 0x602 0x4b8e 0x9a75 0x5fc 0x4d7e 0x9a1e 0x5f0 0x4f6e 0x99bd 0x5e2 0x515e 0x9956 0x5d1 0x534e 0x98f0 0x5ae 0x553e 0x988b 0x58d 0x572e 0x982c 0x57a 0x591e 0x97d5 0x562 0x5b0e 0x9786 0x549 0x5cfe 0x973e 0x540 0x5eee 0x96fa 0x542 0x60de 0x96bb 0x53d 0x62ce 0x9680 0x541 0x64be 0x9647 0x53f 0x66ae 0x9611 0x536 0x689e 0x95df 0x533 0x6a8e 0x95af 0x532 0x6c7e 0x9580 0x542 0x6e6e 0x9553 0x548 0x705e 0x9529 0x544 0x724e 0x9500 0x545 0x743e 0x94d7 0x54f 0x762e 0x94b1 0x553 0x781d 0x948b 0x55f 0x7a0d 0x9468 0x560 0x7bfd 0x9445 0x566 0x7ded 0x9424 0x565 0x7fdd 0x9404 0x56a 0x81cd 0x93e4 0x564 0x83bd 0x93c6 0x555 0x85ad 0x93a9 0x557 0x879d 0x938d 0x55c 0x898d 0x9372 0x55e 0x8b7d 0x9358 0x564 0x8d6d 0x933f 0x563 0x8f5d 0x9325 0x55c 0x914d 0x930a 0x56d 0x933d 0x92eb 0x56f 0x952d 0x92c7 0x564 0x971d 0x929f 0x560 0x990d 0x9279 0x563 0x9afd 0x9255 0x56a 0x9ced 0x922c 0x576 0x9edd 0x9200 0x589 0xa0cd 0x91cb 0x58a 0xa2bd 0x918d 0x596 0xa4ad 0x914c 0x5a1 0xa69d 0x910f 0x5b4 0xa88c 0x90c9 0x5c6 0xaa7c 0x9074 0x5cc 0xac6c 0x9038 0x5e1 0xae5c 0x901e 0x5f1 0xb04c 0x900b 0x61a 0xb23c 0x8ff5 0x649 0xb42c 0x8fd8 0x687 0xb61c 0x8fa9 0x6bd 0xb80c 0x8f3f 0x711 0xb9fc 0x8e30 0x72f 0xbbec 0x8c57 0x74d 0xbddc 0x89d6 0x7bb 0xbfcc 0x84d9 0x870>;
		battery1_profile_t1_col = <0x3>;
		battery1_profile_t1_num = <0x64>;
		battery1_profile_t2 = <0x0 0xab9e 0xa91 0x1f0 0xaaad 0xa91 0x3e0 0xa9fa 0xa86 0x5d0 0xa95d 0xa66 0x7c0 0xa8cc 0xa4a 0x9b0 0xa843 0xa2e 0xba0 0xa7c2 0xa13 0xd90 0xa746 0x9fe 0xf80 0xa6cc 0x9e3 0x1170 0xa654 0x9d1 0x1360 0xa5dd 0x9b8 0x1550 0xa569 0x9a4 0x1740 0xa4f6 0x994 0x192f 0xa485 0x97b 0x1b1f 0xa414 0x969 0x1d0f 0xa3a6 0x95e 0x1eff 0xa339 0x955 0x20ef 0xa2cd 0x94f 0x22df 0xa260 0x946 0x24cf 0xa1f3 0x93f 0x26bf 0xa188 0x93b 0x28af 0xa11d 0x938 0x2a9f 0xa0b2 0x92f 0x2c8f 0xa049 0x92b 0x2e7f 0x9fe6 0x92a 0x306f 0x9f8b 0x92f 0x325f 0x9f38 0x941 0x344f 0x9ee2 0x960 0x363f 0x9e79 0x96c 0x382f 0x9df9 0x961 0x3a1f 0x9d69 0x93c 0x3c0f 0x9cd5 0x90d 0x3dff 0x9c4a 0x8ee 0x3fef 0x9bcd 0x8d6 0x41df 0x9b61 0x8c8 0x43cf 0x9b04 0x8c6 0x45bf 0x9ab0 0x8c6 0x47af 0x9a60 0x8c0 0x499e 0x9a10 0x8b7 0x4b8e 0x99bd 0x8a9 0x4d7e 0x9968 0x895 0x4f6e 0x9910 0x87b 0x515e 0x98b8 0x85f 0x534e 0x9862 0x84a 0x553e 0x980f 0x834 0x572e 0x97c0 0x824 0x591e 0x9776 0x818 0x5b0e 0x972f 0x80f 0x5cfe 0x96ec 0x808 0x5eee 0x96ad 0x803 0x60de 0x9671 0x805 0x62ce 0x9639 0x807 0x64be 0x9602 0x808 0x66ae 0x95ce 0x80e 0x689e 0x959d 0x812 0x6a8e 0x956e 0x816 0x6c7e 0x9540 0x81d 0x6e6e 0x9514 0x824 0x705e 0x94eb 0x82d 0x724e 0x94c3 0x836 0x743e 0x949d 0x83f 0x762e 0x9478 0x846 0x781d 0x9455 0x850 0x7a0d 0x9435 0x856 0x7bfd 0x9415 0x85a 0x7ded 0x93f9 0x864 0x7fdd 0x93df 0x86f 0x81cd 0x93c9 0x87e 0x83bd 0x93b4 0x88d 0x85ad 0x93a0 0x8a0 0x879d 0x938d 0x8b5 0x898d 0x9379 0x8cb 0x8b7d 0x9365 0x8e2 0x8d6d 0x9350 0x8f9 0x8f5d 0x9337 0x90f 0x914d 0x931e 0x92c 0x933d 0x9303 0x948 0x952d 0x92e5 0x96a 0x971d 0x92c4 0x98f 0x990d 0x929f 0x9b3 0x9afd 0x9278 0x9e0 0x9ced 0x924b 0xa10 0x9edd 0x921a 0xa49 0xa0cd 0x91e2 0xa85 0xa2bd 0x91a6 0xaca 0xa4ad 0x9165 0xb11 0xa69d 0x911e 0xb67 0xa88c 0x90d4 0xbc1 0xaa7c 0x908c 0xc25 0xac6c 0x904d 0xc9a 0xae5c 0x901a 0xd20 0xb04c 0x8ff0 0xdc2 0xb23c 0x8fca 0xe82 0xb42c 0x8f99 0xf57 0xb61c 0x8f4a 0x104a 0xb80c 0x8ebc 0x113f 0xb9fc 0x8dcc 0x122d 0xbbec 0x8c55 0x132b 0xbddc 0x8a37 0x1484 0xbfcc 0x873a 0x168d>;
		battery1_profile_t2_col = <0x3>;
		battery1_profile_t2_num = <0x64>;
		battery1_profile_t3 = <0x0 0xabee 0x16b2 0x1f0 0xab0b 0x16b1 0x3e0 0xaa58 0x167a 0x5d0 0xa9b5 0x1630 0x7c0 0xa91d 0x15e6 0x9b0 0xa88c 0x15c1 0xba0 0xa802 0x1556 0xd90 0xa780 0x151b 0xf80 0xa700 0x14d3 0x1170 0xa684 0x1487 0x1360 0xa60a 0x143b 0x1550 0xa592 0x1416 0x1740 0xa51b 0x13cc 0x192f 0xa4a7 0x1396 0x1b1f 0xa435 0x1379 0x1d0f 0xa3c5 0x1344 0x1eff 0xa357 0x131f 0x20ef 0xa2e8 0x12ee 0x22df 0xa274 0x12f5 0x24cf 0xa204 0x13cd 0x26bf 0xa19b 0x12b3 0x28af 0xa134 0x11dd 0x2a9f 0xa0c9 0x11f1 0x2c8f 0xa061 0x1219 0x2e7f 0xa005 0x1232 0x306f 0x9faf 0x1249 0x325f 0x9f57 0x125f 0x344f 0x9ef3 0x125f 0x363f 0x9e79 0x1235 0x382f 0x9de9 0x11f1 0x3a1f 0x9d4e 0x1193 0x3c0f 0x9cb5 0x1130 0x3dff 0x9c29 0x10ee 0x3fef 0x9baa 0x10c5 0x41df 0x9b3a 0x10a9 0x43cf 0x9ad8 0x1080 0x45bf 0x9a81 0x1064 0x47af 0x9a2f 0x104e 0x499e 0x99de 0x1046 0x4b8e 0x998d 0x103f 0x4d7e 0x993b 0x1025 0x4f6e 0x98e9 0x100b 0x515e 0x9896 0xfe8 0x534e 0x9846 0xfbd 0x553e 0x97f8 0xfb6 0x572e 0x97ad 0xfb9 0x591e 0x9765 0xfb3 0x5b0e 0x9721 0xfad 0x5cfe 0x96df 0xfaa 0x5eee 0x96a1 0xfab 0x60de 0x9667 0xfb5 0x62ce 0x962f 0xfbe 0x64be 0x95f9 0xfbf 0x66ae 0x95c6 0xfcc 0x689e 0x9595 0xfe1 0x6a8e 0x9565 0xfea 0x6c7e 0x9539 0xff7 0x6e6e 0x950e 0x100a 0x705e 0x94e5 0x1015 0x724e 0x94bf 0x102d 0x743e 0x949b 0x1043 0x762e 0x9478 0x1060 0x781d 0x9459 0x1081 0x7a0d 0x943d 0x1096 0x7bfd 0x9424 0x10bb 0x7ded 0x940e 0x10e0 0x7fdd 0x93fa 0x110f 0x81cd 0x93e6 0x114a 0x83bd 0x93d4 0x1172 0x85ad 0x93c1 0x11af 0x879d 0x93af 0x11f6 0x898d 0x939b 0x1236 0x8b7d 0x9387 0x1284 0x8d6d 0x9371 0x12be 0x8f5d 0x935b 0x131a 0x914d 0x9341 0x136e 0x933d 0x9326 0x13c2 0x952d 0x9307 0x1429 0x971d 0x92e6 0x148e 0x990d 0x92c1 0x1504 0x9afd 0x9299 0x1588 0x9ced 0x926d 0x162d 0x9edd 0x923a 0x16bb 0xa0cd 0x9204 0x173d 0xa2bd 0x91c9 0x17fc 0xa4ad 0x918b 0x18b9 0xa69d 0x9148 0x1a2c 0xa88c 0x9103 0x1aed 0xaa7c 0x90c2 0x1b7f 0xac6c 0x9089 0x1c5e 0xae5c 0x9053 0x1d86 0xb04c 0x9022 0x1ee5 0xb23c 0x8ff4 0x1ff8 0xb42c 0x8fba 0x2203 0xb61c 0x8f63 0x240f 0xb80c 0x8ece 0x256d 0xb9fc 0x8dd5 0x280c 0xbbec 0x8c5e 0x2a7e 0xbddc 0x8a4f 0x2d44 0xbfcc 0x8772 0x3087>;
		battery1_profile_t3_col = <0x3>;
		battery1_profile_t3_num = <0x64>;
		battery1_profile_t4 = <0x0 0xac01 0x2ac4 0x1f0 0xaad2 0x2ac3 0x3e0 0xa9e3 0x2aa5 0x5d0 0xa912 0x2a1f 0x7c0 0xa855 0x2996 0x9b0 0xa7a8 0x28ff 0xba0 0xa703 0x2863 0xd90 0xa665 0x27ce 0xf80 0xa5d0 0x2743 0x1170 0xa541 0x26b9 0x1360 0xa4b8 0x264a 0x1550 0xa433 0x25e4 0x1740 0xa3b1 0x2571 0x192f 0xa332 0x2506 0x1b1f 0xa2b6 0x2496 0x1d0f 0xa23a 0x2434 0x1eff 0xa1c2 0x23d9 0x20ef 0xa151 0x238f 0x22df 0xa0e9 0x235b 0x24cf 0xa087 0x2334 0x26bf 0xa01f 0x2302 0x28af 0x9fac 0x22d0 0x2a9f 0x9f2b 0x2271 0x2c8f 0x9e99 0x21f1 0x2e7f 0x9dfe 0x2168 0x306f 0x9d65 0x20da 0x325f 0x9cda 0x2064 0x344f 0x9c5d 0x2001 0x363f 0x9bec 0x1fc1 0x382f 0x9b87 0x1f91 0x3a1f 0x9b2b 0x1f6f 0x3c0f 0x9ad7 0x1f64 0x3dff 0x9a86 0x1f4d 0x3fef 0x9a36 0x1f42 0x41df 0x99e6 0x1f2a 0x43cf 0x9994 0x1f0f 0x45bf 0x9943 0x1efe 0x47af 0x98f1 0x1eec 0x499e 0x98a0 0x1edf 0x4b8e 0x9852 0x1ecf 0x4d7e 0x9807 0x1ebe 0x4f6e 0x97bd 0x1eb5 0x515e 0x9776 0x1eb5 0x534e 0x9732 0x1ead 0x553e 0x96f0 0x1ea8 0x572e 0x96b2 0x1eaf 0x591e 0x9676 0x1eb4 0x5b0e 0x963d 0x1ebc 0x5cfe 0x9607 0x1ec8 0x5eee 0x95d3 0x1ed7 0x60de 0x95a3 0x1ef4 0x62ce 0x9576 0x1f11 0x64be 0x954d 0x1f2a 0x66ae 0x9528 0x1f53 0x689e 0x9507 0x1f7b 0x6a8e 0x94e7 0x1fad 0x6c7e 0x94cb 0x1fe7 0x6e6e 0x94b1 0x202b 0x705e 0x9498 0x2075 0x724e 0x9480 0x20bb 0x743e 0x946a 0x210b 0x762e 0x9454 0x215e 0x781d 0x943f 0x21ad 0x7a0d 0x942a 0x220a 0x7bfd 0x9416 0x2270 0x7ded 0x9401 0x22de 0x7fdd 0x93ec 0x2348 0x81cd 0x93d6 0x23c1 0x83bd 0x93c0 0x243c 0x85ad 0x93a9 0x24c0 0x879d 0x9391 0x2548 0x898d 0x9378 0x25cf 0x8b7d 0x935e 0x2671 0x8d6d 0x9342 0x2721 0x8f5d 0x9327 0x27d9 0x914d 0x9308 0x288e 0x933d 0x92e7 0x2949 0x952d 0x92c4 0x2a10 0x971d 0x929f 0x2ada 0x990d 0x9279 0x2ba4 0x9afd 0x924e 0x2c82 0x9ced 0x9223 0x2d6e 0x9edd 0x91f3 0x2e63 0xa0cd 0x91c1 0x2f4a 0xa2bd 0x918d 0x304d 0xa4ad 0x9157 0x314c 0xa69d 0x911f 0x3267 0xa88c 0x90e5 0x3373 0xaa7c 0x90ac 0x349d 0xac6c 0x9075 0x35af 0xae5c 0x903f 0x36e6 0xb04c 0x9009 0x3819 0xb23c 0x8fcd 0x3958 0xb42c 0x8f85 0x3aa5 0xb61c 0x8f21 0x3bc2 0xb80c 0x8e91 0x3ce9 0xb9fc 0x8db7 0x3e00 0xbbec 0x8c70 0x3f24 0xbddc 0x8a9a 0x40c5 0xbfcc 0x87f3 0x4353>;
		battery1_profile_t4_col = <0x3>;
		battery1_profile_t4_num = <0x64>;
		battery1_profile_t5 = <0x0 0xac01 0x2ac4 0x1f0 0xaad2 0x2ac3 0x3e0 0xa9e3 0x2aa5 0x5d0 0xa912 0x2a1f 0x7c0 0xa855 0x2996 0x9b0 0xa7a8 0x28ff 0xba0 0xa703 0x2863 0xd90 0xa665 0x27ce 0xf80 0xa5d0 0x2743 0x1170 0xa541 0x26b9 0x1360 0xa4b8 0x264a 0x1550 0xa433 0x25e4 0x1740 0xa3b1 0x2571 0x192f 0xa332 0x2506 0x1b1f 0xa2b6 0x2496 0x1d0f 0xa23a 0x2434 0x1eff 0xa1c2 0x23d9 0x20ef 0xa151 0x238f 0x22df 0xa0e9 0x235b 0x24cf 0xa087 0x2334 0x26bf 0xa01f 0x2302 0x28af 0x9fac 0x22d0 0x2a9f 0x9f2b 0x2271 0x2c8f 0x9e99 0x21f1 0x2e7f 0x9dfe 0x2168 0x306f 0x9d65 0x20da 0x325f 0x9cda 0x2064 0x344f 0x9c5d 0x2001 0x363f 0x9bec 0x1fc1 0x382f 0x9b87 0x1f91 0x3a1f 0x9b2b 0x1f6f 0x3c0f 0x9ad7 0x1f64 0x3dff 0x9a86 0x1f4d 0x3fef 0x9a36 0x1f42 0x41df 0x99e6 0x1f2a 0x43cf 0x9994 0x1f0f 0x45bf 0x9943 0x1efe 0x47af 0x98f1 0x1eec 0x499e 0x98a0 0x1edf 0x4b8e 0x9852 0x1ecf 0x4d7e 0x9807 0x1ebe 0x4f6e 0x97bd 0x1eb5 0x515e 0x9776 0x1eb5 0x534e 0x9732 0x1ead 0x553e 0x96f0 0x1ea8 0x572e 0x96b2 0x1eaf 0x591e 0x9676 0x1eb4 0x5b0e 0x963d 0x1ebc 0x5cfe 0x9607 0x1ec8 0x5eee 0x95d3 0x1ed7 0x60de 0x95a3 0x1ef4 0x62ce 0x9576 0x1f11 0x64be 0x954d 0x1f2a 0x66ae 0x9528 0x1f53 0x689e 0x9507 0x1f7b 0x6a8e 0x94e7 0x1fad 0x6c7e 0x94cb 0x1fe7 0x6e6e 0x94b1 0x202b 0x705e 0x9498 0x2075 0x724e 0x9480 0x20bb 0x743e 0x946a 0x210b 0x762e 0x9454 0x215e 0x781d 0x943f 0x21ad 0x7a0d 0x942a 0x220a 0x7bfd 0x9416 0x2270 0x7ded 0x9401 0x22de 0x7fdd 0x93ec 0x2348 0x81cd 0x93d6 0x23c1 0x83bd 0x93c0 0x243c 0x85ad 0x93a9 0x24c0 0x879d 0x9391 0x2548 0x898d 0x9378 0x25cf 0x8b7d 0x935e 0x2671 0x8d6d 0x9342 0x2721 0x8f5d 0x9327 0x27d9 0x914d 0x9308 0x288e 0x933d 0x92e7 0x2949 0x952d 0x92c4 0x2a10 0x971d 0x929f 0x2ada 0x990d 0x9279 0x2ba4 0x9afd 0x924e 0x2c82 0x9ced 0x9223 0x2d6e 0x9edd 0x91f3 0x2e63 0xa0cd 0x91c1 0x2f4a 0xa2bd 0x918d 0x304d 0xa4ad 0x9157 0x314c 0xa69d 0x911f 0x3267 0xa88c 0x90e5 0x3373 0xaa7c 0x90ac 0x349d 0xac6c 0x9075 0x35af 0xae5c 0x903f 0x36e6 0xb04c 0x9009 0x3819 0xb23c 0x8fcd 0x3958 0xb42c 0x8f85 0x3aa5 0xb61c 0x8f21 0x3bc2 0xb80c 0x8e91 0x3ce9 0xb9fc 0x8db7 0x3e00 0xbbec 0x8c70 0x3f24 0xbddc 0x8a9a 0x40c5 0xbfcc 0x87f3 0x4353>;
		battery1_profile_t5_col = <0x3>;
		battery1_profile_t5_num = <0x64>;
		battery2_profile_t0 = <0x0 0xabae 0x393 0x1f9 0xaafa 0x393 0x3f2 0xaa6b 0x392 0x5ec 0xa9de 0x388 0x7e5 0xa95c 0x382 0x9de 0xa8dc 0x380 0xbd7 0xa85d 0x37b 0xdd0 0xa7e0 0x381 0xfc9 0xa764 0x382 0x11c3 0xa6eb 0x384 0x13bc 0xa672 0x386 0x15b5 0xa5fb 0x38b 0x17ae 0xa583 0x38a 0x19a7 0xa50b 0x385 0x1ba1 0xa494 0x383 0x1d9a 0xa420 0x387 0x1f93 0xa3ab 0x386 0x218c 0xa336 0x386 0x2385 0xa2c4 0x387 0x257e 0xa254 0x390 0x2778 0xa1e2 0x393 0x2971 0xa173 0x393 0x2b6a 0xa104 0x393 0x2d63 0xa096 0x398 0x2f5c 0xa02a 0x39b 0x3156 0x9fc0 0x39b 0x334f 0x9f56 0x3a1 0x3548 0x9eef 0x3a8 0x3741 0x9e89 0x3aa 0x393a 0x9e23 0x3ac 0x3b33 0x9dbf 0x3b1 0x3d2d 0x9d5f 0x3b8 0x3f26 0x9cff 0x3b8 0x411f 0x9ca3 0x3c3 0x4318 0x9c44 0x3c3 0x4511 0x9bed 0x3d1 0x470b 0x9b93 0x3d2 0x4904 0x9b3d 0x3da 0x4afd 0x9aea 0x3f1 0x4cf6 0x9a93 0x3fa 0x4eef 0x9a3c 0x406 0x50e8 0x99e2 0x412 0x52e2 0x997e 0x412 0x54db 0x990f 0x3fc 0x56d4 0x989b 0x3da 0x58cd 0x9829 0x3bc 0x5ac6 0x97c3 0x3a3 0x5cc0 0x976b 0x38e 0x5eb9 0x971e 0x388 0x60b2 0x96d8 0x37c 0x62ab 0x9699 0x375 0x64a4 0x965f 0x379 0x669d 0x9629 0x37b 0x6897 0x95f3 0x377 0x6a90 0x95c0 0x37f 0x6c89 0x958e 0x378 0x6e82 0x9562 0x37e 0x707b 0x9534 0x37e 0x7275 0x950b 0x386 0x746e 0x94e2 0x383 0x7667 0x94bb 0x391 0x7860 0x9495 0x38c 0x7a59 0x9472 0x399 0x7c52 0x944f 0x393 0x7e4c 0x942f 0x3a2 0x8045 0x940b 0x398 0x823e 0x93ef 0x3ac 0x8437 0x93d2 0x3b4 0x8630 0x93b2 0x3b4 0x882a 0x9390 0x3b9 0x8a23 0x9362 0x3a8 0x8c1c 0x932b 0x39c 0x8e15 0x92e2 0x380 0x900e 0x92a3 0x37b 0x9207 0x9273 0x380 0x9401 0x9248 0x387 0x95fa 0x921b 0x386 0x97f3 0x91ed 0x380 0x99ec 0x91c2 0x377 0x9be5 0x919d 0x380 0x9ddf 0x917a 0x38f 0x9fd8 0x9152 0x397 0xa1d1 0x911f 0x396 0xa3ca 0x90e5 0x397 0xa5c3 0x90a7 0x394 0xa7bc 0x906a 0x398 0xa9b6 0x9022 0x396 0xabaf 0x8fd6 0x372 0xada8 0x8fad 0x369 0xafa1 0x8f9f 0x384 0xb19a 0x8f95 0x3a3 0xb394 0x8f89 0x3d0 0xb58d 0x8f72 0x3f9 0xb786 0x8f4b 0x436 0xb97f 0x8ebb 0x3fd 0xbb78 0x8d4c 0x3bc 0xbd71 0x8b57 0x3d1 0xbf6b 0x88b1 0x3f0 0xc164 0x84d6 0x424 0xc35d 0x7ece 0x4e9>;
		battery2_profile_t0_col = <0x3>;
		battery2_profile_t0_num = <0x64>;
		battery2_profile_t1 = <0x0 0xab6e 0x50f 0x1f9 0xaab3 0x50f 0x3f2 0xaa21 0x514 0x5ec 0xa9a1 0x50b 0x7e5 0xa926 0x4fe 0x9de 0xa8b3 0x500 0xbd7 0xa83b 0x4fb 0xdd0 0xa7c1 0x4f1 0xfc9 0xa74c 0x4f7 0x11c3 0xa6d1 0x4ee 0x13bc 0xa65d 0x4e7 0x15b5 0xa5e6 0x4e5 0x17ae 0xa570 0x4e4 0x19a7 0xa4fe 0x4e4 0x1ba1 0xa487 0x4e0 0x1d9a 0xa414 0x4df 0x1f93 0xa3a3 0x4e4 0x218c 0xa331 0x4e4 0x2385 0xa2bf 0x4e0 0x257e 0xa250 0x4e4 0x2778 0xa1e4 0x4e9 0x2971 0xa175 0x4e8 0x2b6a 0xa107 0x4f3 0x2d63 0xa09a 0x4f7 0x2f5c 0xa02e 0x4fd 0x3156 0x9fc4 0x506 0x334f 0x9f57 0x50d 0x3548 0x9eee 0x50f 0x3741 0x9e8f 0x50f 0x393a 0x9e48 0x537 0x3b33 0x9e0b 0x568 0x3d2d 0x9da8 0x56c 0x3f26 0x9d0e 0x53d 0x411f 0x9c68 0x52d 0x4318 0x9bd9 0x534 0x4511 0x9b65 0x536 0x470b 0x9b15 0x550 0x4904 0x9adc 0x566 0x4afd 0x9aa8 0x575 0x4cf6 0x9a6b 0x57d 0x4eef 0x9a17 0x580 0x50e8 0x99c1 0x582 0x52e2 0x9960 0x57c 0x54db 0x98fa 0x562 0x56d4 0x988a 0x53b 0x58cd 0x981a 0x509 0x5ac6 0x97b0 0x4de 0x5cc0 0x9751 0x4bb 0x5eb9 0x96fc 0x4aa 0x60b2 0x96b3 0x49d 0x62ab 0x966d 0x492 0x64a4 0x962f 0x48f 0x669d 0x95f5 0x48e 0x6897 0x95bc 0x48b 0x6a90 0x9588 0x48b 0x6c89 0x9555 0x485 0x6e82 0x9526 0x488 0x707b 0x94fa 0x48b 0x7275 0x94cf 0x490 0x746e 0x94a1 0x48c 0x7667 0x9479 0x491 0x7860 0x9452 0x494 0x7a59 0x942e 0x4a0 0x7c52 0x9406 0x49a 0x7e4c 0x93e8 0x4a1 0x8045 0x93c2 0x4a1 0x823e 0x93a5 0x4a9 0x8437 0x9385 0x4a9 0x8630 0x9368 0x4b0 0x882a 0x9349 0x4a9 0x8a23 0x932c 0x4aa 0x8c1c 0x9312 0x4b1 0x8e15 0x92ef 0x4a7 0x900e 0x92ce 0x49e 0x9207 0x92ad 0x490 0x9401 0x928e 0x489 0x95fa 0x926c 0x483 0x97f3 0x924a 0x483 0x99ec 0x9224 0x480 0x9be5 0x91fb 0x478 0x9ddf 0x91d3 0x475 0x9fd8 0x91b2 0x484 0xa1d1 0x918f 0x496 0xa3ca 0x9162 0x49a 0xa5c3 0x912c 0x49a 0xa7bc 0x90f2 0x49e 0xa9b6 0x90b6 0x4aa 0xabaf 0x907b 0x4c0 0xada8 0x9035 0x4c9 0xafa1 0x8fe2 0x4b8 0xb19a 0x8fad 0x4b7 0xb394 0x8f97 0x4d1 0xb58d 0x8f87 0x4ea 0xb786 0x8f77 0x50d 0xb97f 0x8f62 0x538 0xbb78 0x8f38 0x56d 0xbd71 0x8ee1 0x5aa 0xbf6b 0x8dde 0x595 0xc164 0x8c17 0x591 0xc35d 0x89b4 0x5d0>;
		battery2_profile_t1_col = <0x3>;
		battery2_profile_t1_num = <0x64>;
		battery2_profile_t2 = <0x0 0xab55 0x852 0x1f9 0xaa5d 0x855 0x3f2 0xa99c 0x8b8 0x5ec 0xa8fb 0x8a9 0x7e5 0xa869 0x8a3 0x9de 0xa7e4 0x888 0xbd7 0xa765 0x87d 0xdd0 0xa6ea 0x869 0xfc9 0xa676 0x85e 0x11c3 0xa5fe 0x84a 0x13bc 0xa58b 0x83e 0x15b5 0xa519 0x834 0x17ae 0xa4a6 0x828 0x19a7 0xa434 0x818 0x1ba1 0xa3c6 0x817 0x1d9a 0xa358 0x80d 0x1f93 0xa2eb 0x80d 0x218c 0xa27e 0x809 0x2385 0xa213 0x800 0x257e 0xa1a8 0x803 0x2778 0xa13d 0x805 0x2971 0xa0d2 0x80b 0x2b6a 0xa067 0x80f 0x2d63 0x9ffe 0x80d 0x2f5c 0x9f96 0x80e 0x3156 0x9f35 0x801 0x334f 0x9ee4 0x817 0x3548 0x9ea0 0x865 0x3741 0x9e51 0x8b6 0x393a 0x9df1 0x8d4 0x3b33 0x9d69 0x8c2 0x3d2d 0x9cc1 0x884 0x3f26 0x9c14 0x83c 0x411f 0x9b81 0x80b 0x4318 0x9b09 0x7ed 0x4511 0x9aa4 0x7de 0x470b 0x9a53 0x7d1 0x4904 0x9a11 0x7db 0x4afd 0x99d0 0x7f0 0x4cf6 0x9986 0x7e9 0x4eef 0x9931 0x7d2 0x50e8 0x98da 0x7b2 0x52e2 0x987b 0x780 0x54db 0x981f 0x75d 0x56d4 0x97c2 0x736 0x58cd 0x9769 0x714 0x5ac6 0x9718 0x6fb 0x5cc0 0x96cb 0x6e4 0x5eb9 0x9683 0x6d9 0x60b2 0x9643 0x6d1 0x62ab 0x9604 0x6c9 0x64a4 0x95c8 0x6c5 0x669d 0x9590 0x6ba 0x6897 0x955a 0x6bb 0x6a90 0x9527 0x6bb 0x6c89 0x94f9 0x6bf 0x6e82 0x94cc 0x6c0 0x707b 0x949f 0x6c7 0x7275 0x9475 0x6ca 0x746e 0x944b 0x6c2 0x7667 0x9427 0x6cc 0x7860 0x93ff 0x6ca 0x7a59 0x93db 0x6d0 0x7c52 0x93bb 0x6d8 0x7e4c 0x939d 0x6e0 0x8045 0x9381 0x6e0 0x823e 0x9361 0x6d9 0x8437 0x9344 0x6e1 0x8630 0x9335 0x6ef 0x882a 0x9321 0x6ef 0x8a23 0x9311 0x6f2 0x8c1c 0x9304 0x707 0x8e15 0x92f5 0x718 0x900e 0x92e6 0x73a 0x9207 0x92d0 0x73b 0x9401 0x92bc 0x75c 0x95fa 0x92a0 0x77b 0x97f3 0x927f 0x78f 0x99ec 0x925c 0x7b1 0x9be5 0x9238 0x7e8 0x9ddf 0x9210 0x817 0x9fd8 0x91e3 0x84e 0xa1d1 0x91b2 0x889 0xa3ca 0x917a 0x8ce 0xa5c3 0x913d 0x91a 0xa7bc 0x9104 0x97b 0xa9b6 0x90bf 0x9b2 0xabaf 0x906f 0xa0e 0xada8 0x9025 0xa85 0xafa1 0x8fe6 0xae6 0xb19a 0x8fb7 0xb5f 0xb394 0x8f8f 0xbf9 0xb58d 0x8f69 0xcad 0xb786 0x8f43 0xd86 0xb97f 0x8eff 0xe54 0xbb78 0x8e83 0xf5d 0xbd71 0x8dad 0x1049 0xbf6b 0x8c63 0x1131 0xc164 0x8a7f 0x1254 0xc35d 0x87d0 0x1450>;
		battery2_profile_t2_col = <0x3>;
		battery2_profile_t2_num = <0x64>;
		battery2_profile_t3 = <0x0 0xabde 0x1086 0x1f9 0xaaac 0x1080 0x3f2 0xa9af 0x105c 0x5ec 0xa8df 0x1015 0x7e5 0xa82c 0xfd7 0x9de 0xa78e 0xf9b 0xbd7 0xa6fc 0xf77 0xdd0 0xa673 0xf4a 0xfc9 0xa5eb 0xf1f 0x11c3 0xa568 0xeee 0x13bc 0xa4ea 0xec6 0x15b5 0xa472 0xeae 0x17ae 0xa3fd 0xe98 0x19a7 0xa38b 0xe82 0x1ba1 0xa31c 0xe76 0x1d9a 0xa2aa 0xe62 0x1f93 0xa23a 0xe4d 0x218c 0xa1cf 0xe46 0x2385 0xa162 0xe31 0x257e 0xa0f6 0xe17 0x2778 0xa092 0xdfe 0x2971 0xa041 0xe0f 0x2b6a 0x9ff3 0xe61 0x2d63 0x9f9a 0xeb8 0x2f5c 0x9f32 0xeec 0x3156 0x9eb5 0xee3 0x334f 0x9e20 0xe99 0x3548 0x9d7c 0xe22 0x3741 0x9cde 0xd9b 0x393a 0x9c4c 0xd34 0x3b33 0x9bcb 0xce9 0x3d2d 0x9b57 0xcb2 0x3f26 0x9af4 0xc8a 0x411f 0x9a9a 0xc62 0x4318 0x9a4d 0xc62 0x4511 0x9a07 0xc68 0x470b 0x99b6 0xc59 0x4904 0x9960 0xc47 0x4afd 0x990c 0xc27 0x4cf6 0x98b4 0xc0f 0x4eef 0x9861 0xbf2 0x50e8 0x980e 0xbd9 0x52e2 0x97bf 0xbc7 0x54db 0x9773 0xbb6 0x56d4 0x972b 0xbad 0x58cd 0x96e8 0xb9d 0x5ac6 0x96a8 0xb9e 0x5cc0 0x9668 0xb9a 0x5eb9 0x962b 0xb95 0x60b2 0x95f3 0xb94 0x62ab 0x95bc 0xb9d 0x64a4 0x9588 0xba6 0x669d 0x9559 0xba4 0x6897 0x952a 0xbb0 0x6a90 0x94fe 0xbbd 0x6c89 0x94d5 0xbcc 0x6e82 0x94ad 0xbcf 0x707b 0x9487 0xbd4 0x7275 0x9465 0xbe2 0x746e 0x944a 0xbf1 0x7667 0x9431 0xc03 0x7860 0x9420 0xc27 0x7a59 0x9410 0xc50 0x7c52 0x9403 0xc68 0x7e4c 0x93f3 0xca7 0x8045 0x93e3 0xccf 0x823e 0x93d6 0xd20 0x8437 0x93c6 0xd58 0x8630 0x93b6 0xdb2 0x882a 0x93a2 0xe1c 0x8a23 0x938c 0xe6f 0x8c1c 0x9378 0xef3 0x8e15 0x935f 0xf70 0x900e 0x9346 0x100a 0x9207 0x9326 0x1092 0x9401 0x9305 0x113f 0x95fa 0x92e1 0x11f2 0x97f3 0x92b8 0x12ac 0x99ec 0x928c 0x1358 0x9be5 0x925c 0x1423 0x9ddf 0x922b 0x14f8 0x9fd8 0x91f5 0x15c6 0xa1d1 0x91ba 0x168d 0xa3ca 0x917e 0x176b 0xa5c3 0x9144 0x1864 0xa7bc 0x9108 0x195c 0xa9b6 0x90cd 0x1a58 0xabaf 0x9097 0x1b9d 0xada8 0x9060 0x1ce5 0xafa1 0x9024 0x1e3a 0xb19a 0x8fdd 0x1fcf 0xb394 0x8f7d 0x2178 0xb58d 0x8eea 0x232c 0xb786 0x8e14 0x24c8 0xb97f 0x8cf9 0x267d 0xbb78 0x8b9e 0x27ea 0xbd71 0x8a18 0x292e 0xbf6b 0x8856 0x29f9 0xc164 0x8615 0x2bf3 0xc35d 0x82ec 0x3133>;
		battery2_profile_t3_col = <0x3>;
		battery2_profile_t3_num = <0x64>;
		battery2_profile_t4 = <0x0 0xabbf 0x12f2 0x1f9 0xaab9 0x1373 0x3f2 0xa970 0x2254 0x5ec 0xa85a 0x233b 0x7e5 0xa76a 0x22bb 0x9de 0xa689 0x2229 0xbd7 0xa5bc 0x217e 0xdd0 0xa4ff 0x2102 0xfc9 0xa44e 0x2077 0x11c3 0xa3a7 0x1ffc 0x13bc 0xa305 0x1f80 0x15b5 0xa267 0x1f01 0x17ae 0xa1d2 0x1e89 0x19a7 0xa154 0x1e43 0x1ba1 0xa0eb 0x1e39 0x1d9a 0xa07c 0x1e25 0x1f93 0x9ff4 0x1ddf 0x218c 0x9f4a 0x1d5e 0x2385 0x9e84 0x1c87 0x257e 0x9dc3 0x1ba9 0x2778 0x9d1c 0x1af7 0x2971 0x9c8e 0x1a7f 0x2b6a 0x9c16 0x1a1a 0x2d63 0x9bb0 0x19da 0x2f5c 0x9b53 0x19a4 0x3156 0x9afe 0x198e 0x334f 0x9ab5 0x1974 0x3548 0x9a6f 0x1968 0x3741 0x9a26 0x1953 0x393a 0x99d7 0x1940 0x3b33 0x9985 0x1941 0x3d2d 0x9931 0x1922 0x3f26 0x98db 0x190a 0x411f 0x988b 0x18f3 0x4318 0x9838 0x18e7 0x4511 0x97ec 0x18c5 0x470b 0x97a2 0x18ca 0x4904 0x9759 0x18be 0x4afd 0x9717 0x18c3 0x4cf6 0x96d7 0x18bd 0x4eef 0x9699 0x18c1 0x50e8 0x965b 0x18c2 0x52e2 0x9621 0x18c9 0x54db 0x95ee 0x18e7 0x56d4 0x95bb 0x18f7 0x58cd 0x958b 0x190d 0x5ac6 0x9562 0x1923 0x5cc0 0x953d 0x1944 0x5eb9 0x951e 0x1972 0x60b2 0x9503 0x19a6 0x62ab 0x94eb 0x19da 0x64a4 0x94d7 0x19cd 0x669d 0x94c3 0x1a36 0x6897 0x94b2 0x1a8e 0x6a90 0x94a2 0x194a 0x6c89 0x9490 0x1a79 0x6e82 0x947f 0x1ba5 0x707b 0x946a 0x1c2f 0x7275 0x9459 0x1ca5 0x746e 0x9456 0x1d48 0x7667 0x943b 0x1d6e 0x7860 0x9426 0x1e0b 0x7a59 0x9411 0x1ef6 0x7c52 0x93fa 0x1fc7 0x7e4c 0x93e3 0x2089 0x8045 0x93ca 0x2166 0x823e 0x93b4 0x2231 0x8437 0x939a 0x2324 0x8630 0x9380 0x23d5 0x882a 0x9363 0x246b 0x8a23 0x9345 0x2570 0x8c1c 0x9323 0x261a 0x8e15 0x9306 0x2756 0x900e 0x92e5 0x2838 0x9207 0x92c1 0x2925 0x9401 0x929b 0x2a0b 0x95fa 0x9275 0x2ade 0x97f3 0x924d 0x2bba 0x99ec 0x9223 0x2c7f 0x9be5 0x91f8 0x2d46 0x9ddf 0x91cb 0x2dfc 0x9fd8 0x919c 0x2ec8 0xa1d1 0x9167 0x2f90 0xa3ca 0x9133 0x305c 0xa5c3 0x9100 0x312f 0xa7bc 0x90c9 0x31f6 0xa9b6 0x9093 0x32ca 0xabaf 0x905b 0x3399 0xada8 0x901f 0x344a 0xafa1 0x8fe3 0x3522 0xb19a 0x8f9f 0x35f7 0xb394 0x8f4c 0x36da 0xb58d 0x8ee0 0x37a0 0xb786 0x8e4d 0x3888 0xb97f 0x8d84 0x394f 0xbb78 0x8c65 0x3a84 0xbd71 0x8adb 0x3c00 0xbf6b 0x88b2 0x3e92 0xc164 0x8562 0x42cf 0xc35d 0x800d 0x4b6c>;
		battery2_profile_t4_col = <0x3>;
		battery2_profile_t4_num = <0x64>;
		battery2_profile_t5 = <0x0 0xabbf 0x12f2 0x1f9 0xaab9 0x1373 0x3f2 0xa970 0x2254 0x5ec 0xa85a 0x233b 0x7e5 0xa76a 0x22bb 0x9de 0xa689 0x2229 0xbd7 0xa5bc 0x217e 0xdd0 0xa4ff 0x2102 0xfc9 0xa44e 0x2077 0x11c3 0xa3a7 0x1ffc 0x13bc 0xa305 0x1f80 0x15b5 0xa267 0x1f01 0x17ae 0xa1d2 0x1e89 0x19a7 0xa154 0x1e43 0x1ba1 0xa0eb 0x1e39 0x1d9a 0xa07c 0x1e25 0x1f93 0x9ff4 0x1ddf 0x218c 0x9f4a 0x1d5e 0x2385 0x9e84 0x1c87 0x257e 0x9dc3 0x1ba9 0x2778 0x9d1c 0x1af7 0x2971 0x9c8e 0x1a7f 0x2b6a 0x9c16 0x1a1a 0x2d63 0x9bb0 0x19da 0x2f5c 0x9b53 0x19a4 0x3156 0x9afe 0x198e 0x334f 0x9ab5 0x1974 0x3548 0x9a6f 0x1968 0x3741 0x9a26 0x1953 0x393a 0x99d7 0x1940 0x3b33 0x9985 0x1941 0x3d2d 0x9931 0x1922 0x3f26 0x98db 0x190a 0x411f 0x988b 0x18f3 0x4318 0x9838 0x18e7 0x4511 0x97ec 0x18c5 0x470b 0x97a2 0x18ca 0x4904 0x9759 0x18be 0x4afd 0x9717 0x18c3 0x4cf6 0x96d7 0x18bd 0x4eef 0x9699 0x18c1 0x50e8 0x965b 0x18c2 0x52e2 0x9621 0x18c9 0x54db 0x95ee 0x18e7 0x56d4 0x95bb 0x18f7 0x58cd 0x958b 0x190d 0x5ac6 0x9562 0x1923 0x5cc0 0x953d 0x1944 0x5eb9 0x951e 0x1972 0x60b2 0x9503 0x19a6 0x62ab 0x94eb 0x19da 0x64a4 0x94d7 0x19cd 0x669d 0x94c3 0x1a36 0x6897 0x94b2 0x1a8e 0x6a90 0x94a2 0x194a 0x6c89 0x9490 0x1a79 0x6e82 0x947f 0x1ba5 0x707b 0x946a 0x1c2f 0x7275 0x9459 0x1ca5 0x746e 0x9456 0x1d48 0x7667 0x943b 0x1d6e 0x7860 0x9426 0x1e0b 0x7a59 0x9411 0x1ef6 0x7c52 0x93fa 0x1fc7 0x7e4c 0x93e3 0x2089 0x8045 0x93ca 0x2166 0x823e 0x93b4 0x2231 0x8437 0x939a 0x2324 0x8630 0x9380 0x23d5 0x882a 0x9363 0x246b 0x8a23 0x9345 0x2570 0x8c1c 0x9323 0x261a 0x8e15 0x9306 0x2756 0x900e 0x92e5 0x2838 0x9207 0x92c1 0x2925 0x9401 0x929b 0x2a0b 0x95fa 0x9275 0x2ade 0x97f3 0x924d 0x2bba 0x99ec 0x9223 0x2c7f 0x9be5 0x91f8 0x2d46 0x9ddf 0x91cb 0x2dfc 0x9fd8 0x919c 0x2ec8 0xa1d1 0x9167 0x2f90 0xa3ca 0x9133 0x305c 0xa5c3 0x9100 0x312f 0xa7bc 0x90c9 0x31f6 0xa9b6 0x9093 0x32ca 0xabaf 0x905b 0x3399 0xada8 0x901f 0x344a 0xafa1 0x8fe3 0x3522 0xb19a 0x8f9f 0x35f7 0xb394 0x8f4c 0x36da 0xb58d 0x8ee0 0x37a0 0xb786 0x8e4d 0x3888 0xb97f 0x8d84 0x394f 0xbb78 0x8c65 0x3a84 0xbd71 0x8adb 0x3c00 0xbf6b 0x88b2 0x3e92 0xc164 0x8562 0x42cf 0xc35d 0x800d 0x4b6c>;
		battery2_profile_t5_col = <0x3>;
		battery2_profile_t5_num = <0x64>;
		compatible = "mediatek,bat_gm30";
		enable_tmp_intr_suspend = <0x0>;
		g_FG_PSEUDO100_T0 = <0x64>;
		g_FG_PSEUDO100_T1 = <0x64>;
		g_FG_PSEUDO100_T2 = <0x64>;
		g_FG_PSEUDO100_T3 = <0x64>;
		g_FG_PSEUDO100_T4 = <0x64>;
		g_PMIC_MIN_VOL = <0x82dc 0x82dc 0x87f0 0x82dc 0x80e8 0x80e8 0x87f0 0x80e8 0x82dc 0x82dc 0x87f0 0x82dc 0x7dc8 0x7dc8 0x87f0 0x7dc8 0x7c9c 0x7c9c 0x87f0 0x7c9c 0x7b0c 0x7b0c 0x87f0 0x7b0c 0x7918 0x7918 0x7918 0x7918 0x7918 0x7918 0x7918 0x7918 0x7918 0x7918 0x7918 0x7918 0x7918 0x7918 0x7918 0x79e0>;
		io-channel-names = "batteryID-channel";
		io-channels = <0x23 0x3>;
		phandle = <0xa8>;
		tran_Q_diff = <0xffffffff 0xffffffff 0xffffffff 0xffffffff>;
	};

	bpi_bsi_slv0@1021e000 {
		compatible = "mediatek,bpi_bsi_slv0";
		reg = <0x0 0x1021e000 0x0 0x1000>;
	};

	bpi_bsi_slv1@1021f000 {
		compatible = "mediatek,bpi_bsi_slv1";
		reg = <0x0 0x1021f000 0x0 0x6000>;
	};

	bpi_bsi_slv2@10225000 {
		compatible = "mediatek,bpi_bsi_slv2";
		reg = <0x0 0x10225000 0x0 0x1000>;
	};

	btif@1100c000 {
		clock-names = "btifc", "apdmac";
		clocks = <0x21 0x1a 0x21 0x26>;
		compatible = "mediatek,btif";
		interrupts = <0x0 0x85 0x8 0x0 0x73 0x8 0x0 0x8d 0x8>;
		reg = <0x0 0x1100c000 0x0 0x1000 0x0 0x11000b80 0x0 0x80 0x0 0x11000c00 0x0 0x80>;
	};

	bus_dbg@10208000 {
		compatible = "mediatek,bus_dbg-v2";
		interrupts = <0x0 0x9e 0x8>;
		mediatek,bus_dbg_con_offset = <0x2fc>;
		reg = <0x0 0x10208000 0x0 0x1000 0x0 0x10001000 0x0 0x1000>;
	};

	cache_parity {
		compatible = "mediatek,cache_parity";
		err_level = <0x1>;
		interrupts = <0x0 0x16 0x4 0x0 0x17 0x4 0x0 0x18 0x4 0x0 0x19 0x4 0x0 0x1a 0x4 0x0 0x1b 0x4 0x0 0x1c 0x4 0x0 0x1d 0x4 0x0 0x13 0x4>;
		irq_config = <0x0 0x8090 0xff00 0x8090 0x44 0x8090 0xff 0x1 0x8090 0xff00 0x8090 0x44 0x8090 0xff 0x2 0x8090 0xff00 0x8090 0x44 0x8090 0xff 0x3 0x8090 0xff00 0x8090 0x44 0x8090 0xff 0x4 0x8090 0xff00 0x8090 0x44 0x8090 0xff 0x5 0x8090 0xff00 0x8090 0x44 0x8090 0xff 0x6 0x8090 0xff00 0x8090 0x44 0x8090 0xff 0x7 0x8090 0xff00 0x8090 0x44 0x8090 0xff 0x400 0xc8c0 0x1000000 0xc8c0 0xc 0xc8c8 0x1>;
		reg = <0x0 0xc530000 0x0 0x10000>;
		version = <0x1>;
	};

	cam1@1a003000 {
		compatible = "mediatek,cam1";
		interrupts = <0x0 0xfa 0x8>;
		reg = <0x0 0x1a003000 0x0 0x1000>;
	};

	cam2@1a004000 {
		compatible = "mediatek,cam2";
		interrupts = <0x0 0xfb 0x8>;
		reg = <0x0 0x1a004000 0x0 0x1000>;
	};

	cam3@1a005000 {
		compatible = "mediatek,cam3";
		interrupts = <0x0 0xfc 0x8>;
		reg = <0x0 0x1a005000 0x0 0x1000>;
	};

	cam_clear@1a01b000 {
		compatible = "mediatek,cam_clear";
		reg = <0x0 0x1a01b000 0x0 0x1000>;
	};

	cam_inner@1a013000 {
		compatible = "mediatek,cam_inner";
		reg = <0x0 0x1a013000 0x0 0x1000>;
	};

	cam_set@1a00b000 {
		compatible = "mediatek,cam_set";
		reg = <0x0 0x1a00b000 0x0 0x1000>;
	};

	cama_clear@1a01c000 {
		compatible = "mediatek,cama_clear";
		reg = <0x0 0x1a01c000 0x0 0x1000>;
	};

	cama_ext@1a024000 {
		compatible = "mediatek,cama_ext";
		reg = <0x0 0x1a024000 0x0 0x1000>;
	};

	cama_inner@1a014000 {
		compatible = "mediatek,cama_inner";
		reg = <0x0 0x1a014000 0x0 0x1000>;
	};

	cama_set@1a00c000 {
		compatible = "mediatek,cama_set";
		reg = <0x0 0x1a00c000 0x0 0x1000>;
	};

	camb_clear@1a01d000 {
		compatible = "mediatek,camb_clear";
		reg = <0x0 0x1a01d000 0x0 0x1000>;
	};

	camb_ext@1a025000 {
		compatible = "mediatek,camb_ext";
		reg = <0x0 0x1a025000 0x0 0x1000>;
	};

	camb_inner@1a015000 {
		compatible = "mediatek,camb_inner";
		reg = <0x0 0x1a015000 0x0 0x1000>;
	};

	camb_set@1a00d000 {
		compatible = "mediatek,camb_set";
		reg = <0x0 0x1a00d000 0x0 0x1000>;
	};

	camsv1@1a050000 {
		compatible = "mediatek,camsv1";
		interrupts = <0x0 0x102 0x8>;
		reg = <0x0 0x1a050000 0x0 0x1000>;
	};

	camsv2@1a051000 {
		compatible = "mediatek,camsv2";
		interrupts = <0x0 0x103 0x8>;
		reg = <0x0 0x1a051000 0x0 0x1000>;
	};

	camsv3@1a052000 {
		compatible = "mediatek,camsv3";
		interrupts = <0x0 0x100 0x8>;
		reg = <0x0 0x1a052000 0x0 0x1000>;
	};

	camsv4@1a053000 {
		compatible = "mediatek,camsv4";
		interrupts = <0x0 0x101 0x8>;
		reg = <0x0 0x1a053000 0x0 0x1000>;
	};

	camsys@1a000000 {
		#clock-cells = <0x1>;
		compatible = "mediatek,camsys", "syscon";
		phandle = <0x57>;
		reg = <0x0 0x1a000000 0x0 0x1000>;
	};

	ccu@1a0b1000 {
		clock-names = "CCU_CLK_CAM_CCU", "CAM_PWR";
		clocks = <0x57 0x8 0x22 0xa>;
		compatible = "mediatek,ccu";
		interrupts = <0x0 0x105 0x8>;
		reg = <0x0 0x1a0b1000 0x0 0x10000>;
	};

	charger {
		ac_charger_current = <0x1e8480>;
		ac_charger_input_current = <0x1e8480>;
		algorithm_name = "SwitchCharging";
		apple_1_0a_charger_current = <0x9eb10>;
		apple_2_1a_charger_current = <0xc3500>;
		battery_cv = <0x432380>;
		bif_cv_under_threshold2 = <0x43e6d0>;
		bif_threshold1 = <0x40d990>;
		bif_threshold2 = <0x419ce0>;
		cable_imp_threshold = <0x2bb>;
		charging_host_charger_current = <0x16e360>;
		chg1_ta_ac_charger_current = <0x16e360>;
		chg2_ta_ac_charger_current = <0x16e360>;
		compatible = "mediatek,charger";
		disable_pd_dual;
		dual_polling_ieoc = <0x6ddd0>;
		enable_ir_comp;
		enable_min_charge_temp;
		enable_pe_2;
		enable_pe_plus;
		enable_sw_jeita;
		high_temp_to_enter_pe40 = <0x27>;
		high_temp_to_leave_pe40 = <0x2e>;
		ibus_err = <0xe>;
		jeita_temp_above_t4_cv = <0x3e8fa0>;
		jeita_temp_below_t0_cv = <0x432380>;
		jeita_temp_t0_to_t1_cv = <0x432380>;
		jeita_temp_t1_to_t2_cv = <0x432380>;
		jeita_temp_t2_to_t3_cv = <0x432380>;
		jeita_temp_t3_to_t4_cv = <0x3e8fa0>;
		low_temp_to_enter_pe40 = <0x10>;
		low_temp_to_leave_pe40 = <0xa>;
		max_charge_temp = <0x35>;
		max_charge_temp_minus_x_degree = <0x34>;
		max_charger_voltage = <0x632ea0>;
		max_charging_time = <0x11940>;
		max_dmivr_charger_current = <0x155cc0>;
		min_charge_temp = <0x0>;
		min_charge_temp_plus_x_degree = <0x1>;
		min_charger_voltage = <0x4630c0>;
		min_charger_voltage_1 = <0x432380>;
		min_charger_voltage_2 = <0x401640>;
		non_std_ac_charger_current = <0x124f80>;
		pd_ichg_level_threshold = <0xf4240>;
		pd_stop_battery_soc = <0x50>;
		pd_vbus_low_bound = <0x4c4b40>;
		pd_vbus_upper_bound = <0x4c4b40>;
		pe20_ichg_level_threshold = <0xf4240>;
		pe40_dual_charger_chg1_current = <0x1e8480>;
		pe40_dual_charger_chg2_current = <0x1e8480>;
		pe40_dual_charger_input_current = <0x2dc6c0>;
		pe40_r_cable_1a_lower = <0x206>;
		pe40_r_cable_2a_lower = <0x17f>;
		pe40_r_cable_3a_lower = <0xf5>;
		pe40_single_charger_current = <0x2dc6c0>;
		pe40_single_charger_input_current = <0x2dc6c0>;
		pe40_stop_battery_soc = <0x50>;
		pe_ichg_level_threshold = <0xf4240>;
		phandle = <0xd5>;
		power_path_support;
		r_bat_comp = <0x23>;
		slave_mivr_diff = <0x186a0>;
		ta_9v_support;
		ta_ac_12v_input_current = <0x30d400>;
		ta_ac_7v_input_current = <0x1e8480>;
		ta_ac_9v_input_current = <0x1e8480>;
		ta_ac_charger_current = <0x2dc6c0>;
		ta_start_battery_soc = <0x0>;
		ta_stop_battery_soc = <0x5a>;
		temp_neg_10_thres = <0x2>;
		temp_t0_thres = <0x1>;
		temp_t0_thres_plus_x_degree = <0x1>;
		temp_t1_thres = <0x1>;
		temp_t1_thres_plus_x_degree = <0x1>;
		temp_t2_thres = <0xf>;
		temp_t2_thres_plus_x_degree = <0x10>;
		temp_t3_thres = <0x2d>;
		temp_t3_thres_minus_x_degree = <0x2c>;
		temp_t4_thres = <0x37>;
		temp_t4_thres_minus_x_degree = <0x33>;
		usb_charger_current = <0x7a120>;
		usb_charger_current_configured = <0x7a120>;
		usb_charger_current_suspend = <0x0>;
		usb_charger_current_unconfigured = <0x11170>;
		v_comp_max = <0x186a0>;
		vbat_cable_imp_threshold = <0x3b8260>;
		vsys_watt = <0x4c4b40>;
	};

	chipid@08000000 {
		compatible = "mediatek,chipid";
		reg = <0x0 0x8000000 0x0 0x4 0x0 0x8000004 0x0 0x4 0x0 0x8000008 0x0 0x4 0x0 0x800000c 0x0 0x4>;
	};

	chn_emi@1021a000 {
		compatible = "mediatek,chn_emi";
		reg = <0x0 0x1021a000 0x0 0x1000>;
	};

	chosen {
		bootargs = "console=tty0 console=ttyS0,921600n1 root=/dev/ram vmalloc=400M slub_debug=OFZPU swiotlb=noforce cgroup.memory=nosocket,nokmem firmware_class.path=/vendor/firmware page_owner=on loop.max_part=7";
		kaslr-seed = <0x0 0x0>;
		phandle = <0x63>;
	};

	clocks {

		clk26m {
			#clock-cells = <0x0>;
			clock-frequency = <0x18cba80>;
			compatible = "fixed-clock";
			phandle = <0x13>;
		};

		clk32k {
			#clock-cells = <0x0>;
			clock-frequency = <0x7d00>;
			compatible = "fixed-clock";
			phandle = <0x1f>;
		};
	};

	consys@18002000 {
		#address-cells = <0x2>;
		#size-cells = <0x2>;
		clock-names = "conn";
		clocks = <0x22 0x1>;
		compatible = "mediatek,mt6768-consys";
		interrupts = <0x0 0x11c 0x8 0x0 0x4e 0x8 0x0 0x11f 0x1>;
		phandle = <0xbb>;
		reg = <0x0 0x18002000 0x0 0x1000 0x0 0x10007000 0x0 0x100 0x0 0x10001000 0x0 0x1000 0x0 0x10006000 0x0 0x1000 0x0 0x18007000 0x0 0x1000 0x0 0x180b1000 0x0 0x1000 0x0 0x180a3000 0x0 0x1000 0x0 0x180a5000 0x0 0x800 0x0 0x180c1000 0x0 0x1000 0x0 0x18004000 0x0 0x1000>;
		wifi_ant_swap_gpio = <0x1e 0x6c 0x0>;
	};

	cpu_dbgapb@0e010000 {
		compatible = "mediatek,hw_dbg";
		num = <0x8>;
		phandle = <0x67>;
		reg = <0x0 0xe010000 0x0 0x1000 0x0 0xe110000 0x0 0x1000 0x0 0xe210000 0x0 0x1000 0x0 0xe310000 0x0 0x1000 0x0 0xe410000 0x0 0x1000 0x0 0xe510000 0x0 0x1000 0x0 0xe610000 0x0 0x1000 0x0 0xe710000 0x0 0x1000>;
	};

	cpus {
		#address-cells = <0x1>;
		#size-cells = <0x0>;

		cpu-map {

			cluster0 {

				core0 {
					cpu = <0x9>;
				};

				core1 {
					cpu = <0xa>;
				};

				core2 {
					cpu = <0xb>;
				};

				core3 {
					cpu = <0xc>;
				};

				core4 {
					cpu = <0xd>;
				};

				core5 {
					cpu = <0xe>;
				};

				doe {
					phandle = <0x64>;
				};
			};

			cluster1 {

				core0 {
					cpu = <0xf>;
				};

				core1 {
					cpu = <0x10>;
				};

				doe {
					phandle = <0x65>;
				};
			};
		};

		cpu@000 {
			clock-frequency = <0x65633340>;
			compatible = "arm,cortex-a55";
			cpu-idle-states = <0x2 0x3 0x4 0x5 0x6 0x7 0x8>;
			device_type = "cpu";
			enable-method = "psci";
			phandle = <0x9>;
			reg = <0x0>;
		};

		cpu@001 {
			clock-frequency = <0x65633340>;
			compatible = "arm,cortex-a55";
			cpu-idle-states = <0x2 0x3 0x4 0x5 0x6 0x7 0x8>;
			device_type = "cpu";
			enable-method = "psci";
			phandle = <0xa>;
			reg = <0x100>;
		};

		cpu@002 {
			clock-frequency = <0x65633340>;
			compatible = "arm,cortex-a55";
			cpu-idle-states = <0x2 0x3 0x4 0x5 0x6 0x7 0x8>;
			device_type = "cpu";
			enable-method = "psci";
			phandle = <0xb>;
			reg = <0x200>;
		};

		cpu@003 {
			clock-frequency = <0x65633340>;
			compatible = "arm,cortex-a55";
			cpu-idle-states = <0x2 0x3 0x4 0x5 0x6 0x7 0x8>;
			device_type = "cpu";
			enable-method = "psci";
			phandle = <0xc>;
			reg = <0x300>;
		};

		cpu@100 {
			clock-frequency = <0x65633340>;
			compatible = "arm,cortex-a55";
			cpu-idle-states = <0x2 0x3 0x4 0x5 0x6 0x7 0x8>;
			device_type = "cpu";
			enable-method = "psci";
			phandle = <0xd>;
			reg = <0x400>;
		};

		cpu@101 {
			clock-frequency = <0x65633340>;
			compatible = "arm,cortex-a55";
			cpu-idle-states = <0x2 0x3 0x4 0x5 0x6 0x7 0x8>;
			device_type = "cpu";
			enable-method = "psci";
			phandle = <0xe>;
			reg = <0x500>;
		};

		cpu@102 {
			clock-frequency = <0x8166d4c0>;
			compatible = "arm,cortex-a75";
			cpu-idle-states = <0x2 0x3 0x4 0x5 0x6 0x7 0x8>;
			device_type = "cpu";
			enable-method = "psci";
			phandle = <0xf>;
			reg = <0x600>;
		};

		cpu@103 {
			clock-frequency = <0x8166d4c0>;
			compatible = "arm,cortex-a75";
			cpu-idle-states = <0x2 0x3 0x4 0x5 0x6 0x7 0x8>;
			device_type = "cpu";
			enable-method = "psci";
			phandle = <0x10>;
			reg = <0x700>;
		};

		idle-states {
			entry-method = "arm,psci";

			idlebus26m {
				arm,psci-suspend-param = <0x1010004>;
				compatible = "arm,idle-state";
				entry-latency-us = <0x320>;
				exit-latency-us = <0x3e8>;
				min-residency-us = <0x7d0>;
				phandle = <0x7>;
				status = "okay";
			};

			idledram {
				arm,psci-suspend-param = <0x1010002>;
				compatible = "arm,idle-state";
				entry-latency-us = <0x320>;
				exit-latency-us = <0x3e8>;
				min-residency-us = <0x7d0>;
				phandle = <0x5>;
				status = "okay";
			};

			idlesyspll {
				arm,psci-suspend-param = <0x1010003>;
				compatible = "arm,idle-state";
				entry-latency-us = <0x320>;
				exit-latency-us = <0x3e8>;
				min-residency-us = <0x7d0>;
				phandle = <0x6>;
				status = "okay";
			};

			mcdi-cluster {
				arm,psci-suspend-param = <0x1010001>;
				compatible = "arm,idle-state";
				entry-latency-us = <0x258>;
				exit-latency-us = <0x258>;
				min-residency-us = <0x4b0>;
				phandle = <0x4>;
			};

			mcdi-cpu {
				arm,psci-suspend-param = <0x10001>;
				compatible = "arm,idle-state";
				entry-latency-us = <0x258>;
				exit-latency-us = <0x258>;
				min-residency-us = <0x4b0>;
				phandle = <0x3>;
			};

			standby {
				arm,psci-suspend-param = <0x1>;
				compatible = "arm,idle-state";
				entry-latency-us = <0x258>;
				exit-latency-us = <0x258>;
				min-residency-us = <0x4b0>;
				phandle = <0x2>;
			};

			suspend {
				arm,psci-suspend-param = <0x1010005>;
				compatible = "arm,idle-state";
				entry-latency-us = <0x320>;
				exit-latency-us = <0x3e8>;
				min-residency-us = <0x7d0>;
				phandle = <0x8>;
			};
		};
	};

	cq_dma@10212000 {
		clock-names = "cqdma";
		clocks = <0x21 0x43>;
		compatible = "mediatek,mt-cqdma-v1";
		interrupts = <0x0 0x86 0x8 0x0 0x87 0x8 0x0 0x88 0x8>;
		nr_channel = <0x3>;
		reg = <0x0 0x10212000 0x0 0x80 0x0 0x10212080 0x0 0x80 0x0 0x10212100 0x0 0x80>;
	};

	dbg_apmcu_mp0@0d400000 {
		compatible = "mediatek,dbg_apmcu_mp0";
		reg = <0x0 0xd400000 0x0 0x1000>;
	};

	dbg_apmcu_mp0@0d410000 {
		compatible = "mediatek,dbg_apmcu_mp0";
		reg = <0x0 0xd410000 0x0 0x1000>;
	};

	dbg_apmcu_mp0@0d420000 {
		compatible = "mediatek,dbg_apmcu_mp0";
		reg = <0x0 0xd420000 0x0 0x1000>;
	};

	dbg_apmcu_mp0@0d430000 {
		compatible = "mediatek,dbg_apmcu_mp0";
		reg = <0x0 0xd430000 0x0 0x1000>;
	};

	dbg_apmcu_mp0@0d440000 {
		compatible = "mediatek,dbg_apmcu_mp0";
		reg = <0x0 0xd440000 0x0 0x1000>;
	};

	dbg_apmcu_mp0@0d510000 {
		compatible = "mediatek,dbg_apmcu_mp0";
		reg = <0x0 0xd510000 0x0 0x1000>;
	};

	dbg_apmcu_mp0@0d520000 {
		compatible = "mediatek,dbg_apmcu_mp0";
		reg = <0x0 0xd520000 0x0 0x1000>;
	};

	dbg_apmcu_mp0@0d530000 {
		compatible = "mediatek,dbg_apmcu_mp0";
		reg = <0x0 0xd530000 0x0 0x1000>;
	};

	dbg_apmcu_mp0@0d540000 {
		compatible = "mediatek,dbg_apmcu_mp0";
		reg = <0x0 0xd540000 0x0 0x1000>;
	};

	dbg_apmcu_mp0@0d610000 {
		compatible = "mediatek,dbg_apmcu_mp0";
		reg = <0x0 0xd610000 0x0 0x1000>;
	};

	dbg_apmcu_mp0@0d620000 {
		compatible = "mediatek,dbg_apmcu_mp0";
		reg = <0x0 0xd620000 0x0 0x1000>;
	};

	dbg_apmcu_mp0@0d630000 {
		compatible = "mediatek,dbg_apmcu_mp0";
		reg = <0x0 0xd630000 0x0 0x1000>;
	};

	dbg_apmcu_mp0@0d640000 {
		compatible = "mediatek,dbg_apmcu_mp0";
		reg = <0x0 0xd640000 0x0 0x1000>;
	};

	dbg_apmcu_mp0@0d710000 {
		compatible = "mediatek,dbg_apmcu_mp0";
		reg = <0x0 0xd710000 0x0 0x1000>;
	};

	dbg_apmcu_mp0@0d720000 {
		compatible = "mediatek,dbg_apmcu_mp0";
		reg = <0x0 0xd720000 0x0 0x1000>;
	};

	dbg_apmcu_mp0@0d730000 {
		compatible = "mediatek,dbg_apmcu_mp0";
		reg = <0x0 0xd730000 0x0 0x1000>;
	};

	dbg_apmcu_mp0@0d740000 {
		compatible = "mediatek,dbg_apmcu_mp0";
		reg = <0x0 0xd740000 0x0 0x1000>;
	};

	dbg_apmcu_mp1@0d800000 {
		compatible = "mediatek,dbg_apmcu_mp1";
		reg = <0x0 0xd800000 0x0 0x1000>;
	};

	dbg_apmcu_mp1@0d810000 {
		compatible = "mediatek,dbg_apmcu_mp1";
		reg = <0x0 0xd810000 0x0 0x1000>;
	};

	dbg_apmcu_mp1@0d820000 {
		compatible = "mediatek,dbg_apmcu_mp1";
		reg = <0x0 0xd820000 0x0 0x1000>;
	};

	dbg_apmcu_mp1@0d830000 {
		compatible = "mediatek,dbg_apmcu_mp1";
		reg = <0x0 0xd830000 0x0 0x1000>;
	};

	dbg_apmcu_mp1@0d840000 {
		compatible = "mediatek,dbg_apmcu_mp1";
		reg = <0x0 0xd840000 0x0 0x1000>;
	};

	dbg_apmcu_mp1@0d910000 {
		compatible = "mediatek,dbg_apmcu_mp1";
		reg = <0x0 0xd910000 0x0 0x1000>;
	};

	dbg_apmcu_mp1@0d920000 {
		compatible = "mediatek,dbg_apmcu_mp1";
		reg = <0x0 0xd920000 0x0 0x1000>;
	};

	dbg_apmcu_mp1@0d930000 {
		compatible = "mediatek,dbg_apmcu_mp1";
		reg = <0x0 0xd930000 0x0 0x1000>;
	};

	dbg_apmcu_mp1@0d940000 {
		compatible = "mediatek,dbg_apmcu_mp1";
		reg = <0x0 0xd940000 0x0 0x1000>;
	};

	dbg_apmcu_mp1@0da10000 {
		compatible = "mediatek,dbg_apmcu_mp1";
		reg = <0x0 0xda10000 0x0 0x1000>;
	};

	dbg_apmcu_mp1@0da20000 {
		compatible = "mediatek,dbg_apmcu_mp1";
		reg = <0x0 0xda20000 0x0 0x1000>;
	};

	dbg_apmcu_mp1@0da30000 {
		compatible = "mediatek,dbg_apmcu_mp1";
		reg = <0x0 0xda30000 0x0 0x1000>;
	};

	dbg_apmcu_mp1@0da40000 {
		compatible = "mediatek,dbg_apmcu_mp1";
		reg = <0x0 0xda40000 0x0 0x1000>;
	};

	dbg_apmcu_mp1@0db10000 {
		compatible = "mediatek,dbg_apmcu_mp1";
		reg = <0x0 0xdb10000 0x0 0x1000>;
	};

	dbg_apmcu_mp1@0db20000 {
		compatible = "mediatek,dbg_apmcu_mp1";
		reg = <0x0 0xdb20000 0x0 0x1000>;
	};

	dbg_apmcu_mp1@0db30000 {
		compatible = "mediatek,dbg_apmcu_mp1";
		reg = <0x0 0xdb30000 0x0 0x1000>;
	};

	dbg_apmcu_mp1@0db40000 {
		compatible = "mediatek,dbg_apmcu_mp1";
		reg = <0x0 0xdb40000 0x0 0x1000>;
	};

	dbg_cti@0d020000 {
		compatible = "mediatek,dbg_cti";
		reg = <0x0 0xd020000 0x0 0x10000>;
	};

	dbg_dem@0d0a0000 {
		compatible = "mediatek,dbg_dem";
		interrupts = <0x0 0x9d 0x8>;
		reg = <0x0 0xd0a0000 0x0 0x10000>;
	};

	dbg_etr@0d030000 {
		compatible = "mediatek,dbg_etr";
		reg = <0x0 0xd030000 0x0 0x10000>;
	};

	dbg_funnel@0d040000 {
		compatible = "mediatek,dbg_funnel";
		reg = <0x0 0xd040000 0x0 0x10000>;
	};

	dbg_mdsys1@0d0c0000 {
		compatible = "mediatek,dbg_mdsys1";
		reg = <0x0 0xd0c0000 0x0 0x40000>;
	};

	dcm {
		compatible = "mediatek,dcm";
		phandle = <0x6d>;
	};

	ddrphy@10015000 {
		compatible = "mediatek,ddrphy";
		reg = <0x0 0x10015000 0x0 0x1000>;
	};

	devapc@10207000 {
		clock-names = "devapc-infra-clock";
		clocks = <0x21 0x28>;
		compatible = "mediatek,mt6768-devapc";
		interrupts = <0x0 0x9f 0x8>;
		reg = <0x0 0x10207000 0x0 0x1000 0x0 0x1000e000 0x0 0x1000>;
	};

	dfd@10200b00 {
		compatible = "mediatek,dfd";
		mediatek,chain_length = <0xa7f8>;
		mediatek,enabled = <0x1>;
		mediatek,rg_dfd_timeout = <0xa0>;
		reg = <0x0 0x10200b00 0x0 0x10000>;
	};

	dfd_cache {
		compatible = "mediatek,dfd_cache";
		mediatek,enabled = <0x0>;
		mediatek,rg_dfd_timeout = <0x3e80>;
		phandle = <0xa9>;
	};

	dip1@15022000 {
		compatible = "mediatek,dip1";
		interrupts = <0x0 0x10e 0x8>;
		reg = <0x0 0x15022000 0x0 0x3000>;
	};

	disp_aal0@14011000 {
		compatible = "mediatek,disp_aal0";
		interrupts = <0x0 0xeb 0x8>;
		reg = <0x0 0x14011000 0x0 0x1000>;
	};

	disp_ccorr0@14010000 {
		compatible = "mediatek,disp_ccorr0";
		interrupts = <0x0 0xea 0x8>;
		reg = <0x0 0x14010000 0x0 0x1000>;
	};

	disp_color0@1400f000 {
		clock-names = "MDP_COLOR";
		clocks = <0x24 0xc>;
		compatible = "mediatek,disp_color0";
		interrupts = <0x0 0xe9 0x8>;
		phandle = <0x2b>;
		reg = <0x0 0x1400f000 0x0 0x1000>;
	};

	disp_dither0@14013000 {
		compatible = "mediatek,disp_dither0";
		interrupts = <0x0 0xed 0x8>;
		reg = <0x0 0x14013000 0x0 0x1000>;
	};

	disp_gamma0@14012000 {
		compatible = "mediatek,disp_gamma0";
		interrupts = <0x0 0xec 0x8>;
		reg = <0x0 0x14012000 0x0 0x1000>;
	};

	disp_mutex0@14001000 {
		compatible = "mediatek,disp_mutex0";
		interrupts = <0x0 0xdf 0x8>;
		phandle = <0x2d>;
		reg = <0x0 0x14001000 0x0 0x1000>;
	};

	disp_ovl0@1400b000 {
		compatible = "mediatek,disp_ovl0";
		interrupts = <0x0 0xe6 0x8>;
		reg = <0x0 0x1400b000 0x0 0x1000>;
	};

	disp_ovl0_2l@1400c000 {
		compatible = "mediatek,disp_ovl0_2l";
		interrupts = <0x0 0xf2 0x8>;
		reg = <0x0 0x1400c000 0x0 0x1000>;
	};

	disp_pwm@1100e000 {
		compatible = "mediatek,disp_pwm";
		reg = <0x0 0x1100e000 0x0 0x1000>;
	};

	disp_rdma0@1400d000 {
		compatible = "mediatek,disp_rdma0";
		interrupts = <0x0 0xe7 0x8>;
		reg = <0x0 0x1400d000 0x0 0x1000>;
	};

	disp_rsz0@14015000 {
		compatible = "mediatek,disp_rsz0";
		interrupts = <0x0 0x125 0x8>;
		reg = <0x0 0x14015000 0x0 0x1000>;
	};

	disp_wdma0@1400e000 {
		compatible = "mediatek,disp_wdma0";
		interrupts = <0x0 0xe8 0x8>;
		reg = <0x0 0x1400e000 0x0 0x1000>;
	};

	dispsys {
		clock-names = "MMSYS_MTCMOS", "MMSYS_SMI_COMMON", "MMSYS_SMI_LARB0", "MMSYS_GALS_COMM0", "MMSYS_GALS_COMM1", "MMSYS_DISP_OVL0", "MMSYS_DISP_OVL0_2L", "MMSYS_DISP_RDMA0", "MMSYS_DISP_WDMA0", "MMSYS_DISP_COLOR0", "MMSYS_DISP_CCORR0", "MMSYS_DISP_AAL0", "MMSYS_DISP_GAMMA0", "MMSYS_DISP_DITHER0", "MMSYS_DSI0_MM_CK", "MMSYS_DSI0_IF_CK", "MMSYS_IMG_DL_RELAY", "MMSYS_26M", "MMSYS_DISP_RSZ0", "APMIXED_MIPI_26M", "TOP_MUX_DISP_PWM", "DISP_PWM", "TOP_26M", "TOP_UNIVPLL2_D4", "TOP_ULPOSC1_D2", "TOP_ULPOSC1_D8";
		clocks = <0x22 0x3 0x24 0x13 0x24 0x14 0x24 0x15 0x24 0x16 0x24 0x7 0x24 0x8 0x24 0xa 0x24 0xb 0x24 0xc 0x24 0xd 0x24 0xe 0x24 0xf 0x24 0x10 0x24 0x11 0x24 0x1e 0x24 0x1c 0x24 0x1f 0x24 0x9 0x3c 0x15 0x12 0x63 0x21 0x31 0x13 0x12 0x1b 0x12 0x2e 0x12 0x30>;
		compatible = "mediatek,dispsys";
		mediatek,larb = <0x55>;
	};

	dma-controller@11000980 {
		#dma-cells = <0x1>;
		clock-names = "apdma";
		clocks = <0x21 0x26>;
		compatible = "mediatek,mt6577-uart-dma";
		dma-bits = <0x22>;
		interrupts = <0x0 0x66 0x8 0x0 0x67 0x8 0x0 0x68 0x8 0x0 0x72 0x8>;
		phandle = <0x2f>;
		reg = <0x0 0x11000980 0x0 0x80 0x0 0x11000a00 0x0 0x80 0x0 0x11000a80 0x0 0x80 0x0 0x11000b00 0x0 0x80>;
	};

	dpe@15028000 {
		clock-names = "DPE_CG_IMG_DPE";
		clocks = <0x56 0x3>;
		compatible = "mediatek,dpe";
		interrupts = <0x0 0x10f 0x8>;
		reg = <0x0 0x15028000 0x0 0x1000>;
	};

	dramc@1022a000 {
		compatible = "mediatek,dramc";
		reg = <0x0 0x1022a000 0x0 0x2000 0x0 0x10232000 0x0 0x2000 0x0 0x1022c000 0x0 0x1000 0x0 0x10234000 0x0 0x1000 0x0 0x10228000 0x0 0x2000 0x0 0x10230000 0x0 0x2000 0x0 0x1022e000 0x0 0x1000 0x0 0x10236000 0x0 0x1000>;
	};

	drcc {
		compatible = "mediatek,drcc";
		drcc0_Code = <0xff>;
		drcc0_Hwgatepct = <0xff>;
		drcc0_Vref = <0xff>;
		drcc1_Code = <0xff>;
		drcc1_Hwgatepct = <0xff>;
		drcc1_Vref = <0xff>;
		drcc2_Code = <0xff>;
		drcc2_Hwgatepct = <0xff>;
		drcc2_Vref = <0xff>;
		drcc3_Code = <0xff>;
		drcc3_Hwgatepct = <0xff>;
		drcc3_Vref = <0xff>;
		drcc4_Code = <0xff>;
		drcc4_Hwgatepct = <0xff>;
		drcc4_Vref = <0xff>;
		drcc5_Code = <0xff>;
		drcc5_Hwgatepct = <0xff>;
		drcc5_Vref = <0xff>;
		drcc6_Code = <0xff>;
		drcc6_Hwgatepct = <0xff>;
		drcc6_Vref = <0xff>;
		drcc7_Code = <0xff>;
		drcc7_Hwgatepct = <0xff>;
		drcc7_Vref = <0xff>;
		phandle = <0xba>;
		state = <0xff>;
	};

	dsi0@14014000 {
		compatible = "mediatek,dsi0";
		interrupts = <0x0 0xee 0x8>;
		reg = <0x0 0x14014000 0x0 0x1000>;
	};

	dsi_te {
		compatible = "mediatek, dsi_te-eint";
		phandle = <0xc6>;
		status = "disabled";
	};

	dsu-pmu-0 {
		compatible = "arm,dsu-pmu";
		cpus = <0x9 0xa 0xb 0xc 0xd 0xe 0xf 0x10>;
		interrupts = <0x0 0x12 0x4>;
	};

	dvfsp@00110800 {
		B-table = <0x7d0 0x48 0x1 0x1 0x79e 0x45 0x1 0x1 0x76c 0x41 0x1 0x1 0x73a 0x3d 0x1 0x1 0x708 0x3a 0x1 0x1 0x6ae 0x36 0x1 0x1 0x655 0x32 0x1 0x1 0x60c 0x30 0x2 0x1 0x5a3 0x2b 0x2 0x1 0x54a 0x27 0x2 0x1 0x4f1 0x24 0x2 0x1 0x498 0x20 0x2 0x1 0x43f 0x1d 0x2 0x1 0x3e6 0x19 0x2 0x1 0x38d 0x16 0x2 0x1 0x352 0x13 0x2 0x1>;
		CCI-table = <0x4a3 0x38 0x2 0x1 0x460 0x34 0x2 0x1 0x419 0x30 0x2 0x1 0x3f6 0x2e 0x2 0x1 0x3c1 0x2b 0x2 0x1 0x38d 0x28 0x2 0x1 0x358 0x24 0x2 0x1 0x335 0x22 0x2 0x1 0x300 0x1f 0x2 0x1 0x2dd 0x1d 0x4 0x1 0x2ba 0x1b 0x4 0x1 0x297 0x19 0x4 0x1 0x274 0x17 0x4 0x1 0x251 0x15 0x4 0x1 0x3a 0x13 0x4 0x1 0x1f4 0x10 0x4 0x1>;
		L-table = <0x6a4 0x38 0x2 0x1 0x659 0x35 0x2 0x1 0x5dc 0x30 0x2 0x1 0x5aa 0x2e 0x2 0x1 0x55f 0x2b 0x2 0x1 0x52d 0x29 0x2 0x1 0x4fb 0x27 0x2 0x1 0x497 0x22 0x2 0x1 0x44c 0x29 0x2 0x1 0x41a 0x1d 0x2 0x1 0x3e7 0x1b 0x2 0x1 0x3b6 0x19 0x2 0x1 0x384 0x17 0x2 0x1 0x352 0x15 0x4 0x1 0x306 0x13 0x4 0x1 0x1f4 0x10 0x4 0x1>;
		big-down-time = <0x2ee>;
		big-rise-time = <0x3e8>;
		change_flag = <0x0>;
		compatible = "mediatek,mt6768-dvfsp";
		little-down-time = <0x2ee>;
		little-rise-time = <0x3e8>;
		phandle = <0xa3>;
		reg = <0x0 0x110800 0x0 0x1400 0x0 0x110800 0x0 0x1400>;
		state = <0x1>;
	};

	dvfsp@10227000 {
		compatible = "mediatek,dvfsp";
		reg = <0x0 0x10227000 0x0 0x1000>;
	};

	dvfsrc@10012000 {
		compatible = "mediatek,dvfsrc";
		phandle = <0x9e>;
		reg = <0x0 0x10012000 0x0 0x1000 0x0 0x110780 0x0 0x80>;
	};

	dxcc_sec@10210000 {
		compatible = "mediatek,dxcc_sec";
		interrupts = <0x0 0xb1 0x4>;
		reg = <0x0 0x10210000 0x0 0x1000>;
	};

	eem_fsm@1100b000 {
		compatible = "mediatek,eem_fsm";
		eem-clamp-big = <0x0>;
		eem-clamp-cci = <0x0>;
		eem-clamp-gpu = <0x0>;
		eem-clamp-little = <0x0>;
		eem-initmon-big = <0xf>;
		eem-initmon-cci = <0xf>;
		eem-initmon-gpu = <0xf>;
		eem-initmon-little = <0xf>;
		eem-offset-big = <0xff>;
		eem-offset-cci = <0xff>;
		eem-offset-gpu = <0xff>;
		eem-offset-little = <0xff>;
		eem-status = <0x1>;
		interrupts = <0x0 0x8e 0x8>;
		phandle = <0xb7>;
		reg = <0x0 0x1100b000 0x0 0x1000>;
	};

	efuse_dbg@10004000 {
		compatible = "mediatek,efuse_dbg";
		reg = <0x0 0x10004000 0x0 0x1000>;
	};

	efusec@11ce0000 {
		compatible = "mediatek,efusec";
		reg = <0x0 0x11ce0000 0x0 0x10000>;
	};

	emi@10219000 {
		compatible = "mediatek,emi";
		interrupts = <0x0 0xa1 0x8>;
		reg = <0x0 0x10219000 0x0 0x1000 0x0 0x10226000 0x0 0x1000 0x0 0x1022d000 0x0 0x1000 0x0 0x10235000 0x0 0x1000 0x0 0x1020e000 0x0 0x1000>;
	};

	emi_mpu@10226000 {
		compatible = "mediatek,emi_mpu";
		reg = <0x0 0x10226000 0x0 0x1000>;
	};

	fdvt@1502b000 {
		clock-names = "FD_CLK_IMG_FDVT";
		clocks = <0x56 0x2>;
		compatible = "mediatek,fdvt";
		interrupts = <0x0 0x111 0x8>;
		reg = <0x0 0x1502b000 0x0 0x1000>;
	};

	fhctl@1000ce00 {
		compatible = "mediatek,fhctl";
		reg = <0x0 0x1000ce00 0x0 0x200>;
	};

	fingerprint {
		compatible = "mediatek,goodix-fp";
		phandle = <0xa6>;
	};

	flashlight_core {
		compatible = "mediatek,flashlight_core";
		phandle = <0xca>;
	};

	flashlights_aw36515 {
		compatible = "mediatek,flashlights_aw36515";
		phandle = <0xcc>;
	};

	flashlights_mt6370 {
		compatible = "mediatek,flashlights_mt6370";
		decouple = <0x0>;
		phandle = <0xcb>;

		channel@1 {
			ct = <0x0>;
			part = <0x0>;
			type = <0x0>;
		};

		channel@2 {
			ct = <0x1>;
			part = <0x0>;
			type = <0x0>;
		};
	};

	flashlights_ocp81375 {
		compatible = "mediatek,flashlights_ocp81375";
		phandle = <0xcd>;
	};

	gauge_timer {
		compatible = "mediatek,gauge_timer_service";
	};

	gce@10238000 {
		#clock-cells = <0x1>;
		ap_dma_base = <0x18010000 0x17 0xffff0000>;
		audio_base = <0x17000000 0x12 0xffff0000>;
		buf_underrun_event_0 = <0x8c>;
		camsv_0_pass1_done = <0x143>;
		camsv_1_pass1_done = <0x144>;
		camsv_2_pass1_done = <0x145>;
		camsys1_base = <0x180a0000 0x1c 0xffff0000>;
		camsys2_base = <0x180b0000 0x1d 0xffff0000>;
		camsys_base = <0x18080000 0x1b 0xffff0000>;
		clock-names = "GCE", "GCE_TIMER", "MMSYS_MTCMOS";
		clocks = <0x21 0x9 0x21 0x18 0x22 0x3>;
		compatible = "mediatek,gce", "syscon";
		conn_peri_base = <0x18820000 0x7 0xffff0000>;
		dip_cq_thread0_frame_done = <0x101>;
		dip_cq_thread10_frame_done = <0x10b>;
		dip_cq_thread11_frame_done = <0x10c>;
		dip_cq_thread12_frame_done = <0x10d>;
		dip_cq_thread13_frame_done = <0x10e>;
		dip_cq_thread14_frame_done = <0x10f>;
		dip_cq_thread15_frame_done = <0x110>;
		dip_cq_thread16_frame_done = <0x111>;
		dip_cq_thread17_frame_done = <0x112>;
		dip_cq_thread18_frame_done = <0x113>;
		dip_cq_thread1_frame_done = <0x102>;
		dip_cq_thread2_frame_done = <0x103>;
		dip_cq_thread3_frame_done = <0x104>;
		dip_cq_thread4_frame_done = <0x105>;
		dip_cq_thread5_frame_done = <0x106>;
		dip_cq_thread6_frame_done = <0x107>;
		dip_cq_thread7_frame_done = <0x108>;
		dip_cq_thread8_frame_done = <0x109>;
		dip_cq_thread9_frame_done = <0x10a>;
		disp_2l_ovl0_frame_done = <0x1c>;
		disp_2l_ovl0_sof = <0x8>;
		disp_aal0_frame_done = <0x22>;
		disp_aal0_sof = <0xd>;
		disp_ccorr0_frame_done = <0x21>;
		disp_ccorr0_sof = <0xc>;
		disp_color0_frame_done = <0x20>;
		disp_color0_sof = <0xb>;
		disp_dither0_frame_done = <0x24>;
		disp_dither0_sof = <0xf>;
		disp_dither_base = <0x14010000 0x2 0xffff0000>;
		disp_dsi0_frame_done = <0x25>;
		disp_dsi0_sof = <0x10>;
		disp_gamma0_frame_done = <0x23>;
		disp_gamma0_sof = <0xe>;
		disp_mutex_reg = <0x14016000 0x1000>;
		disp_ovl0_frame_done = <0x1b>;
		disp_ovl0_frame_rst_done_pusle = <0x98>;
		disp_ovl0_sof = <0x7>;
		disp_pwm0_sof = <0x13>;
		disp_rdma0_frame_done = <0x1e>;
		disp_rdma0_sof = <0x9>;
		disp_rsz0_frame_done = <0x1d>;
		disp_rsz0_sof = <0x11>;
		disp_wdma0_frame_done = <0x1f>;
		disp_wdma0_rst_done = <0x93>;
		disp_wdma0_sof = <0xa>;
		dsi0_done_event = <0x8f>;
		dsi0_irq_event = <0x8e>;
		dsi0_te_event = <0x8d>;
		dsi0_te_from_infra = <0x382>;
		dve_frame_done = <0x114>;
		g3d_config_base = <0x13000000 0x0 0xffff0000>;
		gce_base = <0x18020000 0x18 0xffff0000>;
		gcpu_base = <0x10050000 0xf 0xffff0000>;
		img_dl_relay_sof = <0x12>;
		imgsys_base = <0x15020000 0x4 0xffff0000>;
		infra_na3_base = <0x10010000 0xb 0xffff0000>;
		infra_na4_base = <0x10020000 0xc 0xffff0000>;
		interrupts = <0x0 0xaa 0x8>;
		isp_frame_done_b = <0x142>;
		jpgenc_done = <0x123>;
		kp_base = <0x18840000 0x9 0xffff0000>;
		mboxes = <0x2e 0x0 0x0 0x4 0x2e 0x2 0x0 0x5 0x2e 0x3 0x0 0x4 0x2e 0x4 0x0 0x4 0x2e 0x6 0x0 0x3 0x2e 0x7 0xffffffff 0x2 0x2e 0x8 0x0 0x1 0x2e 0x9 0x0 0x1 0x2e 0xa 0x0 0x1 0x2e 0xb 0x0 0x1 0x2e 0xc 0x0 0x1 0x2e 0xd 0x0 0x1 0x2e 0xe 0x0 0x1 0x2e 0xf 0xffffffff 0x1>;
		mcucfg_base = <0x10040000 0xe 0xffff0000>;
		mdp_ccorr0 = <0x2c>;
		mdp_ccorr0_frame_done = <0x15>;
		mdp_ccorr0_sof = <0x1>;
		mdp_color0 = <0x2b>;
		mdp_rdma0 = <0x25>;
		mdp_rdma0_frame_done = <0x14>;
		mdp_rdma0_rst_done = <0x97>;
		mdp_rdma0_sof = <0x0>;
		mdp_rsz0 = <0x26>;
		mdp_rsz0_frame_done = <0x16>;
		mdp_rsz0_sof = <0x2>;
		mdp_rsz1 = <0x27>;
		mdp_rsz1_frame_done = <0x17>;
		mdp_rsz1_sof = <0x3>;
		mdp_tdshp0 = <0x2a>;
		mdp_tdshp0_frame_done = <0x1a>;
		mdp_tdshp0_sof = <0x6>;
		mdp_wdma0 = <0x28>;
		mdp_wdma_frame_done = <0x19>;
		mdp_wdma_rst_done = <0x94>;
		mdp_wdma_sof = <0x4>;
		mdp_wrot0 = <0x29>;
		mdp_wrot0_rst_done = <0x95>;
		mdp_wrot0_sof = <0x5>;
		mdp_wrot0_write_frame_done = <0x18>;
		mediatek,mailbox-gce = <0x2e>;
		mm_mutex = <0x2d>;
		mm_na_base = <0x14020000 0x3 0xffff0000>;
		mmsys_config = <0x24>;
		mmsys_config_base = <0x14000000 0x1 0xffff0000>;
		msdc2_base = <0x17020000 0x14 0xffff0000>;
		msdc3_base = <0x18000000 0x16 0xffff0000>;
		phandle = <0xa5>;
		pwm_sw_base = <0x1100e000 0x63 0xffff0000>;
		reg = <0x0 0x10238000 0x0 0x4000>;
		rsc_frame_done = <0x116>;
		scp_base = <0x10030000 0xd 0xffff0000>;
		scp_sram_base = <0x10000000 0xa 0xffff0000>;
		secure_thread = <0x6 0x8>;
		seninf_0_fifo_full = <0x147>;
		seninf_1_fifo_full = <0x148>;
		seninf_2_fifo_full = <0x149>;
		seninf_3_fifo_full = <0x14a>;
		seninf_4_fifo_full = <0x14b>;
		seninf_5_fifo_full = <0x14c>;
		seninf_6_fifo_full = <0x14d>;
		seninf_7_fifo_full = <0x14e>;
		sram_share_cnt = <0x1>;
		sram_share_engine = <0xd>;
		sram_share_event = <0x2c6>;
		stream_done_0 = <0x82>;
		stream_done_1 = <0x83>;
		stream_done_2 = <0x84>;
		stream_done_3 = <0x85>;
		stream_done_4 = <0x86>;
		stream_done_5 = <0x87>;
		stream_done_6 = <0x88>;
		stream_done_7 = <0x89>;
		stream_done_8 = <0x8a>;
		stream_done_9 = <0x8b>;
		topckgen_base = <0x18830000 0x8 0xffff0000>;
		tsf_done = <0x146>;
		usb0_base = <0x10200000 0x10 0xffff0000>;
		usb_sif_base = <0x10280000 0x11 0xffff0000>;
		vdec1_base = <0x17030000 0x15 0xffff0000>;
		vdec2_base = <0x18040000 0x19 0xffff0000>;
		vdec3_base = <0x18050000 0x1a 0xffff0000>;
		vdec_base = <0x17010000 0x13 0xffff0000>;
		vdec_gcon_base = <0x18800000 0x5 0xffff0000>;
		venc_128byte_cnt_done = <0x125>;
		venc_frame_done = <0x121>;
		venc_gcon_base = <0x18810000 0x6 0xffff0000>;
		venc_mb_done = <0x124>;
		venc_pause_done = <0x122>;
		wmf_frame_done = <0x115>;
	};

	gce_mbox@10238000 {
		#gce-event-cells = <0x1>;
		#gce-subsys-cells = <0x2>;
		#mbox-cells = <0x3>;
		clock-names = "gce", "gce-timer";
		clocks = <0x21 0x9 0x21 0x18>;
		compatible = "mediatek,mailbox-gce";
		interrupts = <0x0 0xaa 0x8>;
		phandle = <0x2e>;
		reg = <0x0 0x10238000 0x0 0x4000>;
	};

	gic500@0c000000 {
		compatible = "mediatek,gic500";
		reg = <0x0 0xc000000 0x0 0x400000>;
	};

	gic_cpu@0c400000 {
		compatible = "mediatek,gic_cpu";
		reg = <0x0 0xc400000 0x0 0x40000>;
	};

	gpio {
		compatible = "mediatek,gpio_usage_mapping";
		phandle = <0xdc>;
	};

	gpio@10005000 {
		compatible = "mediatek,gpio";
		phandle = <0x14>;
		reg = <0x0 0x10005000 0x0 0x1000>;
	};

	gpufreq {
		clock-names = "clk_mux", "clk_main_parent", "clk_sub_parent", "subsys_mfg_cg", "mtcmos_mfg_async", "mtcmos_mfg", "mtcmos_mfg_core0", "mtcmos_mfg_core1";
		clocks = <0x12 0x54 0x12 0x26 0x12 0x6 0x54 0x0 0x22 0x9 0x22 0x4 0x22 0x7 0x22 0x8>;
		compatible = "mediatek,mt6768-gpufreq";
	};

	hacc@1000a000 {
		compatible = "mediatek,hacc";
		interrupts = <0x0 0xcb 0x8>;
		reg = <0x0 0x1000a000 0x0 0x1000>;
	};

	hwrng {
		compatible = "mediatek,mt67xx-rng";
		phandle = <0xa0>;
	};

	i2c0@11007000 {
		aed = <0x1a>;
		clock-div = <0x5>;
		clock-names = "main", "dma";
		clocks = <0x21 0xb 0x21 0x26>;
		compatible = "mediatek,i2c";
		eh_cfg = <0x30>;
		gpio_start = <0x10002a00>;
		id = <0x0>;
		interrupts = <0x0 0x69 0x8>;
		mem_len = <0x200>;
		phandle = <0xad>;
		pu_cfg = <0x70>;
		reg = <0x0 0x11007000 0x0 0x1000 0x0 0x11000080 0x0 0x80>;
		rsel_cfg = <0x90>;
		scl-gpio-id = <0x53>;
		sda-gpio-id = <0x52>;
	};

	i2c1@11008000 {
		aed = <0x1a>;
		clock-div = <0x5>;
		clock-names = "main", "dma";
		clocks = <0x21 0xb 0x21 0x26>;
		compatible = "mediatek,i2c";
		eh_cfg = <0x30>;
		gpio_start = <0x10002a00>;
		id = <0x1>;
		interrupts = <0x0 0x6a 0x8>;
		mem_len = <0x200>;
		phandle = <0xae>;
		pu_cfg = <0x70>;
		reg = <0x0 0x11008000 0x0 0x1000 0x0 0x11000100 0x0 0x80>;
		rsel_cfg = <0x90>;
		scl-gpio-id = <0x54>;
		sda-gpio-id = <0x51>;
	};

	i2c2@11009000 {
		aed = <0x1a>;
		ch_offset_ccu = <0x200>;
		ch_offset_default = <0x100>;
		clock-div = <0x5>;
		clock-names = "main", "dma";
		clocks = <0x21 0xb 0x21 0x26>;
		compatible = "mediatek,i2c";
		eh_cfg = <0x40>;
		gpio_start = <0x10002800>;
		id = <0x2>;
		interrupts = <0x0 0x6b 0x8>;
		mem_len = <0x200>;
		phandle = <0xaf>;
		pu_cfg = <0xa0>;
		reg = <0x0 0x11009000 0x0 0x1000 0x0 0x11000180 0x0 0x180>;
		rsel_cfg = <0xf0>;
		scl-gpio-id = <0x67>;
		sda-gpio-id = <0x68>;
	};

	i2c3@1100f000 {
		aed = <0x1a>;
		ch_offset_ccu = <0x200>;
		ch_offset_default = <0x100>;
		clock-div = <0x5>;
		clock-names = "main", "dma";
		clocks = <0x21 0xb 0x21 0x26>;
		compatible = "mediatek,i2c";
		eh_cfg = <0x30>;
		gpio_start = <0x10002600>;
		id = <0x3>;
		interrupts = <0x0 0x6c 0x8>;
		mem_len = <0x200>;
		phandle = <0xb0>;
		pu_cfg = <0x60>;
		reg = <0x0 0x1100f000 0x0 0x1000 0x0 0x11000300 0x0 0x100>;
		rsel_cfg = <0x90>;
		scl-gpio-id = <0x32>;
		sda-gpio-id = <0x33>;
	};

	i2c4@11011000 {
		aed = <0x1a>;
		ch_offset_ccu = <0x200>;
		ch_offset_default = <0x100>;
		clock-div = <0x5>;
		clock-names = "main", "dma";
		clocks = <0x21 0xb 0x21 0x26>;
		compatible = "mediatek,i2c";
		eh_cfg = <0x40>;
		gpio_start = <0x10002800>;
		id = <0x4>;
		interrupts = <0x0 0x6d 0x8>;
		mem_len = <0x200>;
		phandle = <0xb1>;
		pu_cfg = <0xa0>;
		reg = <0x0 0x11011000 0x0 0x1000 0x0 0x11000400 0x0 0x180>;
		rsel_cfg = <0xf0>;
		scl-gpio-id = <0x69>;
		sda-gpio-id = <0x6a>;
	};

	i2c5@11016000 {
		aed = <0x1a>;
		clock-div = <0x5>;
		clock-names = "main", "dma";
		clocks = <0x21 0xb 0x21 0x26>;
		compatible = "mediatek,i2c";
		eh_cfg = <0x30>;
		gpio_start = <0x10002600>;
		id = <0x5>;
		interrupts = <0x0 0x93 0x8>;
		mem_len = <0x200>;
		phandle = <0xb2>;
		pu_cfg = <0x60>;
		reg = <0x0 0x11016000 0x0 0x1000 0x0 0x11000580 0x0 0x80>;
		rsel_cfg = <0x90>;
		scl-gpio-id = <0x30>;
		sda-gpio-id = <0x31>;

		rt-swchg@53 {
			compatible = "richtek,swchg";
			led_ctl_gpio = <0x1e 0xa5 0x0>;
			reg = <0x53>;
			rt,intr_gpio = <0x1e 0x9 0x0>;
			rt,intr_gpio_num = <0x9>;
			status = "okay";

			rt9471 {
				aicr = <0xf4240>;
				chg_alias_name = "rt9471_chg";
				chg_name = "primary_chg";
				cv = <0x432380>;
				en_qon_rst;
				en_safe_tmr;
				en_te;
				ichg = <0x16e360>;
				ieoc = <0x30d40>;
				interrupt-names = "wdt", "chg_mivr", "vac_ov", "otg_fault", "chg_rdy", "chg_done", "aicc_done", "pe_done", "chg_tout", "ieoc", "rechg", "chg_batov";
				mivr = <0x432380>;
				mivr_track = <0x0>;
				rm-name = "rt9471";
				rm-slave-addr = [53];
				safe_tmr = <0xa>;
				vac_ovp = <0xd59f80>;
				wdt = <0x28>;
			};
		};
	};

	i2c6@1100d000 {
		aed = <0x1a>;
		clock-div = <0x5>;
		clock-names = "main", "dma";
		clocks = <0x21 0xb 0x21 0x26>;
		compatible = "mediatek,i2c";
		eh_cfg = <0x30>;
		gpio_start = <0x10002000>;
		id = <0x6>;
		interrupts = <0x0 0x94 0x8>;
		mem_len = <0x200>;
		phandle = <0xb3>;
		pu_cfg = <0x60>;
		reg = <0x0 0x1100d000 0x0 0x1000 0x0 0x11000600 0x0 0x80>;
		rsel_cfg = <0x90>;
		scl-gpio-id = <0x59>;
		sda-gpio-id = <0x5a>;
	};

	i2c7@11004000 {
		aed = <0x1a>;
		clock-div = <0x5>;
		clock-names = "main", "dma";
		clocks = <0x21 0xb 0x21 0x26>;
		compatible = "mediatek,i2c";
		eh_cfg = <0x30>;
		gpio_start = <0x10002600>;
		id = <0x7>;
		interrupts = <0x0 0x6e 0x8>;
		mem_len = <0x200>;
		phandle = <0xb4>;
		pu_cfg = <0x60>;
		reg = <0x0 0x11004000 0x0 0x1000 0x0 0x11000680 0x0 0x180>;
		rsel_cfg = <0x90>;
		scl-gpio-id = <0xaf>;
		sda-gpio-id = <0xb0>;
	};

	i2c8@11005000 {
		aed = <0x1a>;
		clock-div = <0x5>;
		clock-names = "main", "dma";
		clocks = <0x21 0xb 0x21 0x26>;
		compatible = "mediatek,i2c";
		id = <0x8>;
		interrupts = <0x0 0x6f 0x8>;
		phandle = <0xb5>;
		reg = <0x0 0x11005000 0x0 0x1000 0x0 0x11000800 0x0 0x180>;
	};

	i2c_common {
		check_max_freq = [01];
		cnt_constraint = [01];
		compatible = "mediatek,i2c_common";
		control_irq_sel = [01];
		dma_support = [03];
		ext_time_config = [18 01];
		idvfs = [01];
		phandle = <0xac>;
		set_dt_div = [01];
		set_ltiming = [01];
		ver = [02];
	};

	imgsys@15020000 {
		#clock-cells = <0x1>;
		clock-names = "ISP_SCP_SYS_DIS", "ISP_SCP_SYS_ISP", "ISP_SCP_SYS_CAM", "ISP_CLK_IMG_DIP", "ISP_CLK_CAM", "ISP_CLK_CAMTG", "ISP_CLK_CAM_SENINF", "ISP_CLK_CAMSV0", "ISP_CLK_CAMSV1", "ISP_CLK_CAMSV2";
		clocks = <0x22 0x3 0x22 0x5 0x22 0xa 0x56 0x1 0x57 0x2 0x57 0x3 0x57 0x4 0x57 0x5 0x57 0x6 0x57 0x7>;
		compatible = "mediatek,imgsys", "syscon";
		phandle = <0x56>;
		reg = <0x0 0x15020000 0x0 0x1000>;
	};

	imp_iic@11017000 {
		compatible = "mediatek,imp_iic";
		reg = <0x0 0x11017000 0x0 0x1000>;
	};

	infra_dbgsystop_cpu0@0e000000 {
		compatible = "mediatek,infra_dbgsystop_cpu0";
		reg = <0x0 0xe000000 0x0 0x100000>;
	};

	infra_dbgsystop_cpu1@0e100000 {
		compatible = "mediatek,infra_dbgsystop_cpu1";
		reg = <0x0 0xe100000 0x0 0x100000>;
	};

	infra_dbgsystop_cpu2@0e200000 {
		compatible = "mediatek,infra_dbgsystop_cpu2";
		reg = <0x0 0xe200000 0x0 0x100000>;
	};

	infra_dbgsystop_cpu3@0e300000 {
		compatible = "mediatek,infra_dbgsystop_cpu3";
		reg = <0x0 0xe300000 0x0 0x100000>;
	};

	infra_dbgsystop_cpu4@0e400000 {
		compatible = "mediatek,infra_dbgsystop_cpu4";
		reg = <0x0 0xe400000 0x0 0x100000>;
	};

	infra_dbgsystop_cpu5@0e500000 {
		compatible = "mediatek,infra_dbgsystop_cpu5";
		reg = <0x0 0xe500000 0x0 0x100000>;
	};

	infra_dbgsystop_cpu6@0e600000 {
		compatible = "mediatek,infra_dbgsystop_cpu6";
		reg = <0x0 0xe600000 0x0 0x100000>;
	};

	infra_dbgsystop_cpu7@0e700000 {
		compatible = "mediatek,infra_dbgsystop_cpu7";
		reg = <0x0 0xe700000 0x0 0x100000>;
	};

	infra_mbist@1020d000 {
		compatible = "mediatek,infra_mbist";
		reg = <0x0 0x1020d000 0x0 0x1000>;
	};

	infracfg@1020e000 {
		compatible = "mediatek,infracfg";
		reg = <0x0 0x1020e000 0x0 0x1000>;
	};

	infracfg_ao@10001000 {
		#clock-cells = <0x1>;
		compatible = "mediatek,infracfg_ao", "syscon";
		interrupts = <0x0 0x47 0x1>;
		phandle = <0x21>;
		reg = <0x0 0x10001000 0x0 0x1000>;
	};

	interrupt-controller {
		#address-cells = <0x2>;
		#interrupt-cells = <0x3>;
		#redistributor-regions = <0x1>;
		#size-cells = <0x2>;
		compatible = "arm,gic-v3";
		interrupt-controller;
		interrupt-parent = <0x11>;
		interrupts = <0x1 0x9 0x4>;
		phandle = <0x11>;
		reg = <0x0 0xc000000 0x0 0x40000 0x0 0xc040000 0x0 0x200000 0x0 0xc53a650 0x0 0x50>;
	};

	intpol-controller@0 {
		#interrupt-cells = <0x3>;
		compatible = "mediatek,mt6577-sysirq";
		interrupt-controller;
		interrupt-parent = <0x11>;
		phandle = <0x1>;
		reg = <0x0 0xc53a650 0x0 0x50>;
	};

	io_cfg_bl@10002600 {
		compatible = "mediatek,io_cfg_bl";
		phandle = <0x18>;
		reg = <0x0 0x10002600 0x0 0x200>;
	};

	io_cfg_lb@10002400 {
		compatible = "mediatek,io_cfg_lb";
		phandle = <0x17>;
		reg = <0x0 0x10002400 0x0 0x200>;
	};

	io_cfg_lm@10002200 {
		compatible = "mediatek,io_cfg_lm";
		phandle = <0x16>;
		reg = <0x0 0x10002200 0x0 0x200>;
	};

	io_cfg_lt@10002000 {
		compatible = "mediatek,io_cfg_lt";
		phandle = <0x15>;
		reg = <0x0 0x10002000 0x0 0x200>;
	};

	io_cfg_rb@10002a00 {
		compatible = "mediatek,io_cfg_rb";
		phandle = <0x1a>;
		reg = <0x0 0x10002a00 0x0 0x200>;
	};

	io_cfg_rm@10002800 {
		compatible = "mediatek,io_cfg_rm";
		phandle = <0x19>;
		reg = <0x0 0x10002800 0x0 0x200>;
	};

	io_cfg_rt@10002c00 {
		compatible = "mediatek,io_cfg_rt";
		phandle = <0x1b>;
		reg = <0x0 0x10002c00 0x0 0x200>;
	};

	io_cfg_tl@10002e00 {
		compatible = "mediatek,io_cfg_tl";
		phandle = <0x1c>;
		reg = <0x0 0x10002e00 0x0 0x200>;
	};

	iocfg_0@10002000 {
		compatible = "mediatek,iocfg_0";
		reg = <0x0 0x10002000 0x0 0x200>;
	};

	iocfg_1@10002200 {
		compatible = "mediatek,iocfg_1";
		reg = <0x0 0x10002200 0x0 0x200>;
	};

	iocfg_2@10002400 {
		compatible = "mediatek,iocfg_2";
		reg = <0x0 0x10002400 0x0 0x200>;
	};

	iocfg_3@10002600 {
		compatible = "mediatek,iocfg_3";
		reg = <0x0 0x10002600 0x0 0x200>;
	};

	iocfg_4@10002800 {
		compatible = "mediatek,iocfg_4";
		reg = <0x0 0x10002800 0x0 0x200>;
	};

	iocfg_5@10002a00 {
		compatible = "mediatek,iocfg_5";
		reg = <0x0 0x10002a00 0x0 0x200>;
	};

	irq_nfc {
		compatible = "mediatek,irq_nfc-eint";
		phandle = <0xda>;
	};

	irtx_pwm {
		compatible = "mediatek,irtx-pwm";
		phandle = <0xd6>;
		pwm_ch = <0x0>;
		pwm_data_invert = <0x0>;
	};

	kd_camera_hw1@1a040000 {
		cam3_enable_sensor = "gc02m1_mipi_raw ov02b10_mipi_raw";
		clock-names = "CLK_TOP_CAMTG_SEL", "CLK_TOP_CAMTG1_SEL", "CLK_TOP_CAMTG2_SEL", "CLK_TOP_CAMTG3_SEL", "CLK_MCLK_6M", "CLK_MCLK_12M", "CLK_MCLK_13M", "CLK_MCLK_48M", "CLK_MCLK_52M", "CLK_MCLK_24M", "CLK_MCLK_26M", "CLK_CAM_SENINF_CG", "CLK_MIPI_C0_26M_CG", "CLK_MIPI_C1_26M_CG", "CLK_MIPI_ANA_0A_CG", "CLK_MIPI_ANA_0B_CG", "CLK_MIPI_ANA_1A_CG", "CLK_MIPI_ANA_1B_CG", "CLK_MIPI_ANA_2A_CG", "CLK_MIPI_ANA_2B_CG", "CLK_TOP_CAMTM_SEL_CG", "CLK_TOP_CAMTM_208_CG", "CLK_SCP_SYS_CAM";
		clocks = <0x12 0x56 0x12 0x57 0x12 0x58 0x12 0x59 0x12 0x14 0x12 0x13 0x12 0x1d 0x12 0x11 0x12 0x1c 0x12 0x12 0x13 0x57 0x4 0x3c 0xe 0x3c 0x12 0x5d 0x0 0x5e 0x0 0x5f 0x0 0x60 0x0 0x61 0x0 0x62 0x0 0x12 0x6d 0x12 0x1a 0x22 0xa>;
		compatible = "mediatek,camera_hw";
		phandle = <0xc9>;
		reg = <0x0 0x1a040000 0x0 0x1000>;
	};

	kp@10010000 {
		compatible = "mediatek,kp";
		interrupts = <0x0 0x49 0x2>;
		phandle = <0x9c>;
		reg = <0x0 0x10010000 0x0 0x1000>;
	};

	lastbus@10001000 {
		compatible = "mediatek,lastbus-v1";
		reg = <0x0 0x10001000 0x0 0x1000 0x0 0x10003000 0x0 0x1000>;
	};

	lk_charger {
		ac_charger_current = <0x16e360>;
		ac_charger_input_current = <0x16e360>;
		charging_host_charger_current = <0x16e360>;
		compatible = "mediatek,lk_charger";
		enable_anime;
		enable_pd20_reset;
		enable_pe_plus;
		fast_charge_voltage = <0x2625a0>;
		max_charger_voltage = <0x632ea0>;
		non_std_ac_charger_current = <0x7a120>;
		pd_charger_current = <0x7a120>;
		phandle = <0xd4>;
		power_path_support;
		ta_ac_charger_current = <0x2dc6c0>;
		temp_t1_threshold = <0x0>;
		temp_t3_threshold = <0x2d>;
		temp_t4_threshold = <0x32>;
		usb_charger_current = <0x7a120>;
	};

	m4u@10205000 {
		cell-index = <0x0>;
		compatible = "mediatek,m4u";
		interrupts = <0x0 0xae 0x8>;
		reg = <0x0 0x10205000 0x0 0x1000>;
	};

	mali@13040000 {
		compatible = "mediatek,mali", "arm,mali-midgard", "arm,mali-bifrost";
		interrupt-names = "GPU", "MMU", "JOB", "EVENT", "PWR";
		interrupts = <0x0 0x112 0x8 0x0 0x113 0x8 0x0 0x114 0x8 0x0 0x115 0x8 0x0 0x116 0x8>;
		reg = <0x0 0x13040000 0x0 0x4000>;
	};

	mbist@17040000 {
		compatible = "mediatek,mbist";
		reg = <0x0 0x17040000 0x0 0x10000>;
	};

	mbist@17050000 {
		compatible = "mediatek,mbist";
		reg = <0x0 0x17050000 0x0 0x10000>;
	};

	mbist@17060000 {
		compatible = "mediatek,mbist";
		reg = <0x0 0x17060000 0x0 0x10000>;
	};

	mbist@17070000 {
		compatible = "mediatek,mbist";
		reg = <0x0 0x17070000 0x0 0x10000>;
	};

	mbist_ao@10013000 {
		compatible = "mediatek,mbist_ao";
		reg = <0x0 0x10013000 0x0 0x1000>;
	};

	mcdi@0010fc00 {
		compatible = "mediatek,mt6768-mcdi";
		mediatek,enabled = <0x1>;
		phandle = <0x69>;
		reg = <0x0 0x10fc00 0x0 0x800 0x0 0xc53a000 0x0 0x1000>;
	};

	mcucfg@0c530000 {
		compatible = "mediatek,mcucfg";
		phandle = <0x9f>;
		reg = <0x0 0xc530000 0x0 0x10000>;
	};

	mcucfg_mp0_counter@0c530000 {
		compatible = "mediatek,mcucfg_mp0_counter";
		reg = <0x0 0xc530000 0x0 0x10000>;
	};

	mcupm_reg@10216000 {
		compatible = "mediatek,mcupm_reg";
		reg = <0x0 0x10216000 0x0 0x1000>;
	};

	mcupm_sram0@10217000 {
		compatible = "mediatek,mcupm_sram0";
		reg = <0x0 0x10217000 0x0 0x1000>;
	};

	mcupm_sram1@10218000 {
		compatible = "mediatek,mcupm_sram1";
		reg = <0x0 0x10218000 0x0 0x1000>;
	};

	mcupm_sram2@10211000 {
		compatible = "mediatek,mcupm_sram2";
		reg = <0x0 0x10211000 0x0 0x1000>;
	};

	mcupm_sram3@10213000 {
		compatible = "mediatek,mcupm_sram3";
		reg = <0x0 0x10213000 0x0 0x1000>;
	};

	md1_sim1_hot_plug_eint {
		phandle = <0xdd>;
	};

	md1_sim2_hot_plug_eint {
		phandle = <0xde>;
	};

	md_auxadc {
		compatible = "mediatek,md_auxadc";
		io-channel-names = "md-channel";
		io-channels = <0x23 0x2>;
		phandle = <0xa2>;
	};

	md_ccif0@1020a000 {
		compatible = "mediatek,md_ccif0";
		reg = <0x0 0x1020a000 0x0 0x1000>;
	};

	md_ccif1@1020c000 {
		compatible = "mediatek,md_ccif1";
		reg = <0x0 0x1020c000 0x0 0x1000>;
	};

	md_ccif2@1023d000 {
		compatible = "mediatek,md_ccif2";
		reg = <0x0 0x1023d000 0x0 0x1000>;
	};

	md_ccif3@1023f000 {
		compatible = "mediatek,md_ccif3";
		reg = <0x0 0x1023f000 0x0 0x1000>;
	};

	mdcldma@10014000 {
		clock-names = "scp-sys-md1-main", "infra-cldma-bclk", "infra-ccif-ap", "infra-ccif-md", "infra-ccif1-ap", "infra-ccif1-md", "infra-ccif2-ap", "infra-ccif2-md";
		clocks = <0x22 0x0 0x21 0x32 0x21 0x29 0x21 0x2c 0x21 0x23 0x21 0x24 0x21 0x51 0x21 0x52>;
		compatible = "mediatek,mdcldma";
		interrupts = <0x0 0xb4 0x4 0x0 0xa4 0x8 0x0 0xa5 0x8 0x0 0x4b 0x2>;
		mediatek,cldma_capability = <0x6>;
		mediatek,md_id = <0x0>;
		phandle = <0xa1>;
		reg = <0x0 0x10014000 0x0 0x1000 0x0 0x1021b000 0x0 0x1000 0x0 0x10209000 0x0 0x1000 0x0 0x1020a000 0x0 0x1000>;
	};

	mdcldmain@1021c000 {
		compatible = "mediatek,mdcldmain";
		reg = <0x0 0x1021c000 0x0 0x400>;
	};

	mdcldmain_ao@10015000 {
		compatible = "mediatek,mdcldmain_ao";
		reg = <0x0 0x10015000 0x0 0x400>;
	};

	mdcldmamisc@1021c000 {
		compatible = "mediatek,mdcldmamisc";
		reg = <0x0 0x1021c000 0x0 0x1000>;
	};

	mdcldmamisc@1021c900 {
		compatible = "mediatek,mdcldmamisc";
		reg = <0x0 0x1021c900 0x0 0x400>;
	};

	mdcldmamisc_ao@10015800 {
		compatible = "mediatek,mdcldmamisc_ao";
		reg = <0x0 0x10015800 0x0 0x400>;
	};

	mdcldmaout@1021c400 {
		compatible = "mediatek,mdcldmaout";
		reg = <0x0 0x1021c400 0x0 0x400>;
	};

	mdcldmaout_ao@10015400 {
		compatible = "mediatek,mdcldmaout_ao";
		reg = <0x0 0x10015400 0x0 0x400>;
	};

	mdp_ccorr0@14005000 {
		clock-names = "MDP_CCORR";
		clocks = <0x24 0x1>;
		compatible = "mediatek,mdp_ccorr0";
		interrupts = <0x0 0xef 0x8>;
		phandle = <0x2c>;
		reg = <0x0 0x14005000 0x0 0x1000>;
	};

	mdp_rdma0@14004000 {
		clock-names = "MDP_RDMA0";
		clocks = <0x24 0x0>;
		compatible = "mediatek,mdp_rdma0";
		interrupts = <0x0 0xe0 0x8>;
		phandle = <0x25>;
		reg = <0x0 0x14004000 0x0 0x1000>;
	};

	mdp_rsz0@14006000 {
		clock-names = "MDP_RSZ0";
		clocks = <0x24 0x2>;
		compatible = "mediatek,mdp_rsz0";
		interrupts = <0x0 0xe1 0x8>;
		phandle = <0x26>;
		reg = <0x0 0x14006000 0x0 0x1000>;
	};

	mdp_rsz1@14007000 {
		clock-names = "MDP_RSZ1";
		clocks = <0x24 0x3>;
		compatible = "mediatek,mdp_rsz1";
		interrupts = <0x0 0xe2 0x8>;
		phandle = <0x27>;
		reg = <0x0 0x14007000 0x0 0x1000>;
	};

	mdp_tdshp0@1400a000 {
		clock-names = "MDP_TDSHP";
		clocks = <0x24 0x4>;
		compatible = "mediatek,mdp_tdshp0";
		phandle = <0x2a>;
		reg = <0x0 0x1400a000 0x0 0x1000>;
	};

	mdp_wdma0@14008000 {
		clock-names = "MDP_WDMA";
		clocks = <0x24 0x6>;
		compatible = "mediatek,mdp_wdma0";
		interrupts = <0x0 0xe5 0x8>;
		phandle = <0x28>;
		reg = <0x0 0x14008000 0x0 0x1000>;
	};

	mdp_wrot0@14009000 {
		clock-names = "MDP_WROT0";
		clocks = <0x24 0x5>;
		compatible = "mediatek,mdp_wrot0";
		interrupts = <0x0 0xe4 0x8>;
		phandle = <0x29>;
		reg = <0x0 0x14009000 0x0 0x1000>;
	};

	memory {
		device_type = "memory";
		reg = <0x0 0x40000000 0x0 0x3e605000>;
	};

	memory-ssmr-features {
		2d_fr-size = <0x0 0x8000000>;
		compatible = "mediatek,memory-ssmr-features";
		iris-recognition-size = <0x0 0x10000000>;
		phandle = <0xcf>;
		prot-sharedmem-size = <0x0 0x8000000>;
		sdsp-firmware-size = <0x0 0x1000000>;
		sdsp-tee-sharedmem-size = <0x0 0x1000000>;
		svp-size = <0x0 0x10000000>;
		ta-elf-size = <0x0 0x1000000>;
		ta-stack-heap-size = <0x0 0x6000000>;
		tui-size = <0x0 0x4000000>;
		wfd-size = <0x0 0x4000000>;
	};

	mfg_cfg@13000000 {
		#clock-cells = <0x1>;
		compatible = "mediatek,mfgcfg", "syscon";
		phandle = <0x54>;
		reg = <0x0 0x13000000 0x0 0x1000>;
	};

	mipi_rx_ana_csi0a@11c10000 {
		#clock-cells = <0x1>;
		compatible = "mediatek,mipi_rx_ana_csi0a", "syscon";
		phandle = <0x5d>;
		reg = <0x0 0x11c10000 0x0 0x1000>;
	};

	mipi_rx_ana_csi0b@11c11000 {
		#clock-cells = <0x1>;
		compatible = "mediatek,mipi_rx_ana_csi0b", "syscon";
		phandle = <0x5e>;
		reg = <0x0 0x11c11000 0x0 0x1000>;
	};

	mipi_rx_ana_csi1a@11c12000 {
		#clock-cells = <0x1>;
		compatible = "mediatek,mipi_rx_ana_csi1a", "syscon";
		phandle = <0x5f>;
		reg = <0x0 0x11c12000 0x0 0x1000>;
	};

	mipi_rx_ana_csi1b@11c13000 {
		#clock-cells = <0x1>;
		compatible = "mediatek,mipi_rx_ana_csi1b", "syscon";
		phandle = <0x60>;
		reg = <0x0 0x11c13000 0x0 0x1000>;
	};

	mipi_rx_ana_csi2a@11c14000 {
		#clock-cells = <0x1>;
		compatible = "mediatek,mipi_rx_ana_csi2a", "syscon";
		phandle = <0x61>;
		reg = <0x0 0x11c14000 0x0 0x1000>;
	};

	mipi_rx_ana_csi2b@11c15000 {
		#clock-cells = <0x1>;
		compatible = "mediatek,mipi_rx_ana_csi2b", "syscon";
		phandle = <0x62>;
		reg = <0x0 0x11c15000 0x0 0x1000>;
	};

	mipi_tx0@11c80000 {
		compatible = "mediatek,mipi_tx0";
		reg = <0x0 0x11c80000 0x0 0x10000>;
	};

	mm_mutex@14016000 {
		compatible = "mediatek,mm_mutex";
		reg = <0x0 0x14016000 0x0 0x1000>;
	};

	mmdvfs_pmqos {
		cam_freq = "cam_step0", "cam_step1", "cam_step2";
		cam_step0 = <0x222 0x1 0x2 0x7>;
		cam_step1 = <0x138 0x1 0x2 0x4>;
		cam_step2 = <0xe4 0x1 0x2 0x5>;
		clock-names = "mmdvfs_clk_mm_sel_ck", "mmdvfs_clk_venc_sel_ck", "mmdvfs_clk_cam_sel_ck", "mmdvfs_clk_mmpll_ck", "mmdvfs_clk_univpll1_d2_ck", "mmdvfs_clk_mmpll_d2_ck", "mmdvfs_clk_univpll_d3_ck", "mmdvfs_clk_syspll_d2_ck";
		clocks = <0x12 0x52 0x12 0x6e 0x12 0x6f 0x12 0x21 0x12 0x17 0x12 0x22 0x12 0x19 0x12 0x1>;
		compatible = "mediatek,mmdvfs_pmqos";
		disp_freq = "mm_step0", "mm_step1", "mm_step2";
		img_freq = "mm_step0", "mm_step1", "mm_step2";
		mdp_freq = "mm_step0", "mm_step1", "mm_step2";
		mm_step0 = <0x1c9 0x1 0x0 0x3>;
		mm_step1 = <0x138 0x1 0x0 0x4>;
		mm_step2 = <0xe4 0x1 0x0 0x5>;
		vdec_freq = "mm_step0", "mm_step1", "mm_step2";
		venc_freq = "venc_step0", "venc_step1", "venc_step2";
		venc_step0 = <0x1c9 0x1 0x1 0x3>;
		venc_step1 = <0x1a0 0x1 0x1 0x6>;
		venc_step2 = <0x138 0x1 0x1 0x4>;
		vopp_steps = <0x0 0x1 0x3>;
	};

	mmsys_config@14000000 {
		#clock-cells = <0x1>;
		clock-names = "CAM_MDP", "IMG_DL_RELAY", "IMG_DL_ASYNC_TOP";
		clocks = <0x24 0x17 0x24 0x1c 0x24 0x1d>;
		compatible = "mediatek,mmsys_config", "syscon";
		interrupts = <0x0 0xf0 0x8>;
		phandle = <0x24>;
		reg = <0x0 0x14000000 0x0 0x1000>;
	};

	mobicore {
		compatible = "trustonic,mobicore";
		interrupts = <0x0 0x129 0x1>;
	};

	modem_temp_share@10018000 {
		compatible = "mediatek,modem_temp_share";
		reg = <0x0 0x10018000 0x0 0x1000>;
	};

	mrdump_ext_rst {
		compatible = "mediatek, mrdump_ext_rst-eint";
		mode = "IRQ";
		phandle = <0x9d>;
		status = "okay";
	};

	msdc0_top@11cd0000 {
		compatible = "mediatek,msdc0_top";
		reg = <0x0 0x11cd0000 0x0 0x1000>;
	};

	msdc1_top@11c90000 {
		compatible = "mediatek,msdc1_top";
		reg = <0x0 0x11c90000 0x0 0x1000>;
	};

	msdc@11230000 {
		bootable;
		bus-width = <0x8>;
		cap-mmc-highspeed;
		clk_src = [01];
		clock-names = "msdc0-clock", "msdc0-hclock", "msdc0-aes-clock";
		clocks = <0x21 0x4c 0x21 0x1c 0x21 0x44>;
		compatible = "mediatek,msdc";
		host_function = [00];
		index = [00];
		interrupts = <0x0 0x64 0x8>;
		max-frequency = <0xbebc200>;
		mmc-ddr-1_8v;
		mmc-hs200-1_8v;
		mmc-hs400-1_8v;
		no-sd;
		no-sdio;
		non-removable;
		phandle = <0xc1>;
		pinctl = <0x30>;
		pinctl_hs200 = <0x32>;
		pinctl_hs400 = <0x31>;
		reg = <0x0 0x11230000 0x0 0x10000>;
		register_setting = <0x33>;
		status = "okay";
		vmmc-supply = <0x34>;
	};

	msdc@11240000 {
		bus-width = <0x4>;
		cap-sd-highspeed;
		cd-gpios = <0x1e 0x4 0x0>;
		cd_level = [01];
		clk_src = [02];
		clock-names = "msdc1-clock", "msdc1-hclock";
		clocks = <0x21 0x4d 0x21 0x1d>;
		compatible = "mediatek,msdc";
		host_function = [01];
		index = [01];
		interrupts = <0x0 0x65 0x8>;
		max-frequency = <0xbebc200>;
		no-mmc;
		no-sdio;
		phandle = <0xc2>;
		pinctl = <0x35>;
		pinctl_ddr50 = <0x38>;
		pinctl_sdr104 = <0x36>;
		pinctl_sdr50 = <0x37>;
		reg = <0x0 0x11240000 0x0 0x10000>;
		register_setting = <0x39>;
		sd-uhs-ddr50;
		sd-uhs-sdr104;
		sd-uhs-sdr12;
		sd-uhs-sdr25;
		sd-uhs-sdr50;
		status = "okay";
		vmmc-supply = <0x3a>;
		vqmmc-supply = <0x3b>;
	};

	mt6358_gauge {
		alias_name = "MT6358";
		compatible = "mediatek,mt6358_gauge";
		gauge_name = "gauge";
	};

	mt6358_snd {
		compatible = "mediatek,mt6358-sound";
		mediatek,pwrap-regmap = <0x20>;
		phandle = <0x52>;
	};

	mt6370_pmu_dts {
		#interrupt-cells = <0x1>;
		interrupt-controller;
		mt6370,intr_gpio = <0x1e 0x3 0x0>;
		mt6370,intr_gpio_num = <0x3>;
		phandle = <0xdf>;

		bled {
			compatible = "mediatek,mt6370_pmu_bled";
			interrupt-names = "bled_ocp";
			mt,bl_ocp_level = <0x2>;
			mt,bl_ovp_level = <0x3>;
			mt,bled_curr_scale = <0x0>;
			mt,bled_flash_ramp = <0x1>;
			mt,bled_name = "mt6370_pmu_bled";
			mt,bled_ramptime = <0x3>;
			mt,chan_en = <0xf>;
			mt,map_linear;
			mt,max_bled_brightness = <0x200>;
			mt,pwm_avg_cycle = <0x0>;
			mt,pwm_deglitch = <0x1>;
			mt,pwm_fsample = <0x2>;
			mt,pwm_hys = <0x0>;
			mt,pwm_hys_en = <0x1>;
			mt,pwm_lpf_coef = <0x0>;
			mt,use_pwm;
		};

		charger {
			aicr = <0x7a120>;
			charger_name = "primary_chg";
			compatible = "mediatek,mt6370_pmu_charger";
			cv = <0x426030>;
			dc_wdt = <0x3d0900>;
			disable_vlgc;
			enable_te;
			enable_wdt;
			fast_unknown_ta_dect;
			ichg = <0x1e8480>;
			ieoc = <0x249f0>;
			interrupt-names = "chg_mivr", "chg_aiclmeasi", "attachi", "ovpctrl_uvp_d_evt", "chg_wdtmri", "chg_vbusov", "chg_tmri", "chg_treg", "dcdti";
			ircmp_resistor = <0x61a8>;
			ircmp_vclamp = <0x7d00>;
			lbp_dt = <0x1>;
			lbp_hys_sel = <0x1>;
			load_switch_name = "primary_load_switch";
			mivr = <0x432380>;
			post_aicl;
			safety_timer = <0xc>;
		};

		core {
			compatible = "mediatek,mt6370_pmu_core";
			i2cstmr_rst_tmr = <0x0>;
			int_deg = <0x0>;
			int_wdt = <0x0>;
			interrupt-names = "otp", "vdda_ovp", "vdda_uv";
			mrstb_en;
			mrstb_tmr = <0x3>;
		};

		dsv {
			compatible = "mediatek,mt6370_pmu_dsv";
			db_delay = <0x3>;
			db_ext_en = <0x0>;
			db_freq_pm = <0x0>;
			db_periodic_fix = <0x0>;
			db_periodic_mode = <0x0>;
			db_single_pin = <0x0>;
			db_startup = <0x0>;
			db_vbst = <0x1644>;
			db_vneg_20ms = <0x1>;
			db_vneg_disc = <0x0>;
			db_vneg_slew = <0x1>;
			db_vpos_20ms = <0x1>;
			db_vpos_disc = <0x1>;
			db_vpos_slew = <0x1>;
			interrupt-names = "dsv_vneg_ocp", "dsv_vpos_ocp", "dsv_bst_ocp", "dsv_vneg_scp", "dsv_vpos_scp";

			mt6370_dsvn {
				regulator-max-microvolt = <0x5b8d80>;
				regulator-min-microvolt = <0x3d0900>;
				regulator-name = "dsv_neg";
			};

			mt6370_dsvp {
				regulator-max-microvolt = <0x5b8d80>;
				regulator-min-microvolt = <0x3d0900>;
				regulator-name = "dsv_pos";
			};
		};

		ldo {
			compatible = "mediatek,mt6370_pmu_ldo";
			interrupt-names = "ldo_oc";
			ldo_oms = <0x1>;
			ldo_vrc_lt = <0x1>;

			mt6370_ldo {
				regulator-max-microvolt = <0x3d0900>;
				regulator-min-microvolt = <0x186a00>;
				regulator-name = "irtx_ldo";
			};
		};

		mt6370_pmu_fled1 {
			compatible = "mediatek,mt6370_pmu_fled1";
			fled_enable = <0x1>;
			interrupt-names = "fled_lvf", "fled2_short", "fled1_short";
			strobe_cur = <0x124f80>;
			strobe_timeout = <0x960>;
			torch_cur = <0x493e0>;
		};

		mt6370_pmu_fled2 {
			compatible = "mediatek,mt6370_pmu_fled2";
			fled_enable = <0x1>;
			strobe_cur = <0xf4240>;
			strobe_timeout = <0x4b0>;
			torch_cur = <0x30d40>;
		};

		rgbled {
			compatible = "mediatek,mt6370_pmu_rgbled";
			interrupt-names = "isink4_short", "isink3_short", "isink2_short", "isink1_short", "isink4_open", "isink3_open", "isink2_open", "isink1_open";
			mt,led_default_trigger = "cc_mode", "cc_mode", "cc_mode", "none";
			mt,led_name = "mt6370_pmu_led1", "mt6370_pmu_led2", "mt6370_pmu_led3", "mt6370_pmu_led4";
		};
	};

	mt6768-afe-pcm@11220000 {
		apmixed = <0x3c>;
		clock-names = "aud_afe_clk", "aud_dac_clk", "aud_dac_predis_clk", "aud_adc_clk", "aud_apll22m_clk", "aud_apll24m_clk", "aud_apll1_tuner_clk", "aud_tml_clk", "aud_infra_axi_clk", "aud_infra_26m_clk", "top_mux_audio", "top_mux_audio_int", "top_sys_pll1_d4", "top_mux_aud_1", "top_apll1_ck", "top_mux_aud_eng1", "top_apll1_d8", "top_i2s0_m_sel", "top_i2s1_m_sel", "top_i2s2_m_sel", "top_i2s3_m_sel", "top_apll12_div0", "top_apll12_div1", "top_apll12_div2", "top_apll12_div3", "apmixed_apll1", "top_clk26m_clk";
		clocks = <0x3d 0x0 0x3d 0x5 0x3d 0x6 0x3d 0x4 0x3d 0x1 0x3d 0x2 0x3d 0x3 0x3d 0x7 0x21 0x2b 0x21 0x33 0x12 0x5f 0x12 0x60 0x12 0x3 0x12 0x61 0x12 0x29 0x12 0x62 0x12 0x2c 0x12 0x82 0x12 0x83 0x12 0x84 0x12 0x85 0x12 0x70 0x12 0x71 0x12 0x72 0x12 0x73 0x3c 0x8 0x13>;
		compatible = "mediatek,mt6768-sound";
		interrupts = <0x0 0xa9 0x8>;
		phandle = <0x53>;
		pinctrl-0 = <0x3e>;
		pinctrl-1 = <0x3f>;
		pinctrl-10 = <0x48>;
		pinctrl-11 = <0x49>;
		pinctrl-12 = <0x4a>;
		pinctrl-13 = <0x4b>;
		pinctrl-14 = <0x4c>;
		pinctrl-15 = <0x4d>;
		pinctrl-16 = <0x4e>;
		pinctrl-17 = <0x4f>;
		pinctrl-18 = <0x50>;
		pinctrl-19 = <0x51>;
		pinctrl-2 = <0x40>;
		pinctrl-3 = <0x41>;
		pinctrl-4 = <0x42>;
		pinctrl-5 = <0x43>;
		pinctrl-6 = <0x44>;
		pinctrl-7 = <0x45>;
		pinctrl-8 = <0x46>;
		pinctrl-9 = <0x47>;
		pinctrl-names = "aud_clk_mosi_off", "aud_clk_mosi_on", "aud_clk_miso_off", "aud_clk_miso_on", "aud_dat_mosi_off", "aud_dat_mosi_on", "aud_dat_miso_off", "aud_dat_miso_on", "aud_gpio_i2s0_off", "aud_gpio_i2s0_on", "aud_gpio_i2s1_off", "aud_gpio_i2s1_on", "aud_gpio_i2s2_off", "aud_gpio_i2s2_on", "aud_gpio_i2s3_off", "aud_gpio_i2s3_on", "vow_dat_miso_off", "vow_dat_miso_on", "vow_clk_miso_off", "vow_clk_miso_on";
		reg = <0x0 0x11220000 0x0 0x1000>;
		topckgen = <0x12>;
	};

	mt_charger {
		compatible = "mediatek,mt-charger";
		phandle = <0xd3>;
	};

	mt_cpufreq {
		compatible = "mediatek,mt-cpufreq";
		phandle = <0xa4>;
	};

	mt_soc_playback_offload {
		compatible = "mediatek,mt_soc_offload_common";
	};

	mtk-btcvsd-snd@18050000 {
		compatible = "mediatek,mtk-btcvsd-snd";
		interrupts = <0x0 0x11b 0x8>;
		mediatek,infracfg = <0x21>;
		mediatek,offset = <0xf00 0x800 0x140 0x144 0x148>;
		reg = <0x0 0x18050000 0x0 0x1000 0x0 0x18080000 0x0 0x10000>;
	};

	mtkfb@0 {
		compatible = "mediatek,mtkfb";
		phandle = <0xc5>;
	};

	nfc {
		compatible = "mediatek,nfc-gpio-v2";
		gpio-irq = <0x9>;
		gpio-irq-std = <0x1e 0x9 0x0>;
		gpio-rst = <0x9f>;
		gpio-rst-std = <0x1e 0x9f 0x0>;
		phandle = <0xd9>;
	};

	nfi@11018000 {
		compatible = "mediatek,nfi";
		reg = <0x0 0x11018000 0x0 0x1000>;
	};

	nfiecc@11019000 {
		compatible = "mediatek,nfiecc";
		reg = <0x0 0x11019000 0x0 0x1000>;
	};

	odm {
		compatible = "simple-bus";
		phandle = <0xce>;
	};

	otg_iddig {
		compatible = "mediatek,usb_iddig_bi_eint";
		phandle = <0xd1>;
	};

	pericfg@10003000 {
		#clock-cells = <0x1>;
		compatible = "mediatek,pericfg", "syscon";
		phandle = <0x6a>;
		reg = <0x0 0x10003000 0x0 0x1000>;
	};

	pinctrl {
		#gpio-cells = <0x2>;
		#interrupt-cells = <0x4>;
		compatible = "mediatek,mt6768-pinctrl";
		gpio-controller;
		gpio-ranges = <0x1e 0x0 0x0 0xba>;
		interrupt-controller;
		interrupts = <0x0 0xba 0x4>;
		phandle = <0x1e>;
		pins-are-numbered;
		reg_base_eint = <0x1d>;
		reg_bases = <0x14 0x15 0x16 0x17 0x18 0x19 0x1a 0x1b 0x1c>;

		aud_clk_miso_off {
			phandle = <0x40>;

			pins_cmd0_dat {
				pinmux = <0x8c00 0x8d00>;
			};
		};

		aud_clk_miso_on {
			phandle = <0x41>;

			pins_cmd0_dat {
				input-schmitt-enable;
				pinmux = <0x8c01>;
			};

			pins_cmd1_dat {
				input-schmitt-enable;
				pinmux = <0x8d01>;
			};
		};

		aud_clk_mosi_off {
			phandle = <0x3e>;

			pins_cmd0_dat {
				pinmux = <0x8800 0x8900>;
			};
		};

		aud_clk_mosi_on {
			phandle = <0x3f>;

			pins_cmd0_dat {
				input-schmitt-enable;
				pinmux = <0x8801>;
			};

			pins_cmd1_dat {
				input-schmitt-enable;
				pinmux = <0x8901>;
			};
		};

		aud_dat_miso_off {
			phandle = <0x44>;

			pins_cmd0_dat {
				bias-disable;
				input-enable;
				pinmux = <0x8c00>;
				slew-rate = <0x0>;
			};

			pins_cmd1_dat {
				bias-disable;
				input-enable;
				pinmux = <0x8d00>;
				slew-rate = <0x0>;
			};

			pins_cmd2_dat {
				bias-disable;
				input-enable;
				pinmux = <0x8e00>;
				slew-rate = <0x0>;
			};

			pins_cmd3_dat {
				bias-disable;
				input-enable;
				pinmux = <0x8f00>;
				slew-rate = <0x0>;
			};
		};

		aud_dat_miso_on {
			phandle = <0x45>;

			pins_cmd0_dat {
				input-schmitt-enable;
				pinmux = <0x8c01>;
			};

			pins_cmd1_dat {
				input-schmitt-enable;
				pinmux = <0x8d01>;
			};

			pins_cmd2_dat {
				input-schmitt-enable;
				pinmux = <0x8e01>;
			};

			pins_cmd3_dat {
				input-schmitt-enable;
				pinmux = <0x8f01>;
			};
		};

		aud_dat_mosi_off {
			phandle = <0x42>;

			pins_cmd0_dat {
				bias-disable;
				input-enable;
				pinmux = <0x8800>;
				slew-rate = <0x0>;
			};

			pins_cmd1_dat {
				bias-disable;
				input-enable;
				pinmux = <0x8900>;
				slew-rate = <0x0>;
			};

			pins_cmd2_dat {
				bias-disable;
				input-enable;
				pinmux = <0x8a00>;
				slew-rate = <0x0>;
			};

			pins_cmd3_dat {
				bias-pull-down;
				input-enable;
				pinmux = <0x8b00>;
				slew-rate = <0x0>;
			};
		};

		aud_dat_mosi_on {
			phandle = <0x43>;

			pins_cmd0_dat {
				input-schmitt-enable;
				pinmux = <0x8801>;
			};

			pins_cmd1_dat {
				input-schmitt-enable;
				pinmux = <0x8901>;
			};

			pins_cmd2_dat {
				input-schmitt-enable;
				pinmux = <0x8a01>;
			};

			pins_cmd3_dat {
				input-schmitt-enable;
				pinmux = <0x8b01>;
			};
		};

		aud_gpio_i2s0_off {
			phandle = <0x46>;

			pins_cmd_dat {
				pinmux = <0x2800>;
			};
		};

		aud_gpio_i2s0_on {
			phandle = <0x47>;

			pins_cmd_dat {
				pinmux = <0x2802>;
			};
		};

		aud_gpio_i2s1_off {
			phandle = <0x48>;
		};

		aud_gpio_i2s1_on {
			phandle = <0x49>;
		};

		aud_gpio_i2s2_off {
			phandle = <0x4a>;
		};

		aud_gpio_i2s2_on {
			phandle = <0x4b>;
		};

		aud_gpio_i2s3_off {
			phandle = <0x4c>;

			pins_cmd_dat {
				pinmux = <0x2500 0x2600 0x2400>;
			};
		};

		aud_gpio_i2s3_on {
			phandle = <0x4d>;

			pins_cmd_dat {
				pinmux = <0x2502 0x2602 0x2402>;
			};
		};

		msdc0@default {
			phandle = <0x30>;

			pins_clk {
				drive-strength = [03];
			};

			pins_cmd {
				drive-strength = [03];
			};

			pins_dat {
				drive-strength = [03];
			};

			pins_ds {
				drive-strength = [03];
			};

			pins_rst {
				drive-strength = [03];
			};
		};

		msdc0@hs200 {
			phandle = <0x32>;

			pins_clk {
				drive-strength = [04];
			};

			pins_cmd {
				drive-strength = [03];
			};

			pins_dat {
				drive-strength = [04];
			};

			pins_ds {
				drive-strength = [04];
			};

			pins_rst {
				drive-strength = [03];
			};
		};

		msdc0@hs400 {
			phandle = <0x31>;

			pins_clk {
				drive-strength = [04];
			};

			pins_cmd {
				drive-strength = [03];
			};

			pins_dat {
				drive-strength = [04];
			};

			pins_ds {
				drive-strength = [04];
			};

			pins_rst {
				drive-strength = [03];
			};
		};

		msdc0@register_default {
			cmd_edge = [00];
			phandle = <0x33>;
			rdata_edge = [00];
			wdata_edge = [00];
		};

		msdc1@ddr50 {
			phandle = <0x38>;

			pins_clk {
				drive-strength = [03];
			};

			pins_cmd {
				drive-strength = [03];
			};

			pins_dat {
				drive-strength = [03];
			};
		};

		msdc1@default {
			phandle = <0x35>;

			pins_clk {
				drive-strength = [03];
			};

			pins_cmd {
				drive-strength = [03];
			};

			pins_dat {
				drive-strength = [03];
			};
		};

		msdc1@register_default {
			cmd_edge = [00];
			phandle = <0x39>;
			rdata_edge = [00];
			wdata_edge = [00];
		};

		msdc1@sdr104 {
			phandle = <0x36>;

			pins_clk {
				drive-strength = [03];
			};

			pins_cmd {
				drive-strength = [03];
			};

			pins_dat {
				drive-strength = [03];
			};
		};

		msdc1@sdr50 {
			phandle = <0x37>;

			pins_clk {
				drive-strength = [03];
			};

			pins_cmd {
				drive-strength = [03];
			};

			pins_dat {
				drive-strength = [03];
			};
		};

		vow_clk_miso_off {
			phandle = <0x50>;

			pins_cmd3_dat {
				pinmux = <0x8f00>;
			};
		};

		vow_clk_miso_on {
			phandle = <0x51>;

			pins_cmd3_dat {
				pinmux = <0x8f04>;
			};
		};

		vow_dat_miso_off {
			phandle = <0x4e>;

			pins_cmd1_dat {
				pinmux = <0x8e00>;
			};
		};

		vow_dat_miso_on {
			phandle = <0x4f>;

			pins_cmd1_dat {
				pinmux = <0x8e04>;
			};
		};
	};

	pmic_clock_buffer_ctrl {
		compatible = "mediatek,pmic_clock_buffer";
		mediatek,clkbuf-config = <0x2 0x1 0x1 0x2 0x0 0x0 0x0>;
		mediatek,clkbuf-driving-current = <0x1 0x1 0x1 0x1 0x1 0x1 0x1>;
		mediatek,clkbuf-quantity = <0x7>;
		phandle = <0xd7>;
	};

	pmu {
		compatible = "arm,armv8-pmuv3";
		interrupt-parent = <0x11>;
		interrupts = <0x1 0x7 0x8>;
	};

	psci {
		compatible = "arm,psci-1.0";
		method = "smc";
	};

	pwm@11006000 {
		clock-names = "PWM1-main", "PWM2-main", "PWM3-main", "PWM4-main", "PWM5-main", "PWM6-main", "PWM-HCLK-main", "PWM-main";
		clocks = <0x21 0x10 0x21 0x11 0x21 0x12 0x21 0x13 0x21 0x14 0x21 0x30 0x21 0xf 0x21 0x15>;
		compatible = "mediatek,pwm";
		interrupts = <0x0 0x62 0x8>;
		reg = <0x0 0x11006000 0x0 0x1000>;
	};

	pwrap@1000d000 {
		clock-names = "spi", "wrap";
		clocks = <0x13 0x13>;
		compatible = "mediatek,mt6768-pwrap";
		interrupts = <0x0 0xc2 0x4>;
		phandle = <0x20>;
		reg = <0x0 0x1000d000 0x0 0x1000>;
		reg-names = "pwrap";

		mt6358-pmic {
			#interrupt-cells = <0x2>;
			compatible = "mediatek,mt6358-pmic";
			interrupt-controller;
			interrupt-names = "vproc11_oc", "vproc12_oc", "vcore_oc", "vgpu_oc", "vmodem_oc", "vdram1_oc", "vs1_oc", "vs2_oc", "vpa_oc", "vcore_preoc", "vfe28_oc", "vxo22_oc", "vrf18_oc", "vrf12_oc", "vefuse_oc", "vcn33_oc", "vcn28_oc", "vcn18_oc", "vcama1_oc", "vcama2_oc", "vcamd_oc", "vcamio_oc", "vldo28_oc", "va12_oc", "vaux18_oc", "vaud28_oc", "vio28_oc", "vio18_oc", "vsram_proc11_oc", "vsram_proc12_oc", "vsram_others_oc", "vsram_gpu_oc", "vdram2_oc", "vmc_oc", "vmch_oc", "vemc_oc", "vsim1_oc", "vsim2_oc", "vibr_oc", "vusb_oc", "vbif28_oc", "pwrkey", "homekey", "pwrkey_r", "homekey_r", "ni_lbat_int", "chrdet", "chrdet_edge", "vcdt_hv_det", "rtc", "fg_bat0_h", "fg_bat0_l", "fg_cur_h", "fg_cur_l", "fg_zcv", "fg_bat1_h", "fg_bat1_l", "fg_n_charge_l", "fg_iavg_h", "fg_iavg_l", "fg_time_h", "fg_discharge", "fg_charge", "baton_lv", "baton_ht", "baton_bat_in", "baton_bat_out", "bif", "bat_h", "bat_l", "bat2_h", "bat2_l", "bat_temp_h", "bat_temp_l", "auxadc_imp", "nag_c_dltv", "audio", "accdet", "accdet_eint0", "accdet_eint1", "spi_cmd_alert";
			interrupt-parent = <0x1e>;
			interrupts = <0x90 0x4 0x90 0x0>;
			mediatek,num-pmic-irqs = <0x91>;
			mediatek,pmic-irqs = <0x0 0x0 0x1 0x0 0x2 0x0 0x3 0x0 0x4 0x0 0x5 0x0 0x6 0x0 0x7 0x0 0x8 0x0 0x9 0x0 0x10 0x1 0x11 0x1 0x12 0x1 0x13 0x1 0x14 0x1 0x15 0x1 0x16 0x1 0x17 0x1 0x18 0x1 0x19 0x1 0x1a 0x1 0x1b 0x1 0x1c 0x1 0x1d 0x1 0x1e 0x1 0x1f 0x1 0x20 0x1 0x21 0x1 0x22 0x1 0x23 0x1 0x24 0x1 0x25 0x1 0x26 0x1 0x27 0x1 0x28 0x1 0x29 0x1 0x2a 0x1 0x2b 0x1 0x2c 0x1 0x2d 0x1 0x2e 0x1 0x30 0x2 0x31 0x2 0x32 0x2 0x33 0x2 0x34 0x2 0x35 0x2 0x36 0x2 0x37 0x2 0x40 0x3 0x50 0x4 0x51 0x4 0x52 0x4 0x53 0x4 0x54 0x4 0x55 0x4 0x56 0x4 0x57 0x4 0x58 0x4 0x59 0x4 0x5a 0x4 0x5b 0x4 0x5c 0x4 0x60 0x4 0x61 0x4 0x62 0x4 0x63 0x4 0x64 0x4 0x70 0x5 0x71 0x5 0x72 0x5 0x73 0x5 0x74 0x5 0x75 0x5 0x76 0x5 0x77 0x5 0x80 0x6 0x85 0x6 0x86 0x6 0x87 0x6 0x90 0x7>;
			phandle = <0x6e>;
			status = "okay";

			mt-pmic {
				compatible = "mediatek,mt-pmic";
				interrupt-names = "pwrkey", "pwrkey_r", "homekey", "homekey_r", "bat_h", "bat_l", "fg_cur_h", "fg_cur_l";
				interrupts = <0x30 0x4 0x32 0x4 0x31 0x4 0x33 0x4 0x70 0x4 0x71 0x4 0x52 0x4 0x53 0x4>;
				phandle = <0x6f>;
			};

			mt6358_misc {
				apply-lpsd-solution;
				base = <0x580>;
				compatible = "mediatek,mt6358-misc";
				dcxo-switch;
				phandle = <0x9a>;
			};

			mt6358_rtc {
				apply-lpsd-solution;
				base = <0x580>;
				compatible = "mediatek,mt6358-rtc";
				interrupt-names = "rtc";
				interrupts = <0x40 0x0>;
				phandle = <0x99>;
			};

			mt6358regulator {
				compatible = "mediatek,mt6358-regulator";
				phandle = <0x71>;

				buck_vcore {
					phandle = <0x73>;
					regulator-enable-ramp-delay = <0xc8>;
					regulator-max-microvolt = <0x13bdb6>;
					regulator-min-microvolt = <0x7a120>;
					regulator-name = "vcore";
				};

				buck_vdram1 {
					phandle = <0x72>;
					regulator-enable-ramp-delay = <0x0>;
					regulator-max-microvolt = <0x1fda4c>;
					regulator-min-microvolt = <0x7a120>;
					regulator-name = "vdram1";
				};

				buck_vgpu {
					phandle = <0x77>;
					regulator-enable-ramp-delay = <0xc8>;
					regulator-max-microvolt = <0x13bdb6>;
					regulator-min-microvolt = <0x7a120>;
					regulator-name = "vgpu";
				};

				buck_vmodem {
					phandle = <0x79>;
					regulator-enable-ramp-delay = <0x384>;
					regulator-max-microvolt = <0x13bdb6>;
					regulator-min-microvolt = <0x7a120>;
					regulator-name = "vmodem";
				};

				buck_vpa {
					phandle = <0x74>;
					regulator-enable-ramp-delay = <0xfa>;
					regulator-max-microvolt = <0x37b1d0>;
					regulator-min-microvolt = <0x7a120>;
					regulator-name = "vpa";
				};

				buck_vproc11 {
					phandle = <0x75>;
					regulator-enable-ramp-delay = <0xc8>;
					regulator-max-microvolt = <0x13bdb6>;
					regulator-min-microvolt = <0x7a120>;
					regulator-name = "vproc11";
				};

				buck_vproc12 {
					phandle = <0x76>;
					regulator-enable-ramp-delay = <0xc8>;
					regulator-max-microvolt = <0x13bdb6>;
					regulator-min-microvolt = <0x7a120>;
					regulator-name = "vproc12";
				};

				buck_vs1 {
					phandle = <0x7a>;
					regulator-enable-ramp-delay = <0x0>;
					regulator-max-microvolt = <0x277b6c>;
					regulator-min-microvolt = <0xf4240>;
					regulator-name = "vs1";
				};

				buck_vs2 {
					phandle = <0x78>;
					regulator-enable-ramp-delay = <0x0>;
					regulator-max-microvolt = <0x1fda4c>;
					regulator-min-microvolt = <0x7a120>;
					regulator-name = "vs2";
				};

				ldo_va09 {
					compatible = "regulator-fixed";
					phandle = <0x98>;
					regulator-boot-on;
					regulator-enable-ramp-delay = <0x108>;
					regulator-max-microvolt = <0xdbba0>;
					regulator-min-microvolt = <0xdbba0>;
					regulator-name = "va09";
				};

				ldo_va12 {
					compatible = "regulator-fixed";
					phandle = <0x90>;
					regulator-enable-ramp-delay = <0x10e>;
					regulator-max-microvolt = <0x124f80>;
					regulator-min-microvolt = <0x124f80>;
					regulator-name = "va12";
				};

				ldo_vaud28 {
					compatible = "regulator-fixed";
					phandle = <0x96>;
					regulator-enable-ramp-delay = <0x10e>;
					regulator-max-microvolt = <0x2ab980>;
					regulator-min-microvolt = <0x2ab980>;
					regulator-name = "vaud28";
				};

				ldo_vaux18 {
					compatible = "regulator-fixed";
					phandle = <0x8b>;
					regulator-enable-ramp-delay = <0x10e>;
					regulator-max-microvolt = <0x1b7740>;
					regulator-min-microvolt = <0x1b7740>;
					regulator-name = "vaux18";
				};

				ldo_vbif28 {
					compatible = "regulator-fixed";
					phandle = <0x8c>;
					regulator-enable-ramp-delay = <0x10e>;
					regulator-max-microvolt = <0x2ab980>;
					regulator-min-microvolt = <0x2ab980>;
					regulator-name = "vbif28";
				};

				ldo_vcama1 {
					phandle = <0x8e>;
					regulator-enable-ramp-delay = <0x10e>;
					regulator-max-microvolt = <0x2dc6c0>;
					regulator-min-microvolt = <0x1b7740>;
					regulator-name = "vcama1";
				};

				ldo_vcama2 {
					phandle = <0x94>;
					regulator-enable-ramp-delay = <0x10e>;
					regulator-max-microvolt = <0x2dc6c0>;
					regulator-min-microvolt = <0x1b7740>;
					regulator-name = "vcama2";
				};

				ldo_vcamd {
					phandle = <0x82>;
					regulator-enable-ramp-delay = <0x10e>;
					regulator-max-microvolt = <0x1b7740>;
					regulator-min-microvolt = <0xdbba0>;
					regulator-name = "vcamd";
				};

				ldo_vcamio {
					compatible = "regulator-fixed";
					phandle = <0x81>;
					regulator-enable-ramp-delay = <0x10e>;
					regulator-max-microvolt = <0x1b7740>;
					regulator-min-microvolt = <0x1b7740>;
					regulator-name = "vcamio";
				};

				ldo_vcn18 {
					compatible = "regulator-fixed";
					phandle = <0x83>;
					regulator-enable-ramp-delay = <0x10e>;
					regulator-max-microvolt = <0x1b7740>;
					regulator-min-microvolt = <0x1b7740>;
					regulator-name = "vcn18";
				};

				ldo_vcn28 {
					compatible = "regulator-fixed";
					phandle = <0x86>;
					regulator-enable-ramp-delay = <0x10e>;
					regulator-max-microvolt = <0x2ab980>;
					regulator-min-microvolt = <0x2ab980>;
					regulator-name = "vcn28";
				};

				ldo_vcn33_bt {
					phandle = <0x92>;
					regulator-enable-ramp-delay = <0x10e>;
					regulator-max-microvolt = <0x3567e0>;
					regulator-min-microvolt = <0x325aa0>;
					regulator-name = "vcn33_bt";
				};

				ldo_vcn33_wifi {
					phandle = <0x93>;
					regulator-enable-ramp-delay = <0x10e>;
					regulator-max-microvolt = <0x3567e0>;
					regulator-min-microvolt = <0x325aa0>;
					regulator-name = "vcn33_wifi";
				};

				ldo_vdram2 {
					phandle = <0x7b>;
					regulator-enable-ramp-delay = <0xce4>;
					regulator-max-microvolt = <0x1b7740>;
					regulator-min-microvolt = <0x927c0>;
					regulator-name = "vdram2";
				};

				ldo_vefuse {
					phandle = <0x8a>;
					regulator-enable-ramp-delay = <0x10e>;
					regulator-max-microvolt = <0x1cfde0>;
					regulator-min-microvolt = <0x19f0a0>;
					regulator-name = "vefuse";
				};

				ldo_vemc {
					phandle = <0x34>;
					regulator-enable-ramp-delay = <0x3c>;
					regulator-max-microvolt = <0x325aa0>;
					regulator-min-microvolt = <0x2c4020>;
					regulator-name = "vemc";
				};

				ldo_vfe28 {
					compatible = "regulator-fixed";
					phandle = <0x84>;
					regulator-enable-ramp-delay = <0x10e>;
					regulator-max-microvolt = <0x2ab980>;
					regulator-min-microvolt = <0x2ab980>;
					regulator-name = "vfe28";
				};

				ldo_vibr {
					phandle = <0x7d>;
					regulator-enable-ramp-delay = <0x3c>;
					regulator-max-microvolt = <0x325aa0>;
					regulator-min-microvolt = <0x124f80>;
					regulator-name = "vibr";
				};

				ldo_vio18 {
					compatible = "regulator-fixed";
					phandle = <0x7f>;
					regulator-enable-ramp-delay = <0xa8c>;
					regulator-max-microvolt = <0x1b7740>;
					regulator-min-microvolt = <0x1b7740>;
					regulator-name = "vio18";
				};

				ldo_vio28 {
					compatible = "regulator-fixed";
					phandle = <0x8f>;
					regulator-enable-ramp-delay = <0x10e>;
					regulator-max-microvolt = <0x2ab980>;
					regulator-min-microvolt = <0x2ab980>;
					regulator-name = "vio28";
				};

				ldo_vldo28 {
					phandle = <0x95>;
					regulator-enable-ramp-delay = <0x10e>;
					regulator-max-microvolt = <0x2dc6c0>;
					regulator-min-microvolt = <0x2ab980>;
					regulator-name = "vldo28";
				};

				ldo_vmc {
					phandle = <0x3b>;
					regulator-enable-ramp-delay = <0x3c>;
					regulator-max-microvolt = <0x325aa0>;
					regulator-min-microvolt = <0x1b7740>;
					regulator-name = "vmc";
				};

				ldo_vmch {
					phandle = <0x3a>;
					regulator-enable-ramp-delay = <0x3c>;
					regulator-max-microvolt = <0x325aa0>;
					regulator-min-microvolt = <0x2c4020>;
					regulator-name = "vmch";
				};

				ldo_vrf12 {
					compatible = "regulator-fixed";
					phandle = <0x7e>;
					regulator-enable-ramp-delay = <0x78>;
					regulator-max-microvolt = <0x124f80>;
					regulator-min-microvolt = <0x124f80>;
					regulator-name = "vrf12";
				};

				ldo_vrf18 {
					compatible = "regulator-fixed";
					phandle = <0x91>;
					regulator-enable-ramp-delay = <0x78>;
					regulator-max-microvolt = <0x1b7740>;
					regulator-min-microvolt = <0x1b7740>;
					regulator-name = "vrf18";
				};

				ldo_vsim1 {
					phandle = <0x7c>;
					regulator-enable-ramp-delay = <0x21c>;
					regulator-max-microvolt = <0x2f4d60>;
					regulator-min-microvolt = <0x19f0a0>;
					regulator-name = "vsim1";
				};

				ldo_vsim2 {
					phandle = <0x97>;
					regulator-enable-ramp-delay = <0x21c>;
					regulator-max-microvolt = <0x2f4d60>;
					regulator-min-microvolt = <0x19f0a0>;
					regulator-name = "vsim2";
				};

				ldo_vsram_gpu {
					phandle = <0x88>;
					regulator-enable-ramp-delay = <0xf0>;
					regulator-max-microvolt = <0x13bdb6>;
					regulator-min-microvolt = <0x7a120>;
					regulator-name = "vsram_gpu";
				};

				ldo_vsram_others {
					phandle = <0x87>;
					regulator-enable-ramp-delay = <0xf0>;
					regulator-max-microvolt = <0x13bdb6>;
					regulator-min-microvolt = <0x7a120>;
					regulator-name = "vsram_others";
				};

				ldo_vsram_proc11 {
					phandle = <0x85>;
					regulator-enable-ramp-delay = <0xf0>;
					regulator-max-microvolt = <0x13bdb6>;
					regulator-min-microvolt = <0x7a120>;
					regulator-name = "vsram_proc11";
				};

				ldo_vsram_proc12 {
					phandle = <0x8d>;
					regulator-enable-ramp-delay = <0xf0>;
					regulator-max-microvolt = <0x13bdb6>;
					regulator-min-microvolt = <0x7a120>;
					regulator-name = "vsram_proc12";
				};

				ldo_vusb {
					phandle = <0x80>;
					regulator-enable-ramp-delay = <0x10e>;
					regulator-max-microvolt = <0x2f4d60>;
					regulator-min-microvolt = <0x2dc6c0>;
					regulator-name = "vusb";
				};

				ldo_vxo22 {
					compatible = "regulator-fixed";
					phandle = <0x89>;
					regulator-enable-ramp-delay = <0x78>;
					regulator-max-microvolt = <0x2191c0>;
					regulator-min-microvolt = <0x2191c0>;
					regulator-name = "vxo22";
				};
			};

			mt635x-auxadc {
				#io-channel-cells = <0x1>;
				compatible = "mediatek,mt6358-auxadc";
				phandle = <0x70>;

				accdet {
					channel = <0x9>;
				};

				bat_temp {
					channel = <0x3>;
					resistance-ratio = <0x2 0x1>;
				};

				batadc {
					avg-num = <0x80>;
					channel = <0x0>;
					resistance-ratio = <0x3 0x1>;
				};

				chip_temp {
					channel = <0x5>;
				};

				dcxo_temp {
					avg-num = <0x10>;
					channel = <0xd>;
				};

				dcxo_volt {
					channel = <0xa>;
					resistance-ratio = <0x3 0x2>;
				};

				hpofs_cal {
					avg-num = <0x100>;
					channel = <0xc>;
				};

				tsx_temp {
					avg-num = <0x80>;
					channel = <0xb>;
				};

				vbif {
					channel = <0xe>;
					resistance-ratio = <0x2 0x1>;
				};

				vcdt {
					channel = <0x2>;
				};

				vcore_temp {
					channel = <0x6>;
				};

				vgpu_temp {
					channel = <0x8>;
				};

				vproc_temp {
					channel = <0x7>;
				};
			};
		};
	};

	pwrap_md32@10448000 {
		compatible = "mediatek,pwrap_md32";
		reg = <0x0 0x10448000 0x0 0x1000>;
	};

	pwrap_mpu@1000d000 {
		compatible = "mediatek,pwrap_mpu";
		reg = <0x0 0x1000d000 0x0 0x1000>;
	};

	pwrap_p2p@1005cb000 {
		compatible = "mediatek,pwrap_p2p";
		reg = <0x0 0x105cb000 0x0 0x1000>;
	};

	pwraphal@ {
		compatible = "mediatek,pwraph";
		mediatek,pwrap-regmap = <0x20>;
		phandle = <0x9b>;
	};

	radio_md_cfg {
		compatible = "mediatek,radio_md_cfg";
		phandle = <0xd0>;
	};

	reserve@16030000 {
		compatible = "mediatek,reserve";
		reg = <0x0 0x16030000 0x0 0x10000>;
	};

	reserved-memory {
		#address-cells = <0x2>;
		#size-cells = <0x2>;
		phandle = <0x66>;
		ranges;

		consys-reserve-memory {
			alignment = <0x0 0x1000000>;
			alloc-ranges = <0x0 0x40000000 0x0 0x80000000>;
			compatible = "mediatek,consys-reserve-memory";
			no-map;
			size = <0x0 0x400000>;
		};

		ion-carveout-heap {
			alignment = <0x0 0x1000>;
			alloc-ranges = <0x0 0x40000000 0x0 0x80000000>;
			compatible = "mediatek,ion-carveout-heap";
			no-map;
			size = <0x0 0x4000>;
		};

		reserve-memory-scp_share {
			alignment = <0x0 0x1000000>;
			alloc-ranges = <0x0 0x40000000 0x0 0x50000000>;
			compatible = "mediatek,reserve-memory-scp_share";
			no-map;
			size = <0x0 0x300000>;
		};

		reserve-memory-sspm_share {
			alignment = <0x0 0x10000>;
			alloc-ranges = <0x0 0x40000000 0x0 0x60000000>;
			compatible = "mediatek,reserve-memory-sspm_share";
			no-map;
			size = <0x0 0x510000>;
			status = "okay";
		};

		soter-shared-mem {
			alignment = <0x0 0x200000>;
			alloc-ranges = <0x0 0x40000000 0x0 0x50000000>;
			compatible = "microtrust,shared_mem";
			no-map;
			size = <0x0 0x200000>;
		};

		wifi-reserve-memory {
			alignment = <0x0 0x1000000>;
			alloc-ranges = <0x0 0x40000000 0x0 0x80000000>;
			compatible = "mediatek,wifi-reserve-memory";
			no-map;
			size = <0x0 0x300000>;
		};

		zmc-default {
			alignment = <0x0 0x1000000>;
			alloc-ranges = <0x0 0xc0000000 0x4 0x0>;
			compatible = "mediatek,zone_movable_cma";
			size = <0x0 0x2d000000>;
		};
	};

	scp@10500000 {
		compatible = "mediatek,scp";
		core_1 = "enable";
		interrupts = <0x0 0xcd 0x4>;
		reg = <0x0 0x10500000 0x0 0x80000 0x0 0x105c0000 0x0 0x3000 0x0 0x105c4000 0x0 0x1000 0x0 0x105d4000 0x0 0x6000>;
		scp_sramSize = <0x80000>;
		status = "okay";
	};

	scp_dvfs {
		clock-names = "clk_mux", "clk_pll_0", "clk_pll_1", "clk_pll_2", "clk_pll_3", "clk_pll_4", "clk_pll_5", "clk_pll_6";
		clocks = <0x12 0x53 0x13 0x12 0xe 0x12 0x1a 0x12 0x2 0x12 0x17 0x12 0x6 0x12 0x19>;
		compatible = "mediatek,scp_dvfs";
	};

	scpsys@10001000 {
		#clock-cells = <0x1>;
		compatible = "mediatek,scpsys", "syscon";
		phandle = <0x22>;
		reg = <0x0 0x10001000 0x0 0x1000 0x0 0x10006000 0x0 0x1000 0x0 0x14002000 0x0 0x1000 0x0 0x1020e000 0x0 0x1000 0x0 0x18004000 0x0 0x1000 0x0 0x18002000 0x0 0x1000 0x0 0x10000000 0x0 0x1000 0x0 0x16000000 0x0 0x1000 0x0 0x16025000 0x0 0x1000>;
	};

	security_ao@1001a000 {
		compatible = "mediatek,security_ao";
		reg = <0x0 0x1001a000 0x0 0x1000>;
	};

	seninf1@1a040000 {
		compatible = "mediatek,seninf1";
		reg = <0x0 0x1a040000 0x0 0x1000>;
	};

	seninf2@1a041000 {
		compatible = "mediatek,seninf2";
		reg = <0x0 0x1a041000 0x0 0x1000>;
	};

	seninf3@1a042000 {
		compatible = "mediatek,seninf3";
		reg = <0x0 0x1a042000 0x0 0x1000>;
	};

	seninf4@1a043000 {
		compatible = "mediatek,seninf4";
		reg = <0x0 0x1a043000 0x0 0x1000>;
	};

	serial@11002000 {
		clock-names = "baud", "bus";
		clocks = <0x13 0x21 0x16>;
		compatible = "mediatek,mt6577-uart";
		dma-names = "tx", "rx";
		dmas = <0x2f 0x0 0x2f 0x1>;
		interrupts = <0x0 0x70 0x8>;
		phandle = <0xaa>;
		reg = <0x0 0x11002000 0x0 0x1000>;
	};

	serial@11003000 {
		clock-names = "baud", "bus";
		clocks = <0x13 0x21 0x17>;
		compatible = "mediatek,mt6577-uart";
		dma-names = "tx", "rx";
		dmas = <0x2f 0x2 0x2f 0x3>;
		interrupts = <0x0 0x71 0x8>;
		phandle = <0xab>;
		reg = <0x0 0x11003000 0x0 0x1000>;
	};

	sleep@10006000 {
		compatible = "mediatek,sleep";
		interrupts = <0x0 0xc3 0x8>;
		phandle = <0x6b>;
		reg = <0x0 0x10006000 0x0 0x1000>;
	};

	sleep_reg_md@1000f000 {
		compatible = "mediatek,sleep_reg_md";
		reg = <0x0 0x1000f000 0x0 0x1000>;
	};

	smart_pa {
		phandle = <0xdb>;
	};

	smi_common@14002000 {
		clock-names = "scp-dis", "mm-comm0", "mm-comm1", "mm-common";
		clocks = <0x22 0x3 0x24 0x15 0x24 0x16 0x24 0x13>;
		compatible = "mediatek,smi_common";
		mediatek,smi-id = <0x5>;
		mmsys_config = <0x24>;
		reg = <0x0 0x14002000 0x0 0x1000>;
	};

	smi_larb0@14003000 {
		clock-names = "scp-dis", "mm-larb0";
		clocks = <0x22 0x3 0x24 0x14>;
		compatible = "mediatek,smi_larb0", "mediatek,smi_larb";
		mediatek,smi-id = <0x0>;
		phandle = <0x55>;
		reg = <0x0 0x14003000 0x0 0x1000>;
	};

	smi_larb1@16010000 {
		clock-names = "scp-vdec", "mm-vdec", "vdec-larb1";
		clocks = <0x22 0xc 0x24 0x1b 0x5a 0x3>;
		compatible = "mediatek,smi_larb1", "mediatek,smi_larb";
		interrupts = <0x0 0xf7 0x8>;
		mediatek,smi-id = <0x1>;
		phandle = <0x58>;
		reg = <0x0 0x16010000 0x0 0x1000>;
	};

	smi_larb2@15021000 {
		clock-names = "scp-isp", "mm-img", "img-larb2";
		clocks = <0x22 0x5 0x24 0x18 0x56 0x0>;
		compatible = "mediatek,smi_larb2", "mediatek,smi_larb";
		mediatek,smi-id = <0x2>;
		phandle = <0xc7>;
		reg = <0x0 0x15021000 0x0 0x1000>;
	};

	smi_larb3@1a002000 {
		clock-names = "scp-cam", "mm-cam", "cam-larb3";
		clocks = <0x22 0xa 0x24 0x19 0x57 0x0>;
		compatible = "mediatek,smi_larb3", "mediatek,smi_larb";
		mediatek,smi-id = <0x3>;
		phandle = <0xc8>;
		reg = <0x0 0x1a002000 0x0 0x1000>;
	};

	smi_larb4@17010000 {
		clock-names = "scp-venc", "mm-venc", "venc-venc", "venc-jpgenc";
		clocks = <0x22 0xb 0x24 0x1a 0x5c 0x1 0x5c 0x2>;
		compatible = "mediatek,smi_larb4", "mediatek,smi_larb";
		mediatek,smi-id = <0x4>;
		phandle = <0x5b>;
		reg = <0x0 0x17010000 0x0 0x1000>;
	};

	snd_scp_spk {
		compatible = "mediatek,snd_scp_spk";
		phandle = <0xc4>;
	};

	sound {
		compatible = "mediatek,mt6768-mt6358-sound";
		mediatek,audio-codec = <0x52>;
		mediatek,platform = <0x53>;
		mtk_spk_i2s_in = <0x0>;
		mtk_spk_i2s_out = <0x3>;
		phandle = <0xc3>;
	};

	spi0@1100a000 {
		clock-names = "parent-clk", "sel-clk", "spi-clk";
		clocks = <0x12 0xb 0x12 0x5b 0x21 0x1b>;
		compatible = "mediatek,mt6765-spi";
		interrupts = <0x0 0x8a 0x8>;
		mediatek,pad-select = <0x0>;
		phandle = <0xb6>;
		reg = <0x0 0x1100a000 0x0 0x1000>;
	};

	spi1@11010000 {
		clock-names = "parent-clk", "sel-clk", "spi-clk";
		clocks = <0x12 0xb 0x12 0x5b 0x21 0x34>;
		compatible = "mediatek,mt6765-spi";
		interrupts = <0x0 0x8b 0x8>;
		mediatek,pad-select = <0x0>;
		phandle = <0xbc>;
		reg = <0x0 0x11010000 0x0 0x1000>;
	};

	spi2@11012000 {
		clock-names = "parent-clk", "sel-clk", "spi-clk";
		clocks = <0x12 0xb 0x12 0x5b 0x21 0x37>;
		compatible = "mediatek,mt6765-spi";
		interrupts = <0x0 0x91 0x8>;
		mediatek,pad-select = <0x0>;
		phandle = <0xbd>;
		reg = <0x0 0x11012000 0x0 0x1000>;
	};

	spi3@11013000 {
		clock-names = "parent-clk", "sel-clk", "spi-clk";
		clocks = <0x12 0xb 0x12 0x5b 0x21 0x38>;
		compatible = "mediatek,mt6765-spi";
		interrupts = <0x0 0x92 0x8>;
		mediatek,pad-select = <0x0>;
		phandle = <0xbe>;
		reg = <0x0 0x11013000 0x0 0x1000>;
	};

	spi4@11014000 {
		clock-names = "parent-clk", "sel-clk", "spi-clk";
		clocks = <0x12 0xb 0x12 0x5b 0x21 0x41>;
		compatible = "mediatek,mt6765-spi";
		interrupts = <0x0 0x74 0x8>;
		mediatek,pad-select = <0x0>;
		phandle = <0xbf>;
		reg = <0x0 0x11014000 0x0 0x1000>;
	};

	spi5@11015000 {
		clock-names = "parent-clk", "sel-clk", "spi-clk";
		clocks = <0x12 0xb 0x12 0x5b 0x21 0x42>;
		compatible = "mediatek,mt6765-spi";
		interrupts = <0x0 0x75 0x8>;
		mediatek,pad-select = <0x0>;
		phandle = <0xc0>;
		reg = <0x0 0x11015000 0x0 0x1000>;
	};

	sramrom@10214000 {
		compatible = "mediatek,sramrom";
		reg = <0x0 0x10214000 0x0 0x1000>;
	};

	sspm@10440000 {
		compatible = "mediatek,sspm";
		interrupt-names = "ipc", "mbox0", "mbox1", "mbox2", "mbox3", "mbox4";
		interrupts = <0x0 0xd7 0x4 0x0 0xda 0x4 0x0 0xdb 0x4 0x0 0xdc 0x4 0x0 0xdd 0x4 0x0 0xde 0x4>;
		reg = <0x0 0x10440000 0x0 0x10000 0x0 0x10450000 0x0 0x100 0x0 0x10451000 0x0 0x8 0x0 0x10460000 0x0 0x100 0x0 0x10461000 0x0 0x8 0x0 0x10470000 0x0 0x100 0x0 0x10471000 0x0 0x8 0x0 0x10480000 0x0 0x100 0x0 0x10481000 0x0 0x8 0x0 0x10490000 0x0 0x100 0x0 0x10491000 0x0 0x8>;
		reg-names = "cfgreg", "mbox0_base", "mbox0_ctrl", "mbox1_base", "mbox1_ctrl", "mbox2_base", "mbox2_ctrl", "mbox3_base", "mbox3_ctrl", "mbox4_base", "mbox4_ctrl";
	};

	sys_cirq@10204000 {
		compatible = "mediatek,sys_cirq";
		interrupts = <0x0 0x127 0x8>;
		mediatek,cirq_num = <0xe8>;
		mediatek,spi_start_offset = <0x40>;
		reg = <0x0 0x10204000 0x0 0x1000>;
	};

	sys_timer@10017000 {
		clocks = <0x12 0x86>;
		compatible = "mediatek,sys_timer";
		interrupts = <0x0 0xcf 0x4>;
		reg = <0x0 0x10017000 0x0 0x1000>;
		reg-names = "sys_timer_base";
	};

	therm_ctrl@1100b000 {
		clock-names = "therm-main";
		clocks = <0x21 0xa>;
		compatible = "mediatek,therm_ctrl";
		interrupts = <0x0 0x63 0x8>;
		reg = <0x0 0x1100b000 0x0 0x1000>;
	};

	thermal-sensor1 {
		compatible = "mediatek,mtboard-thermistor1";
		io-channel-names = "thermistor-ch0";
		io-channels = <0x23 0x0>;
		phandle = <0xb8>;
	};

	thermal-sensor2 {
		compatible = "mediatek,mtboard-thermistor2";
		io-channel-names = "thermistor-ch1";
		io-channels = <0x23 0x1>;
		phandle = <0xb9>;
	};

	timer {
		clock-frequency = <0xc65d40>;
		compatible = "arm,armv8-timer";
		interrupt-parent = <0x11>;
		interrupts = <0x1 0xd 0x8 0x1 0xe 0x8 0x1 0xb 0x8 0x1 0xa 0x8>;
		phandle = <0x68>;
	};

	topckgen@10000000 {
		#clock-cells = <0x1>;
		compatible = "mediatek,topckgen", "syscon";
		phandle = <0x12>;
		reg = <0x0 0x10000000 0x0 0x1000>;
	};

	topckgen_ao@1001b000 {
		compatible = "mediatek,topckgen_ao";
		reg = <0x0 0x1001b000 0x0 0x1000>;
	};

	topmisc@10011000 {
		compatible = "mediatek,topmisc";
		reg = <0x0 0x10011000 0x0 0x1000>;
	};

	toprgu@10007000 {
		compatible = "mediatek,toprgu";
		interrupts = <0x0 0x9c 0x8>;
		phandle = <0x6c>;
		reg = <0x0 0x10007000 0x0 0x1000>;
	};

	touch {
		compatible = "mediatek,touch";
		phandle = <0xd8>;
	};

	tran_battery {
		compatible = "tran,chg_fun";
		enable_pcb_tml;
		jeita_above_t4_chg_cur = <0x0>;
		jeita_above_t4_input_cur = <0xf4240>;
		jeita_below_t0_chg_cur = <0x0>;
		jeita_below_t0_input_cur = <0x16e360>;
		jeita_t0_to_t1_chg_cur = <0xf4240>;
		jeita_t0_to_t1_input_cur = <0x16e360>;
		jeita_t2_to_t3_chg_cur = <0x2191c0>;
		jeita_t2_to_t3_input_cur = <0x2191c0>;
		jeita_t3_to_t4_chg_cur = <0x1e8480>;
		jeita_t3_to_t4_input_cur = <0x1e8480>;
		pcb_cur_step_one = <0x1f4>;
		pcb_cur_step_two = <0x1f4>;
		pcb_min_chg_cur = <0xf4240>;
		pcb_temp_step_one = <0xa028>;
		pcb_temp_step_two = <0xabe0>;
		phandle = <0xd2>;
	};

	trng@1020f000 {
		compatible = "mediatek,trng";
		interrupts = <0x0 0xb0 0x8>;
		reg = <0x0 0x1020f000 0x0 0x1000>;
	};

	type_c_port0 {
		mt-tcpc,name = "type_c_port0";
		mt-tcpc,notifier_supply_num = <0x3>;
		mt-tcpc,role_def = <0x4>;
		mt-tcpc,rp_level = <0x0>;
		mt-tcpc,vconn_supply = <0x1>;
		mt6370pd,intr_gpio = <0x1e 0x18 0x0>;
		mt6370pd,intr_gpio_num = <0x18>;
		phandle = <0xe0>;
		tcpc-dual,supported_modes = <0x0>;

		dpm_caps {
			attemp_discover_cable;
			attemp_discover_id;
			attemp_enter_dp_mode;
			dr_check = <0x0>;
			local_dr_data;
			local_dr_power;
			local_no_suspend;
			local_usb_comm;
			local_vconn_supply;
			pr_check = <0x0>;
			pr_check_gp_source;
		};

		pd-data {
			bat,nr = <0x1>;
			pd,charging_policy = <0x21>;
			pd,country_nr = <0x0>;
			pd,id-vdo-data = <0xd10029cf 0x0 0x10000>;
			pd,id-vdo-size = <0x3>;
			pd,mfrs = "RichtekTCPC";
			pd,pid = <0x5081>;
			pd,sink-pdo-data = <0x190c8 0xc0761e3c>;
			pd,sink-pdo-size = <0x2>;
			pd,source-cap-ext = <0x171129cf 0x0 0x102 0x0 0x0 0x2000000>;
			pd,source-pdo-data = <0x19032>;
			pd,source-pdo-size = <0x1>;
			pd,vid = <0x29cf>;

			bat-info0 {
				bat,design_cap = <0xbb8>;
				bat,mfrs = "bat1";
				bat,pid = <0x1711>;
				bat,vid = <0x29cf>;
			};
		};
	};

	usb0@11200000 {
		clock-names = "usb0", "usb0_clk_top_sel", "usb0_clk_univpll3_d4";
		clocks = <0x21 0x8 0x12 0x66 0x12 0x20>;
		compatible = "mediatek,mt6768-usb20";
		interrupts = <0x0 0x61 0x8>;
		mode = <0x2>;
		multipoint = <0x1>;
		num_eps = <0x10>;
		reg = <0x0 0x11200000 0x0 0x10000 0x0 0x11cc0000 0x0 0x10000>;
	};

	usb1p_sif@11210000 {
		compatible = "mediatek,usb1p_sif";
		reg = <0x0 0x11210000 0x0 0x10000>;
	};

	utos {
		compatible = "microtrust,utos";
		interrupts = <0x0 0x12b 0x1 0x0 0x12c 0x1>;
	};

	utos_tester {
		compatible = "microtrust,tester-v1";
	};

	vcu@16000000 {
		compatible = "mediatek-vcu";
		gce-event-names = "venc_eof", "venc_cmdq_pause_done", "venc_mb_done", "venc_128B_cnt_done";
		gce-events = <0x2e 0x121 0x2e 0x122 0x2e 0x124 0x2e 0x125>;
		mboxes = <0x2e 0x1 0x0 0x1 0x2e 0x5 0x0 0x1>;
		mediatek,mailbox-gce = <0x2e>;
		mediatek,vcuid = <0x0>;
		mediatek,vcuname = "vcu";
		phandle = <0x59>;
		reg = <0x0 0x16000000 0x0 0x40000 0x0 0x17020000 0x0 0x10000 0x0 0x19002000 0x0 0x1000>;
	};

	vdec@16020000 {
		compatible = "mediatek,vdec";
		interrupts = <0x0 0xf6 0x8>;
		reg = <0x0 0x16020000 0x0 0x10000>;
	};

	vdec_gcon@16000000 {
		#clock-cells = <0x1>;
		clock-names = "MT_SCP_SYS_DIS", "MT_SCP_SYS_VDE", "MT_CG_VDEC";
		clocks = <0x22 0x3 0x22 0xc 0x5a 0x0>;
		compatible = "mediatek,vdec_gcon", "syscon";
		interrupts = <0x0 0xf6 0x8>;
		mediatek,larb = <0x58>;
		mediatek,vcu = <0x59>;
		phandle = <0x5a>;
		reg = <0x0 0x16000000 0x0 0x1000 0x0 0x16020000 0x0 0x400 0x0 0x16025000 0x0 0x1000>;
	};

	vdec_mbist_ctrl@16001000 {
		compatible = "mediatek,vdec_mbist_ctrl";
		reg = <0x0 0x16001000 0x0 0x1000>;
	};

	venc@17020000 {
		compatible = "mediatek,venc";
		interrupts = <0x0 0xf3 0x8>;
		reg = <0x0 0x17020000 0x0 0x10000>;
	};

	venc_gcon@17000000 {
		#clock-cells = <0x1>;
		clock-names = "MT_SCP_SYS_DIS", "MT_SCP_SYS_VEN", "MT_CG_VENC";
		clocks = <0x22 0x3 0x22 0xb 0x5c 0x1>;
		compatible = "mediatek,venc_gcon", "syscon";
		interrupts = <0x0 0xf3 0x8>;
		mediatek,larb = <0x5b>;
		mediatek,vcu = <0x59>;
		phandle = <0x5c>;
		reg = <0x0 0x17000000 0x0 0x1000 0x0 0x17020000 0x0 0x1000>;
	};

	venc_jpg@17030000 {
		clock-names = "MT_CG_VENC_JPGENC";
		clocks = <0x5c 0x2>;
		compatible = "mediatek,venc_jpg";
		interrupts = <0x0 0xf5 0x8>;
		reg = <0x0 0x17030000 0x0 0x10000>;
	};

	wifi@18000000 {
		compatible = "mediatek,wifi";
		interrupts = <0x0 0x11d 0x8>;
		reg = <0x0 0x18000000 0x0 0x100000>;
	};
};
